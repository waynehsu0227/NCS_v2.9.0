## CMakeLists.txt
```
#
# Copyright (c) 2024 Nordic Semiconductor ASA
#
# SPDX-License-Identifier: LicenseRef-Nordic-5-Clause
#
cmake_minimum_required(VERSION 3.20.0)

find_package(Zephyr REQUIRED HINTS $ENV{ZEPHYR_BASE})
project(ot_rpc_client_test)

FILE(GLOB app_sources src/*.c)

target_include_directories(app PRIVATE
  # Needed to access OpenThread RPC command IDs.
  ${ZEPHYR_NRF_MODULE_DIR}/subsys/net/openthread/rpc/common
  ../common
  )

target_sources(app PRIVATE
  ${app_sources}
  ../common/net_l2_openthread.c
  ../common/nrf_rpc_single_thread.c
  )

# Fill the gaps due to not setting NET_L2_OPENTHREAD.
zephyr_include_directories(
  ${ZEPHYR_OPENTHREAD_MODULE_DIR}/include
)

zephyr_compile_definitions(
  CONFIG_OPENTHREAD_PKT_LIST_SIZE=1
)

# Enforce single-threaded nRF RPC command processing.
target_link_options(app PUBLIC
  -Wl,--wrap=nrf_rpc_os_init,--wrap=nrf_rpc_os_thread_pool_send
)
```

## prj.conf
```kconfig
#
# Copyright (c) 2024 Nordic Semiconductor ASA
#
# SPDX-License-Identifier: LicenseRef-Nordic-5-Clause
#

# Ztest configuration
CONFIG_ZTEST=y
CONFIG_TEST_RANDOM_GENERATOR=y

CONFIG_OPENTHREAD_RPC=y
CONFIG_OPENTHREAD_RPC_CLIENT=y
CONFIG_NETWORKING=y
CONFIG_NRF_RPC_ZCBOR_BACKUPS=1
CONFIG_NRF_RPC_CBKPROXY_OUT_SLOTS=0

CONFIG_MOCK_NRF_RPC=y
CONFIG_MOCK_NRF_RPC_TRANSPORT=y

CONFIG_KERNEL_MEM_POOL=y
CONFIG_HEAP_MEM_POOL_SIZE=4096
```

## src/coap_suite.c
```c
/*
 * Copyright (c) 2024 Nordic Semiconductor ASA
 *
 * SPDX-License-Identifier: LicenseRef-Nordic-5-Clause
 */

#include <mock_nrf_rpc_transport.h>
#include <ot_rpc_ids.h>
#include <ot_rpc_types.h>
#include <test_rpc_env.h>

#include <zephyr/fff.h>
#include <zephyr/kernel.h>
#include <zephyr/ztest.h>

#include <openthread/coap.h>

/* Message address used when testing serialization of a function that takes otMessage* */
#define MSG_ADDR UINT32_MAX

/* Shortest and longest possible CoAP URI */
#define SHORT_URI      'a'
#define CBOR_SHORT_URI 0x61, SHORT_URI
#define LONG_URI       STR_SEQUENCE(32)
#define CBOR_LONG_URI  0x78, 0x20, LONG_URI

/* Longest possible CoAP token */
#define TOKEN	   INT_SEQUENCE(OT_COAP_MAX_TOKEN_LENGTH)
#define CBOR_TOKEN 0x48, TOKEN

/* Fake functions */

DEFINE_FFF_GLOBALS;
FAKE_VOID_FUNC(ot_coap_handler, void *, otMessage *, const otMessageInfo *);
FAKE_VOID_FUNC(ot_coap_response_handler, void *, otMessage *, const otMessageInfo *, otError);

static void nrf_rpc_err_handler(const struct nrf_rpc_err_report *report)
{
	zassert_ok(report->code);
}

static void tc_setup(void *f)
{
	mock_nrf_rpc_tr_expect_add(RPC_INIT_REQ, RPC_INIT_RSP);
	zassert_ok(nrf_rpc_init(nrf_rpc_err_handler));
	mock_nrf_rpc_tr_expect_reset();
}

/* Test serialization of otCoapNewMessage() returning NULL */
ZTEST(ot_rpc_coap, test_otCoapNewMessage_0)
{
	otMessage *message;
	otMessageSettings settings = {
		.mLinkSecurityEnabled = false,
		.mPriority = OT_MESSAGE_PRIORITY_LOW,
	};

	mock_nrf_rpc_tr_expect_add(
		RPC_CMD(OT_RPC_CMD_COAP_NEW_MESSAGE, CBOR_FALSE, OT_MESSAGE_PRIORITY_LOW),
		RPC_RSP(0));
	message = otCoapNewMessage(NULL, &settings);
	mock_nrf_rpc_tr_expect_done();

	zassert_equal(message, NULL);
}

/* Test serialization of otCoapNewMessage() returning maximum allowed 0xffffffff */
ZTEST(ot_rpc_coap, test_otCoapNewMessage_max)
{
	otMessage *message;
	otMessageSettings settings = {
		.mLinkSecurityEnabled = true,
		.mPriority = OT_MESSAGE_PRIORITY_HIGH,
	};

	mock_nrf_rpc_tr_expect_add(
		RPC_CMD(OT_RPC_CMD_COAP_NEW_MESSAGE, CBOR_TRUE, OT_MESSAGE_PRIORITY_HIGH),
		RPC_RSP(CBOR_UINT32(UINT32_MAX)));
	message = otCoapNewMessage(NULL, &settings);
	mock_nrf_rpc_tr_expect_done();

	zassert_equal(message, (otMessage *)UINT32_MAX);
}

/* Test serialization of otCoapMessageInit() */
ZTEST(ot_rpc_coap, test_otCoapMessageInit)
{
	otMessage *message = (otMessage *)MSG_ADDR;

	mock_nrf_rpc_tr_expect_add(RPC_CMD(OT_RPC_CMD_COAP_MESSAGE_INIT, CBOR_UINT32(MSG_ADDR),
					   OT_COAP_TYPE_RESET,
					   CBOR_UINT8(OT_COAP_CODE_PROXY_NOT_SUPPORTED)),
				   RPC_RSP());
	otCoapMessageInit(message, OT_COAP_TYPE_RESET, OT_COAP_CODE_PROXY_NOT_SUPPORTED);
	mock_nrf_rpc_tr_expect_done();
}

/* Test serialization of otCoapMessageInitResponse() */
ZTEST(ot_rpc_coap, test_otCoapMessageInitResponse)
{
	otMessage *response = (otMessage *)MSG_ADDR;
	otMessage *request = (otMessage *)(MSG_ADDR - 1);
	otError error;

	mock_nrf_rpc_tr_expect_add(RPC_CMD(OT_RPC_CMD_COAP_MESSAGE_INIT_RESPONSE,
					   CBOR_UINT32(MSG_ADDR), CBOR_UINT32(MSG_ADDR - 1),
					   OT_COAP_TYPE_RESET,
					   CBOR_UINT8(OT_COAP_CODE_PROXY_NOT_SUPPORTED)),
				   RPC_RSP(OT_ERROR_INVALID_ARGS));
	error = otCoapMessageInitResponse(response, request, OT_COAP_TYPE_RESET,
					  OT_COAP_CODE_PROXY_NOT_SUPPORTED);
	mock_nrf_rpc_tr_expect_done();

	zassert_equal(error, OT_ERROR_INVALID_ARGS);
}

/* Test serialization of otCoapMessageAppendUriPathOptions(..., "a") */
ZTEST(ot_rpc_coap, test_otCoapMessageAppendUriPathOptions_short)
{
	otMessage *message = (otMessage *)MSG_ADDR;
	char uri[] = {SHORT_URI, '\0'};
	otError error;

	mock_nrf_rpc_tr_expect_add(RPC_CMD(OT_RPC_CMD_COAP_MESSAGE_APPEND_URI_PATH_OPTIONS,
					   CBOR_UINT32(MSG_ADDR), CBOR_SHORT_URI),
				   RPC_RSP(OT_ERROR_INVALID_ARGS));
	error = otCoapMessageAppendUriPathOptions(message, uri);
	mock_nrf_rpc_tr_expect_done();

	zassert_equal(error, OT_ERROR_INVALID_ARGS);
}

/* Test serialization of otCoapMessageAppendUriPathOptions(..., "aaa...") */
ZTEST(ot_rpc_coap, test_otCoapMessageAppendUriPathOptions_long)
{
	otMessage *message = (otMessage *)MSG_ADDR;
	char uri[] = {LONG_URI, '\0'};
	otError error;

	mock_nrf_rpc_tr_expect_add(RPC_CMD(OT_RPC_CMD_COAP_MESSAGE_APPEND_URI_PATH_OPTIONS,
					   CBOR_UINT32(MSG_ADDR), CBOR_LONG_URI),
				   RPC_RSP(OT_ERROR_INVALID_ARGS));
	error = otCoapMessageAppendUriPathOptions(message, uri);
	mock_nrf_rpc_tr_expect_done();

	zassert_equal(error, OT_ERROR_INVALID_ARGS);
}

/* Test serialization of otCoapMessageSetPayloadMarker() */
ZTEST(ot_rpc_coap, test_otCoapMessageSetPayloadMarker)
{
	otMessage *message = (otMessage *)MSG_ADDR;
	otError error;

	mock_nrf_rpc_tr_expect_add(
		RPC_CMD(OT_RPC_CMD_COAP_MESSAGE_SET_PAYLOAD_MARKER, CBOR_UINT32(MSG_ADDR)),
		RPC_RSP(OT_ERROR_INVALID_ARGS));
	error = otCoapMessageSetPayloadMarker(message);
	mock_nrf_rpc_tr_expect_done();

	zassert_equal(error, OT_ERROR_INVALID_ARGS);
}

/* Test serialization of otCoapMessageGetType() returning OT_COAP_TYPE_RESET */
ZTEST(ot_rpc_coap, test_otCoapMessageGetType)
{
	otMessage *message = (otMessage *)MSG_ADDR;
	otCoapType type;

	mock_nrf_rpc_tr_expect_add(RPC_CMD(OT_RPC_CMD_COAP_MESSAGE_GET_TYPE, CBOR_UINT32(MSG_ADDR)),
				   RPC_RSP(OT_COAP_TYPE_RESET));
	type = otCoapMessageGetType(message);
	mock_nrf_rpc_tr_expect_done();

	zassert_equal(type, OT_COAP_TYPE_RESET);
}

/* Test serialization of otCoapMessageGetCode() returning OT_COAP_CODE_PROXY_NOT_SUPPORTED */
ZTEST(ot_rpc_coap, test_otCoapMessageGetCode)
{
	otMessage *message = (otMessage *)MSG_ADDR;
	otCoapCode code;

	mock_nrf_rpc_tr_expect_add(RPC_CMD(OT_RPC_CMD_COAP_MESSAGE_GET_CODE, CBOR_UINT32(MSG_ADDR)),
				   RPC_RSP(CBOR_UINT8(OT_COAP_CODE_PROXY_NOT_SUPPORTED)));
	code = otCoapMessageGetCode(message);
	mock_nrf_rpc_tr_expect_done();

	zassert_equal(code, OT_COAP_CODE_PROXY_NOT_SUPPORTED);
}

/* Test serialization of otCoapMessageGetMessageId() returning max allowed 0xffff */
ZTEST(ot_rpc_coap, test_otCoapMessageGetMessageId)
{
	otMessage *message = (otMessage *)MSG_ADDR;
	uint16_t id;

	mock_nrf_rpc_tr_expect_add(
		RPC_CMD(OT_RPC_CMD_COAP_MESSAGE_GET_MESSAGE_ID, CBOR_UINT32(MSG_ADDR)),
		RPC_RSP(CBOR_UINT16(UINT16_MAX)));
	id = otCoapMessageGetMessageId(message);
	mock_nrf_rpc_tr_expect_done();

	zassert_equal(id, UINT16_MAX);
}

/* Test serialization of otCoapMessageGetTokenLength() returning OT_COAP_MAX_TOKEN_LENGTH */
ZTEST(ot_rpc_coap, test_otCoapMessageGetTokenLength)
{
	otMessage *message = (otMessage *)MSG_ADDR;
	uint8_t length;

	mock_nrf_rpc_tr_expect_add(
		RPC_CMD(OT_RPC_CMD_COAP_MESSAGE_GET_TOKEN_LENGTH, CBOR_UINT32(MSG_ADDR)),
		RPC_RSP(CBOR_UINT8(OT_COAP_MAX_TOKEN_LENGTH)));
	length = otCoapMessageGetTokenLength(message);
	mock_nrf_rpc_tr_expect_done();

	zassert_equal(length, OT_COAP_MAX_TOKEN_LENGTH);
}

/* Test serialization of otCoapMessageGetToken() sequence of length OT_COAP_MAX_TOKEN_LENGTH */
ZTEST(ot_rpc_coap, test_otCoapMessageGetToken)
{
	otMessage *message = (otMessage *)MSG_ADDR;
	const uint8_t exp_token[] = {TOKEN};
	const uint8_t *token;

	mock_nrf_rpc_tr_expect_add(
		RPC_CMD(OT_RPC_CMD_COAP_MESSAGE_GET_TOKEN, CBOR_UINT32(MSG_ADDR)),
		RPC_RSP(CBOR_TOKEN));
	token = otCoapMessageGetToken(message);
	mock_nrf_rpc_tr_expect_done();

	zassert_mem_equal(token, exp_token, sizeof(exp_token));
}

/* Test serialization of otCoapStart(..., 0xffff) returning OT_ERROR_INVALID_STATE */
ZTEST(ot_rpc_coap, test_otCoapStart)
{
	otError error;

	mock_nrf_rpc_tr_expect_add(RPC_CMD(OT_RPC_CMD_COAP_START, CBOR_UINT16(UINT16_MAX)),
				   RPC_RSP(OT_ERROR_INVALID_STATE));
	error = otCoapStart(NULL, UINT16_MAX);
	mock_nrf_rpc_tr_expect_done();

	zassert_equal(error, OT_ERROR_INVALID_STATE);
}

/* Test serialization of otCoapStop() returning OT_ERROR_INVALID_STATE */
ZTEST(ot_rpc_coap, test_otCoapStop)
{
	otError error;

	mock_nrf_rpc_tr_expect_add(RPC_CMD(OT_RPC_CMD_COAP_STOP), RPC_RSP(OT_ERROR_INVALID_STATE));
	error = otCoapStop(NULL);
	mock_nrf_rpc_tr_expect_done();

	zassert_equal(error, OT_ERROR_INVALID_STATE);
}

/* Test serialization of otCoapAddResource() and otCoapRemoveResource() */
ZTEST(ot_rpc_coap, test_otCoapAddResource_otCoapRemoveResource)
{
	const char uri[] = {LONG_URI, '\0'};

	otCoapResource resource = {
		.mUriPath = uri,
		.mHandler = ot_coap_handler,
		.mContext = (void *)(UINT32_MAX - 1),
		.mNext = NULL,
	};

	/* Test serialization of otCoapAddResource() */
	mock_nrf_rpc_tr_expect_add(RPC_CMD(OT_RPC_CMD_COAP_ADD_RESOURCE, CBOR_LONG_URI), RPC_RSP());
	otCoapAddResource(NULL, &resource);
	mock_nrf_rpc_tr_expect_done();

	/* Test remote call of the resource handler */
	RESET_FAKE(ot_coap_handler);

	mock_nrf_rpc_tr_expect_add(RPC_RSP(), NO_RSP);
	mock_nrf_rpc_tr_receive(RPC_CMD(OT_RPC_CMD_COAP_RESOURCE_HANDLER, CBOR_LONG_URI,
					CBOR_UINT32(MSG_ADDR), CBOR_MSG_INFO));
	mock_nrf_rpc_tr_expect_done();

	zassert_equal(ot_coap_handler_fake.call_count, 1);
	zassert_equal(ot_coap_handler_fake.arg0_val, (void *)(UINT32_MAX - 1));
	zassert_equal(ot_coap_handler_fake.arg1_val, (otMessage *)MSG_ADDR);

	/* Test serialization of otCoapRemoveResource() */
	mock_nrf_rpc_tr_expect_add(RPC_CMD(OT_RPC_CMD_COAP_REMOVE_RESOURCE, CBOR_LONG_URI),
				   RPC_RSP());
	otCoapRemoveResource(NULL, &resource);
	mock_nrf_rpc_tr_expect_done();
}

/* Test serialization of otCoapSetDefaultHandler() */
ZTEST(ot_rpc_coap, test_otCoapSetDefaultHandler)
{
	/* Test serialization of otCoapSetDefaultHandler() that takes non-null handler */
	mock_nrf_rpc_tr_expect_add(RPC_CMD(OT_RPC_CMD_COAP_SET_DEFAULT_HANDLER, CBOR_TRUE),
				   RPC_RSP());
	otCoapSetDefaultHandler(NULL, ot_coap_handler, (void *)(UINT32_MAX - 1));
	mock_nrf_rpc_tr_expect_done();

	/* Test remote call of the default handler */
	RESET_FAKE(ot_coap_handler);

	mock_nrf_rpc_tr_expect_add(RPC_RSP(), NO_RSP);
	mock_nrf_rpc_tr_receive(
		RPC_CMD(OT_RPC_CMD_COAP_DEFAULT_HANDLER, CBOR_UINT32(MSG_ADDR), CBOR_MSG_INFO));
	mock_nrf_rpc_tr_expect_done();

	zassert_equal(ot_coap_handler_fake.call_count, 1);
	zassert_equal(ot_coap_handler_fake.arg0_val, (void *)(UINT32_MAX - 1));
	zassert_equal(ot_coap_handler_fake.arg1_val, (otMessage *)MSG_ADDR);

	/* Test serialization of otCoapSetDefaultHandler() that takes null handler */
	mock_nrf_rpc_tr_expect_add(RPC_CMD(OT_RPC_CMD_COAP_SET_DEFAULT_HANDLER, CBOR_FALSE),
				   RPC_RSP());
	otCoapSetDefaultHandler(NULL, NULL, NULL);
	mock_nrf_rpc_tr_expect_done();
}

/* Test serialization of otCoapSendRequest() returning OT_ERROR_NONE */
ZTEST(ot_rpc_coap, test_otCoapSendRequest)
{
	/*
	 * Request key is allocated by the otCoapSendRequest() encoder function but we know
	 * that the first free slot will be selected so it will be 1.
	 */
	ot_rpc_coap_request_key request_rep = 1;
	otMessageInfo message_info = {
		.mSockAddr = {.mFields.m8 = {ADDR_1}},
		.mPeerAddr = {.mFields.m8 = {ADDR_2}},
		.mSockPort = PORT_1,
		.mPeerPort = PORT_2,
		.mHopLimit = HOP_LIMIT,
		.mEcn = 3,
		.mIsHostInterface = true,
		.mAllowZeroHopLimit = true,
		.mMulticastLoop = true,
	};
	otError error;

	mock_nrf_rpc_tr_expect_add(RPC_CMD(OT_RPC_CMD_COAP_SEND_REQUEST, CBOR_UINT32(MSG_ADDR),
					   CBOR_MSG_INFO, request_rep),
				   RPC_RSP(OT_ERROR_NONE));
	error = otCoapSendRequest(NULL, (otMessage *)MSG_ADDR, &message_info,
				  ot_coap_response_handler, (void *)(UINT32_MAX - 1));
	mock_nrf_rpc_tr_expect_done();

	/* Test remote call of the resource handler */
	RESET_FAKE(ot_coap_response_handler);

	mock_nrf_rpc_tr_expect_add(RPC_RSP(), NO_RSP);
	mock_nrf_rpc_tr_receive(RPC_CMD(OT_RPC_CMD_COAP_RESPONSE_HANDLER, request_rep,
					CBOR_UINT32(MSG_ADDR), CBOR_MSG_INFO,
					CBOR_UINT8(OT_ERROR_RESPONSE_TIMEOUT)));
	mock_nrf_rpc_tr_expect_done();

	zassert_equal(ot_coap_response_handler_fake.call_count, 1);
	zassert_equal(ot_coap_response_handler_fake.arg0_val, (void *)(UINT32_MAX - 1));
	zassert_equal(ot_coap_response_handler_fake.arg1_val, (otMessage *)MSG_ADDR);
	zassert_equal(ot_coap_response_handler_fake.arg3_val, OT_ERROR_RESPONSE_TIMEOUT);

	zassert_equal(error, OT_ERROR_NONE);
}

/* Test serialization of otCoapSendRequest() returning OT_ERROR_INVALID_STATE */
ZTEST(ot_rpc_coap, test_otCoapSendRequest_failure)
{
	/*
	 * Request key is allocated by the otCoapSendRequest() encoder function but we know
	 * that the first free slot will be selected so it will be 1.
	 */
	ot_rpc_coap_request_key request_rep = 1;
	otMessageInfo message_info = {
		.mSockAddr = {.mFields.m8 = {ADDR_1}},
		.mPeerAddr = {.mFields.m8 = {ADDR_2}},
		.mSockPort = PORT_1,
		.mPeerPort = PORT_2,
		.mHopLimit = HOP_LIMIT,
		.mEcn = 3,
		.mIsHostInterface = true,
		.mAllowZeroHopLimit = true,
		.mMulticastLoop = true,
	};
	otError error;

	mock_nrf_rpc_tr_expect_add(RPC_CMD(OT_RPC_CMD_COAP_SEND_REQUEST, CBOR_UINT32(MSG_ADDR),
					   CBOR_MSG_INFO, request_rep),
				   RPC_RSP(OT_ERROR_INVALID_STATE));
	error = otCoapSendRequest(NULL, (otMessage *)MSG_ADDR, &message_info,
				  ot_coap_response_handler, (void *)(UINT32_MAX - 1));
	mock_nrf_rpc_tr_expect_done();

	zassert_equal(error, OT_ERROR_INVALID_STATE);
}

/* Test serialization of otCoapSendResponse() returning OT_ERROR_INVALID_STATE */
ZTEST(ot_rpc_coap, test_otCoapSendResponse)
{
	otMessageInfo message_info = {
		.mSockAddr = {.mFields.m8 = {ADDR_1}},
		.mPeerAddr = {.mFields.m8 = {ADDR_2}},
		.mSockPort = PORT_1,
		.mPeerPort = PORT_2,
		.mHopLimit = HOP_LIMIT,
		.mEcn = 3,
		.mIsHostInterface = true,
		.mAllowZeroHopLimit = true,
		.mMulticastLoop = true,
	};
	otError error;

	mock_nrf_rpc_tr_expect_add(
		RPC_CMD(OT_RPC_CMD_COAP_SEND_RESPONSE, CBOR_UINT32(MSG_ADDR), CBOR_MSG_INFO),
		RPC_RSP(OT_ERROR_INVALID_STATE));
	error = otCoapSendResponse(NULL, (otMessage *)MSG_ADDR, &message_info);
	mock_nrf_rpc_tr_expect_done();

	zassert_equal(error, OT_ERROR_INVALID_STATE);
}

ZTEST_SUITE(ot_rpc_coap, NULL, NULL, tc_setup, NULL, NULL);
```

## src/dataset_suite.c
```c
/*
 * Copyright (c) 2024 Nordic Semiconductor ASA
 *
 * SPDX-License-Identifier: LicenseRef-Nordic-5-Clause
 */

#include <mock_nrf_rpc_transport.h>
#include <nrf_rpc/nrf_rpc_cbkproxy.h>
#include <ot_rpc_ids.h>
#include <test_rpc_env.h>

#include <zephyr/ztest.h>
#include <zephyr/kernel.h>

#include <openthread/dataset.h>

static void nrf_rpc_err_handler(const struct nrf_rpc_err_report *report)
{
	zassert_ok(report->code);
}

static void tc_setup(void *f)
{
	mock_nrf_rpc_tr_expect_add(RPC_INIT_REQ, RPC_INIT_RSP);
	zassert_ok(nrf_rpc_init(nrf_rpc_err_handler));
	mock_nrf_rpc_tr_expect_reset();
}

/* Test serialization of otDatasetIsCommissioned() */
ZTEST(ot_rpc_dataset, test_otDatasetIsCommissioned)
{
	bool result;

	mock_nrf_rpc_tr_expect_add(RPC_CMD(OT_RPC_CMD_DATASET_IS_COMMISSIONED), RPC_RSP(CBOR_TRUE));
	result = otDatasetIsCommissioned(NULL);
	mock_nrf_rpc_tr_expect_done();
	zassert_true(result);

	mock_nrf_rpc_tr_expect_add(RPC_CMD(OT_RPC_CMD_DATASET_IS_COMMISSIONED),
				   RPC_RSP(CBOR_FALSE));
	result = otDatasetIsCommissioned(NULL);
	mock_nrf_rpc_tr_expect_done();
	zassert_false(result);
}

/* Test serialization of otDatasetSetActiveTlvs() */
ZTEST(ot_rpc_dataset, test_otDatasetSetActiveTlvs)
{
	otError error;

	const otOperationalDatasetTlvs dataset = {{INT_SEQUENCE(OT_OPERATIONAL_DATASET_MAX_LENGTH)},
						  OT_OPERATIONAL_DATASET_MAX_LENGTH};

	mock_nrf_rpc_tr_expect_add(RPC_CMD(OT_RPC_CMD_DATASET_SET_ACTIVE_TLVS, TLVS),
				   RPC_RSP(OT_ERROR_NONE));
	error = otDatasetSetActiveTlvs(NULL, &dataset);
	mock_nrf_rpc_tr_expect_done();
	zassert_equal(error, OT_ERROR_NONE);
}

/* Test incoming parameters validation of otDatasetSetActiveTlvs() */
ZTEST(ot_rpc_dataset, test_otDatasetSetActiveTlvs_negative)
{
	otError error;
	const otOperationalDatasetTlvs dataset = {{0}, OT_OPERATIONAL_DATASET_MAX_LENGTH + 1};

	error = otDatasetSetActiveTlvs(NULL, &dataset);
	zassert_equal(error, OT_ERROR_INVALID_ARGS);
	error = otDatasetSetActiveTlvs(NULL, NULL);
	zassert_equal(error, OT_ERROR_INVALID_ARGS);
}

/* Test serialization of otDatasetGetActiveTlvs() */
ZTEST(ot_rpc_dataset, test_otDatasetGetActiveTlvs)
{
	otError error;
	otOperationalDatasetTlvs dataset;
	const otOperationalDatasetTlvs expected_dataset = {
		{INT_SEQUENCE(OT_OPERATIONAL_DATASET_MAX_LENGTH)},
		OT_OPERATIONAL_DATASET_MAX_LENGTH};

	mock_nrf_rpc_tr_expect_add(RPC_CMD(OT_RPC_CMD_DATASET_GET_ACTIVE_TLVS), RPC_RSP(TLVS));
	error = otDatasetGetActiveTlvs(NULL, &dataset);
	mock_nrf_rpc_tr_expect_done();
	zassert_equal(error, OT_ERROR_NONE);
	zassert_mem_equal(&dataset, &expected_dataset, sizeof(otOperationalDatasetTlvs));
}

/* Test NULL replay on otDatasetGetActiveTlvs() and parameter validation. */
ZTEST(ot_rpc_dataset, test_otDatasetGetActiveTlvs_null)
{
	otError error;
	otOperationalDatasetTlvs dataset;

	mock_nrf_rpc_tr_expect_add(RPC_CMD(OT_RPC_CMD_DATASET_GET_ACTIVE_TLVS), RPC_RSP(CBOR_NULL));
	error = otDatasetGetActiveTlvs(NULL, &dataset);
	mock_nrf_rpc_tr_expect_done();
	zassert_equal(error, OT_ERROR_NOT_FOUND);

	error = otDatasetGetActiveTlvs(NULL, NULL);
	zassert_equal(error, OT_ERROR_NOT_FOUND);
}

/* Test serialization of otDatasetSetActive() */
ZTEST(ot_rpc_dataset, test_otDatasetSetActive)
{
	otError error;

	const otOperationalDataset dataset = {
		{0x0123456789abcdefull, 0x1234, false},
		{0x0123456789abcdefull, 0x1234, false},
		{{INT_SEQUENCE(OT_NETWORK_KEY_SIZE)}},
		{{INT_SEQUENCE(OT_NETWORK_NAME_MAX_SIZE)}},
		{{INT_SEQUENCE(OT_EXT_PAN_ID_SIZE)}},
		{{INT_SEQUENCE(OT_IP6_PREFIX_SIZE)}},
		0x12345678ul,
		0xabcd,
		0xef67,
		{{INT_SEQUENCE(OT_PSKC_MAX_SIZE)}},
		{0x9876, 1, 0, 1, 0, 1, 0, 1, 0, 1, 7},
		0xfedcba98,
		{false, true, false, true, false, true, false, true, false, true, false, true}};

	mock_nrf_rpc_tr_expect_add(RPC_CMD(OT_RPC_CMD_DATASET_SET_ACTIVE, DATASET),
				   RPC_RSP(OT_ERROR_NONE));
	error = otDatasetSetActive(NULL, &dataset);
	mock_nrf_rpc_tr_expect_done();
	zassert_equal(error, OT_ERROR_NONE);
}

/* Test incoming parameters validation of otDatasetSetActive() */
ZTEST(ot_rpc_dataset, test_otDatasetSetActive_negative)
{
	otError error;

	error = otDatasetSetActive(NULL, NULL);
	zassert_equal(error, OT_ERROR_INVALID_ARGS);
}

/* Test serialization of otDatasetGetActive() */
ZTEST(ot_rpc_dataset, test_otDatasetGetActive)
{
	otError error;
	otOperationalDataset dataset;
	uint8_t net_key[] = {INT_SEQUENCE(OT_NETWORK_KEY_SIZE)};
	uint8_t nwk_name[] = {INT_SEQUENCE(OT_NETWORK_NAME_MAX_SIZE), 0};
	uint8_t ext_pan_id[] = {INT_SEQUENCE(OT_EXT_PAN_ID_SIZE)};
	uint8_t local_prefix[] = {INT_SEQUENCE(OT_IP6_PREFIX_SIZE)};
	uint8_t pskc[] = {INT_SEQUENCE(OT_PSKC_MAX_SIZE)};

	mock_nrf_rpc_tr_expect_add(RPC_CMD(OT_RPC_CMD_DATASET_GET_ACTIVE), RPC_RSP(DATASET));
	error = otDatasetGetActive(NULL, &dataset);
	mock_nrf_rpc_tr_expect_done();
	zassert_equal(error, OT_ERROR_NONE);
	zassert_equal(dataset.mActiveTimestamp.mSeconds, 0x0123456789abcdefull);
	zassert_equal(dataset.mActiveTimestamp.mTicks, 0x1234);
	zassert_false(dataset.mActiveTimestamp.mAuthoritative);

	zassert_equal(dataset.mPendingTimestamp.mSeconds, 0x0123456789abcdefull);
	zassert_equal(dataset.mPendingTimestamp.mTicks, 0x1234);
	zassert_false(dataset.mPendingTimestamp.mAuthoritative);

	zassert_mem_equal(dataset.mNetworkKey.m8, net_key, OT_NETWORK_KEY_SIZE);
	zassert_mem_equal(dataset.mNetworkName.m8, nwk_name, OT_NETWORK_NAME_MAX_SIZE + 1);
	zassert_mem_equal(dataset.mExtendedPanId.m8, ext_pan_id, OT_EXT_PAN_ID_SIZE);
	zassert_mem_equal(dataset.mMeshLocalPrefix.m8, local_prefix, OT_IP6_PREFIX_SIZE);
	zassert_equal(dataset.mDelay, 0x12345678ul);
	zassert_equal(dataset.mPanId, 0xabcd);
	zassert_equal(dataset.mChannel, 0xef67);
	zassert_mem_equal(dataset.mPskc.m8, pskc, OT_PSKC_MAX_SIZE);

	zassert_equal(dataset.mSecurityPolicy.mRotationTime, 0x9876);
	zassert_true(!!dataset.mSecurityPolicy.mObtainNetworkKeyEnabled);
	zassert_false(!!dataset.mSecurityPolicy.mNativeCommissioningEnabled);
	zassert_true(!!dataset.mSecurityPolicy.mRoutersEnabled);
	zassert_false(!!dataset.mSecurityPolicy.mExternalCommissioningEnabled);
	zassert_true(!!dataset.mSecurityPolicy.mCommercialCommissioningEnabled);
	zassert_false(!!dataset.mSecurityPolicy.mAutonomousEnrollmentEnabled);
	zassert_true(!!dataset.mSecurityPolicy.mNetworkKeyProvisioningEnabled);
	zassert_false(!!dataset.mSecurityPolicy.mTobleLinkEnabled);
	zassert_true(!!dataset.mSecurityPolicy.mNonCcmRoutersEnabled);
	zassert_equal(dataset.mSecurityPolicy.mVersionThresholdForRouting, 7);

	zassert_equal(dataset.mChannelMask, 0xfedcba98ul);

	zassert_false(dataset.mComponents.mIsActiveTimestampPresent);
	zassert_true(dataset.mComponents.mIsPendingTimestampPresent);
	zassert_false(dataset.mComponents.mIsNetworkKeyPresent);
	zassert_true(dataset.mComponents.mIsNetworkNamePresent);
	zassert_false(dataset.mComponents.mIsExtendedPanIdPresent);
	zassert_true(dataset.mComponents.mIsMeshLocalPrefixPresent);
	zassert_false(dataset.mComponents.mIsDelayPresent);
	zassert_true(dataset.mComponents.mIsPanIdPresent);
	zassert_false(dataset.mComponents.mIsChannelPresent);
	zassert_true(dataset.mComponents.mIsPskcPresent);
	zassert_false(dataset.mComponents.mIsSecurityPolicyPresent);
	zassert_true(dataset.mComponents.mIsChannelMaskPresent);
}

/* Test NULL replay on otDatasetGetActive() and parameter validation. */
ZTEST(ot_rpc_dataset, test_otDatasetGetActive_null)
{
	otError error;
	otOperationalDataset dataset;

	mock_nrf_rpc_tr_expect_add(RPC_CMD(OT_RPC_CMD_DATASET_GET_ACTIVE), RPC_RSP(CBOR_NULL));
	error = otDatasetGetActive(NULL, &dataset);
	mock_nrf_rpc_tr_expect_done();
	zassert_equal(error, OT_ERROR_NOT_FOUND);

	error = otDatasetGetActive(NULL, NULL);
	zassert_equal(error, OT_ERROR_NOT_FOUND);
}

ZTEST_SUITE(ot_rpc_dataset, NULL, NULL, tc_setup, NULL, NULL);
```

## src/instance_suite.c
```c
/*
 * Copyright (c) 2024 Nordic Semiconductor ASA
 *
 * SPDX-License-Identifier: LicenseRef-Nordic-5-Clause
 */

#include <mock_nrf_rpc_transport.h>
#include <ot_rpc_ids.h>
#include <test_rpc_env.h>

#include <zephyr/ztest.h>
#include <zephyr/kernel.h>

#include <openthread/instance.h>

/* Instance address used when testing serialization of a function that takes otInstance* */
#define INSTANCE_ADDR UINT32_MAX

static void nrf_rpc_err_handler(const struct nrf_rpc_err_report *report)
{
	zassert_ok(report->code);
}

static void tc_setup(void *f)
{
	mock_nrf_rpc_tr_expect_add(RPC_INIT_REQ, RPC_INIT_RSP);
	zassert_ok(nrf_rpc_init(nrf_rpc_err_handler));
	mock_nrf_rpc_tr_expect_reset();
}

/* Test serialization of otInstanceInitSingle() returning 0 */
ZTEST(ot_rpc_instance, test_otInstanceInitSingle_0)
{
	otInstance *instance;

	mock_nrf_rpc_tr_expect_add(RPC_CMD(OT_RPC_CMD_INSTANCE_INIT_SINGLE), RPC_RSP(0));
	instance = otInstanceInitSingle();
	mock_nrf_rpc_tr_expect_done();

	zassert_equal(instance, NULL);
}

/* Test serialization of otInstanceInitSingle() returning max allowed 0xffffffff */
ZTEST(ot_rpc_instance, test_otInstanceInitSingle_max)
{
	otInstance *instance;

	mock_nrf_rpc_tr_expect_add(RPC_CMD(OT_RPC_CMD_INSTANCE_INIT_SINGLE),
				   RPC_RSP(CBOR_UINT32(UINT32_MAX)));
	instance = otInstanceInitSingle();
	mock_nrf_rpc_tr_expect_done();

	zassert_equal(instance, (void *)UINT32_MAX);
}

/* Test serialization of otInstanceGetId() returning 0 */
ZTEST(ot_rpc_instance, test_otInstanceGetId_0)
{
	otInstance *instance = (otInstance *)INSTANCE_ADDR;
	uint32_t id;

	mock_nrf_rpc_tr_expect_add(RPC_CMD(OT_RPC_CMD_INSTANCE_GET_ID, CBOR_UINT32(INSTANCE_ADDR)),
				   RPC_RSP(0));
	id = otInstanceGetId(instance);
	mock_nrf_rpc_tr_expect_done();

	zassert_equal(id, 0);
}

/* Test serialization of otInstanceGetId() returning max allowed UINT32_MAX */
ZTEST(ot_rpc_instance, test_otInstanceGetId_max)
{
	otInstance *instance = (otInstance *)INSTANCE_ADDR;
	uint32_t id;

	mock_nrf_rpc_tr_expect_add(RPC_CMD(OT_RPC_CMD_INSTANCE_GET_ID, CBOR_UINT32(INSTANCE_ADDR)),
				   RPC_RSP(CBOR_UINT32(UINT32_MAX)));
	id = otInstanceGetId(instance);
	mock_nrf_rpc_tr_expect_done();

	zassert_equal(id, UINT32_MAX);
}

/* Test serialization of otInstanceIsInitialized() returning false */
ZTEST(ot_rpc_instance, test_otInstanceIsInitialized_false)
{
	otInstance *instance = (otInstance *)INSTANCE_ADDR;
	bool initialized;

	mock_nrf_rpc_tr_expect_add(
		RPC_CMD(OT_RPC_CMD_INSTANCE_IS_INITIALIZED, CBOR_UINT32(INSTANCE_ADDR)),
		RPC_RSP(CBOR_FALSE));
	initialized = otInstanceIsInitialized(instance);
	mock_nrf_rpc_tr_expect_done();

	zassert_false(initialized);
}

/* Test serialization of otInstanceIsInitialized() returning true */
ZTEST(ot_rpc_instance, test_otInstanceIsInitialized_true)
{
	otInstance *instance = (otInstance *)INSTANCE_ADDR;
	bool initialized;

	mock_nrf_rpc_tr_expect_add(
		RPC_CMD(OT_RPC_CMD_INSTANCE_IS_INITIALIZED, CBOR_UINT32(INSTANCE_ADDR)),
		RPC_RSP(CBOR_TRUE));
	initialized = otInstanceIsInitialized(instance);
	mock_nrf_rpc_tr_expect_done();

	zassert_true(initialized);
}

/* Test serialization of otInstanceFinalize() */
ZTEST(ot_rpc_instance, test_otInstanceFinalize)
{
	otInstance *instance = (otInstance *)INSTANCE_ADDR;

	mock_nrf_rpc_tr_expect_add(
		RPC_CMD(OT_RPC_CMD_INSTANCE_FINALIZE, CBOR_UINT32(INSTANCE_ADDR)), RPC_RSP());
	otInstanceFinalize(instance);
	mock_nrf_rpc_tr_expect_done();
}

/* Test serialization of otInstanceErasePersistentInfo() returning success */
ZTEST(ot_rpc_instance, test_otInstanceErasePersistentInfo_ok)
{
	otInstance *instance = (otInstance *)INSTANCE_ADDR;
	otError error;

	mock_nrf_rpc_tr_expect_add(
		RPC_CMD(OT_RPC_CMD_INSTANCE_ERASE_PERSISTENT_INFO, CBOR_UINT32(INSTANCE_ADDR)),
		RPC_RSP(OT_ERROR_NONE));
	error = otInstanceErasePersistentInfo(instance);
	mock_nrf_rpc_tr_expect_done();

	zassert_equal(error, OT_ERROR_NONE);
}

/* Test serialization of otInstanceErasePersistentInfo() returning error */
ZTEST(ot_rpc_instance, test_otInstanceErasePersistentInfo_error)
{
	otInstance *instance = (otInstance *)INSTANCE_ADDR;
	otError error;

	mock_nrf_rpc_tr_expect_add(
		RPC_CMD(OT_RPC_CMD_INSTANCE_ERASE_PERSISTENT_INFO, CBOR_UINT32(INSTANCE_ADDR)),
		RPC_RSP(OT_ERROR_INVALID_STATE));
	error = otInstanceErasePersistentInfo(instance);
	mock_nrf_rpc_tr_expect_done();

	zassert_equal(error, OT_ERROR_INVALID_STATE);
}

/* Test serialization of otGetVersionString() */
ZTEST(ot_rpc_instance, test_otGetVersionString)
{
	const char exp_version[] = {VERSION_STR, '\0'};
	const char *version;

	mock_nrf_rpc_tr_expect_add(RPC_CMD(OT_RPC_CMD_GET_VERSION_STRING),
				   RPC_RSP(0x58, 64, VERSION_STR));
	version = otGetVersionString();
	mock_nrf_rpc_tr_expect_done();

	zassert_str_equal(version, exp_version);
}

ZTEST_SUITE(ot_rpc_instance, NULL, NULL, tc_setup, NULL, NULL);
```

## src/ip6_suite.c
```c
/*
 * Copyright (c) 2024 Nordic Semiconductor ASA
 *
 * SPDX-License-Identifier: LicenseRef-Nordic-5-Clause
 */

#include <mock_nrf_rpc_transport.h>
#include <ot_rpc_ids.h>
#include <ot_rpc_types.h>
#include <test_rpc_env.h>

#include <zephyr/ztest.h>
#include <zephyr/kernel.h>

#include <openthread/ip6.h>

static void nrf_rpc_err_handler(const struct nrf_rpc_err_report *report)
{
	zassert_ok(report->code);
}

static void tc_setup(void *f)
{
	mock_nrf_rpc_tr_expect_add(RPC_INIT_REQ, RPC_INIT_RSP);
	zassert_ok(nrf_rpc_init(nrf_rpc_err_handler));
	mock_nrf_rpc_tr_expect_reset();
}

/* Test serialization of otIp6SetEnabled(false) */
ZTEST(ot_rpc_ip6, test_otIp6SetEnabled_false)
{
	otError error;

	mock_nrf_rpc_tr_expect_add(RPC_CMD(OT_RPC_CMD_IP6_SET_ENABLED, CBOR_FALSE), RPC_RSP(0x00));
	error = otIp6SetEnabled(NULL, false);
	mock_nrf_rpc_tr_expect_done();
	zassert_equal(error, OT_ERROR_NONE);
}

/* Test serialization of otIp6SetEnabled(true) */
ZTEST(ot_rpc_ip6, test_otIp6SetEnabled_true)
{
	otError error;

	mock_nrf_rpc_tr_expect_add(RPC_CMD(OT_RPC_CMD_IP6_SET_ENABLED, CBOR_TRUE), RPC_RSP(0x00));
	error = otIp6SetEnabled(NULL, true);
	mock_nrf_rpc_tr_expect_done();
	zassert_equal(error, OT_ERROR_NONE);
}

/* Test serialization of failed otIp6SetEnabled(true) */
ZTEST(ot_rpc_ip6, test_otIp6SetEnabled_true_failed)
{
	otError error;

	mock_nrf_rpc_tr_expect_add(RPC_CMD(OT_RPC_CMD_IP6_SET_ENABLED, CBOR_TRUE), RPC_RSP(0x01));
	error = otIp6SetEnabled(NULL, true);
	mock_nrf_rpc_tr_expect_done();
	zassert_equal(error, OT_ERROR_FAILED);
}

/* Test serialization of otIp6IsEnabled returning false */
ZTEST(ot_rpc_ip6, test_otIp6IsEnabled_false)
{
	bool enabled;

	mock_nrf_rpc_tr_expect_add(RPC_CMD(OT_RPC_CMD_IP6_IS_ENABLED), RPC_RSP(CBOR_FALSE));
	enabled = otIp6IsEnabled(NULL);
	mock_nrf_rpc_tr_expect_done();
	zassert_false(enabled);
}

/* Test serialization of otIp6IsEnabled returning true */
ZTEST(ot_rpc_ip6, test_otIp6IsEnabled_true)
{
	bool enabled;

	mock_nrf_rpc_tr_expect_add(RPC_CMD(OT_RPC_CMD_IP6_IS_ENABLED), RPC_RSP(CBOR_TRUE));
	enabled = otIp6IsEnabled(NULL);
	mock_nrf_rpc_tr_expect_done();
	zassert_true(enabled);
}

/* Test serialization of otIp6SubscribeMulticastAddress(ff02::1) */
ZTEST(ot_rpc_ip6, test_otIp6SubscribeMulticastAddress)
{
	otError error;
	otIp6Address addr = {.mFields.m8 = {MADDR_FF02_1}};

	mock_nrf_rpc_tr_expect_add(RPC_CMD(OT_RPC_CMD_IP6_SUBSCRIBE_MADDR, 0x50, MADDR_FF02_1),
				   RPC_RSP(0x00));
	error = otIp6SubscribeMulticastAddress(NULL, &addr);
	mock_nrf_rpc_tr_expect_done();
	zassert_equal(error, OT_ERROR_NONE);
}

/* Test serialization of failed otIp6SubscribeMulticastAddress(ff02::1) */
ZTEST(ot_rpc_ip6, test_otIp6SubscribeMulticastAddress_failed)
{
	otError error;
	otIp6Address addr = {.mFields.m8 = {MADDR_FF02_1}};

	mock_nrf_rpc_tr_expect_add(RPC_CMD(OT_RPC_CMD_IP6_SUBSCRIBE_MADDR, 0x50, MADDR_FF02_1),
				   RPC_RSP(0x01));
	error = otIp6SubscribeMulticastAddress(NULL, &addr);
	mock_nrf_rpc_tr_expect_done();
	zassert_equal(error, OT_ERROR_FAILED);
}

/* Test serialization of otIp6UnsubscribeMulticastAddress(ff02::1) */
ZTEST(ot_rpc_ip6, test_otIp6UnsubscribeMulticastAddress)
{
	otError error;
	otIp6Address addr = {.mFields.m8 = {MADDR_FF02_1}};

	mock_nrf_rpc_tr_expect_add(RPC_CMD(OT_RPC_CMD_IP6_UNSUBSCRIBE_MADDR, 0x50, MADDR_FF02_1),
				   RPC_RSP(0x00));
	error = otIp6UnsubscribeMulticastAddress(NULL, &addr);
	mock_nrf_rpc_tr_expect_done();
	zassert_equal(error, OT_ERROR_NONE);
}

/* Test serialization of failed otIp6UnsubscribeMulticastAddress(ff02::1) */
ZTEST(ot_rpc_ip6, test_otIp6UnsubscribeMulticastAddress_failed)
{
	otError error;
	otIp6Address addr = {.mFields.m8 = {MADDR_FF02_1}};

	mock_nrf_rpc_tr_expect_add(RPC_CMD(OT_RPC_CMD_IP6_UNSUBSCRIBE_MADDR, 0x50, MADDR_FF02_1),
				   RPC_RSP(0x01));
	error = otIp6UnsubscribeMulticastAddress(NULL, &addr);
	mock_nrf_rpc_tr_expect_done();
	zassert_equal(error, OT_ERROR_FAILED);
}

/* Test serialization of otIp6GetUnicastAddresses() */
ZTEST(ot_rpc_ip6, test_otIp6GetUnicastAddresses)
{
	const otIp6Address exp_addr1 = {.mFields.m8 = {ADDR_1}};
	const otIp6Address exp_addr2 = {.mFields.m8 = {ADDR_2}};
	const uint16_t exp_flags1 = BIT(OT_RPC_NETIF_ADDRESS_PREFERRED_OFFSET) |
				    BIT(OT_RPC_NETIF_ADDRESS_VALID_OFFSET) |
				    BIT(OT_RPC_NETIF_ADDRESS_RLOC_OFFSET) |
				    BIT(OT_RPC_NETIF_ADDRESS_MESH_LOCAL_OFFSET);
	const uint16_t exp_flags2 = BIT(OT_RPC_NETIF_ADDRESS_SCOPE_VALID_OFFSET) |
				    (ADDR_SCOPE << OT_RPC_NETIF_ADDRESS_SCOPE_OFFSET);

	const otNetifAddress *addr;

	mock_nrf_rpc_tr_expect_add(RPC_CMD(OT_RPC_CMD_IP6_GET_UNICAST_ADDRESSES),
				   RPC_RSP(0x9f, 0x50, ADDR_1, CBOR_UINT8(ADDR_PREFIX_LENGTH),
					   OT_ADDRESS_ORIGIN_MANUAL, CBOR_UINT16(exp_flags1), 0xff,
					   0x9f, 0x50, ADDR_2, CBOR_UINT8(ADDR_PREFIX_LENGTH),
					   OT_ADDRESS_ORIGIN_DHCPV6, CBOR_UINT16(exp_flags2),
					   0xff));
	addr = otIp6GetUnicastAddresses(NULL);
	mock_nrf_rpc_tr_expect_done();

	zassert_not_null(addr);
	zassert_mem_equal(&addr->mAddress, &exp_addr1, OT_IP6_ADDRESS_SIZE);
	zassert_equal(addr->mPrefixLength, ADDR_PREFIX_LENGTH);
	zassert_equal(addr->mAddressOrigin, OT_ADDRESS_ORIGIN_MANUAL);
	zassert_true(addr->mPreferred);
	zassert_true(addr->mValid);
	zassert_false(addr->mScopeOverrideValid);
	zassert_true(addr->mRloc);
	zassert_true(addr->mMeshLocal);
	addr = addr->mNext;

	zassert_not_null(addr);
	zassert_mem_equal(&addr->mAddress, &exp_addr2, OT_IP6_ADDRESS_SIZE);
	zassert_equal(addr->mPrefixLength, ADDR_PREFIX_LENGTH);
	zassert_equal(addr->mAddressOrigin, OT_ADDRESS_ORIGIN_DHCPV6);
	zassert_false(addr->mPreferred);
	zassert_false(addr->mValid);
	zassert_true(addr->mScopeOverrideValid);
	zassert_equal(addr->mScopeOverride, ADDR_SCOPE);
	zassert_false(addr->mRloc);
	zassert_false(addr->mMeshLocal);
	addr = addr->mNext;

	zassert_is_null(addr);
}

/* Test serialization of otIp6GetMulticastAddresses() */
ZTEST(ot_rpc_ip6, test_otIp6GetMulticastAddresses)
{
	const otIp6Address exp_addr1 = {.mFields.m8 = {MADDR_FF02_1}};
	const otIp6Address exp_addr2 = {.mFields.m8 = {MADDR_FF02_2}};

	const otNetifMulticastAddress *maddr;

	mock_nrf_rpc_tr_expect_add(RPC_CMD(OT_RPC_CMD_IP6_GET_MULTICAST_ADDRESSES),
				   RPC_RSP(0x50, MADDR_FF02_1, 0x50, MADDR_FF02_2));
	maddr = otIp6GetMulticastAddresses(NULL);
	mock_nrf_rpc_tr_expect_done();

	zassert_not_null(maddr);
	zassert_mem_equal(&maddr->mAddress, &exp_addr1, OT_IP6_ADDRESS_SIZE);
	maddr = maddr->mNext;

	zassert_not_null(maddr);
	zassert_mem_equal(&maddr->mAddress, &exp_addr2, OT_IP6_ADDRESS_SIZE);
	maddr = maddr->mNext;

	zassert_is_null(maddr);
}

ZTEST_SUITE(ot_rpc_ip6, NULL, NULL, tc_setup, NULL, NULL);
```

## src/link_suite.c
```c
/*
 * Copyright (c) 2024 Nordic Semiconductor ASA
 *
 * SPDX-License-Identifier: LicenseRef-Nordic-5-Clause
 */

#include <mock_nrf_rpc_transport.h>
#include <ot_rpc_ids.h>
#include <test_rpc_env.h>

#include <zephyr/ztest.h>
#include <zephyr/kernel.h>

#include <openthread/link.h>

static void nrf_rpc_err_handler(const struct nrf_rpc_err_report *report)
{
	zassert_ok(report->code);
}

static void tc_setup(void *f)
{
	mock_nrf_rpc_tr_expect_add(RPC_INIT_REQ, RPC_INIT_RSP);
	zassert_ok(nrf_rpc_init(nrf_rpc_err_handler));
	mock_nrf_rpc_tr_expect_reset();
}

/* Test serialization of failed otLinkSetPollPeriod(rdn) */
ZTEST(ot_rpc_link, test_otLinkSetPollPeriod_0)
{
	otError error;

	mock_nrf_rpc_tr_expect_add(RPC_CMD(OT_RPC_CMD_LINK_SET_POLL_PERIOD, 0x00), RPC_RSP(0x07));
	error = otLinkSetPollPeriod(NULL, 0);
	mock_nrf_rpc_tr_expect_done();
	zassert_equal(error, OT_ERROR_INVALID_ARGS);
}

/* Test serialization of max allowed otLinkSetPollPeriod(0x3ffffff) */
ZTEST(ot_rpc_link, test_otLinkSetPollPeriod_max)
{
	otError error;

	mock_nrf_rpc_tr_expect_add(
		RPC_CMD(OT_RPC_CMD_LINK_SET_POLL_PERIOD, 0x1a, 0x03, 0xff, 0xff, 0xff),
		RPC_RSP(0x00));
	error = otLinkSetPollPeriod(NULL, 0x3ffffff);
	mock_nrf_rpc_tr_expect_done();
	zassert_equal(error, OT_ERROR_NONE);
}

/* Test serialization of otLinkGetPollPeriod() returning min allowed 10 */
ZTEST(ot_rpc_link, test_otLinkGetPollPeriod_min)
{
	uint32_t period;

	mock_nrf_rpc_tr_expect_add(RPC_CMD(OT_RPC_CMD_LINK_GET_POLL_PERIOD), RPC_RSP(0x0a));
	period = otLinkGetPollPeriod(NULL);
	mock_nrf_rpc_tr_expect_done();
	zassert_equal(period, 10);
}

/* Test serialization of otLinkGetPollPeriod() returning max allowed 0x3ffffff */
ZTEST(ot_rpc_link, test_otLinkGetPollPeriod_max)
{
	uint32_t period;

	mock_nrf_rpc_tr_expect_add(RPC_CMD(OT_RPC_CMD_LINK_GET_POLL_PERIOD),
				   RPC_RSP(0x1a, 0x03, 0xff, 0xff, 0xff));
	period = otLinkGetPollPeriod(NULL);
	mock_nrf_rpc_tr_expect_done();
	zassert_equal(period, 0x3ffffff);
}

/* Test serialization of otLinkSetMaxFrameRetriesDirect() */
ZTEST(ot_rpc_link, test_otLinkSetMaxFrameRetriesDirect)
{
	mock_nrf_rpc_tr_expect_add(
		RPC_CMD(OT_RPC_CMD_LINK_SET_MAX_FRAME_RETRIES_DIRECT, CBOR_UINT8(0x55)), RPC_RSP());
	otLinkSetMaxFrameRetriesDirect(NULL, 0x55);
	mock_nrf_rpc_tr_expect_done();
}

/* Test serialization of otLinkSetMaxFrameRetriesIndirect() */
ZTEST(ot_rpc_link, test_otLinkSetMaxFrameRetriesIndirect)
{
	mock_nrf_rpc_tr_expect_add(
		RPC_CMD(OT_RPC_CMD_LINK_SET_MAX_FRAME_RETRIES_INDIRECT, CBOR_UINT8(0xAA)),
		RPC_RSP());
	otLinkSetMaxFrameRetriesIndirect(NULL, 0xAA);
	mock_nrf_rpc_tr_expect_done();
}

/* Test serialization of otLinkSetEnabled() */
ZTEST(ot_rpc_link, test_otLinkSetEnabled)
{
	otError error;

	mock_nrf_rpc_tr_expect_add(RPC_CMD(OT_RPC_CMD_LINK_SET_ENABLED, CBOR_TRUE),
				   RPC_RSP(OT_ERROR_NONE));
	error = otLinkSetEnabled(NULL, true);
	mock_nrf_rpc_tr_expect_done();
	zassert_equal(error, OT_ERROR_NONE);
}

/* Test serialization of otLinkGetFactoryAssignedIeeeEui64() */
ZTEST(ot_rpc_link, test_otLinkGetFactoryAssignedIeeeEui64)
{
	otExtAddress ext_addr;
	otExtAddress expected_ext_addr = {{INT_SEQUENCE(OT_EXT_ADDRESS_SIZE)}};

	mock_nrf_rpc_tr_expect_add(RPC_CMD(OT_RPC_CMD_LINK_GET_FACTORY_ASSIGNED_EUI64),
				   RPC_RSP(EXT_ADDR));
	otLinkGetFactoryAssignedIeeeEui64(NULL, &ext_addr);
	mock_nrf_rpc_tr_expect_done();
	zassert_mem_equal(expected_ext_addr.m8, ext_addr.m8, OT_EXT_ADDRESS_SIZE);
}

/* Test serialization of otLinkGetChannel() */
ZTEST(ot_rpc_link, test_otLinkGetChannel)
{
	uint8_t channel;

	mock_nrf_rpc_tr_expect_add(RPC_CMD(OT_RPC_CMD_LINK_GET_CHANNEL),
				   RPC_RSP(CBOR_UINT8(UINT8_MAX)));
	channel = otLinkGetChannel(NULL);
	mock_nrf_rpc_tr_expect_done();

	zassert_equal(channel, UINT8_MAX);
}

/* Test serialization of otLinkGetExtendedAddress() */
ZTEST(ot_rpc_link, test_otLinkGetExtendedAddress)
{
	const otExtAddress exp_extaddr = {{INT_SEQUENCE(OT_EXT_ADDRESS_SIZE)}};
	const otExtAddress *extaddr;

	mock_nrf_rpc_tr_expect_add(RPC_CMD(OT_RPC_CMD_LINK_GET_EXTENDED_ADDRESS),
				   RPC_RSP(EXT_ADDR));
	extaddr = otLinkGetExtendedAddress(NULL);
	mock_nrf_rpc_tr_expect_done();

	zassert_mem_equal(extaddr, &exp_extaddr, OT_EXT_ADDRESS_SIZE);
}

/* Test serialization of otLinkGetPanId() */
ZTEST(ot_rpc_link, test_otLinkGetPanId)
{
	otPanId panid;

	mock_nrf_rpc_tr_expect_add(RPC_CMD(OT_RPC_CMD_LINK_GET_PAN_ID),
				   RPC_RSP(CBOR_UINT16(UINT16_MAX)));
	panid = otLinkGetPanId(NULL);
	mock_nrf_rpc_tr_expect_done();

	zassert_equal(panid, UINT16_MAX);
}

ZTEST_SUITE(ot_rpc_link, NULL, NULL, tc_setup, NULL, NULL);
```

## src/thread_suite.c
```c
/*
 * Copyright (c) 2024 Nordic Semiconductor ASA
 *
 * SPDX-License-Identifier: LicenseRef-Nordic-5-Clause
 */

#include <mock_nrf_rpc_transport.h>
#include <nrf_rpc/nrf_rpc_cbkproxy.h>
#include <ot_rpc_ids.h>
#include <test_rpc_env.h>

#include <zephyr/ztest.h>
#include <zephyr/kernel.h>

#include <openthread/thread.h>

static int slot_cnt;
static bool cb_called;

static void nrf_rpc_err_handler(const struct nrf_rpc_err_report *report)
{
	zassert_ok(report->code);
}

static void tc_setup(void *f)
{
	mock_nrf_rpc_tr_expect_add(RPC_INIT_REQ, RPC_INIT_RSP);
	zassert_ok(nrf_rpc_init(nrf_rpc_err_handler));
	mock_nrf_rpc_tr_expect_reset();
}

/* Test serialization of otThreadDiscover() */
ZTEST(ot_rpc_thread, test_otThreadDiscover)
{
	otError error;
	uint32_t scan_channels = 0x7fff800;
	uint16_t pan_id = 0x4321;
	bool joiner = false;
	bool enable_eui64_filtering = true;
	otHandleActiveScanResult cb = (otHandleActiveScanResult)0xdeadbeef;
	void *cb_ctx = (void *)0xcafeface;

	mock_nrf_rpc_tr_expect_add(RPC_CMD(OT_RPC_CMD_THREAD_DISCOVER, CBOR_UINT32(0x7fff800),
					   CBOR_UINT16(0x4321), CBOR_FALSE, CBOR_TRUE, slot_cnt,
					   CBOR_UINT32(0xcafeface)),
				   RPC_RSP(OT_ERROR_NONE));
	error = otThreadDiscover(NULL, scan_channels, pan_id, joiner, enable_eui64_filtering, cb,
				 cb_ctx);
	mock_nrf_rpc_tr_expect_done();
	zassert_equal(error, OT_ERROR_NONE);
}

static void discover_cb(otActiveScanResult *result, void *ctx)
{
	uint8_t ext_addr[] = {INT_SEQUENCE(OT_EXT_ADDRESS_SIZE)};
	uint8_t nwk_name[] = {INT_SEQUENCE(OT_NETWORK_NAME_MAX_SIZE), 0};
	uint8_t ext_pan_id[] = {INT_SEQUENCE(OT_EXT_PAN_ID_SIZE)};
	uint8_t steer_data[] = {INT_SEQUENCE(OT_STEERING_DATA_MAX_LENGTH)};

	cb_called = true;
	zassert_not_null(result);
	zassert_not_null(ctx);
	zassert_mem_equal(result->mExtAddress.m8, ext_addr, OT_EXT_ADDRESS_SIZE);
	zassert_mem_equal(result->mNetworkName.m8, nwk_name, OT_NETWORK_NAME_MAX_SIZE + 1);
	zassert_mem_equal(result->mExtendedPanId.m8, ext_pan_id, OT_EXT_PAN_ID_SIZE);
	zassert_mem_equal(result->mSteeringData.m8, steer_data, OT_STEERING_DATA_MAX_LENGTH);
	zassert_equal(result->mPanId, 0x1234);
	zassert_equal(result->mJoinerUdpPort, 0x4321);
	zassert_equal(result->mChannel, 0x22);
	zassert_equal(result->mRssi, 0x33);
	zassert_equal(result->mLqi, 0x44);
	zassert_equal(result->mVersion, 0x0f);
	zassert_false(!!result->mIsNative);
	zassert_true(!!result->mDiscover);
	zassert_false(!!result->mIsJoinable);
	zassert_equal_ptr(ctx, (void *)0xdeadbeef);
}

/* Test reception of discover callback with active scan result. */
ZTEST(ot_rpc_dataset, test_discover_cb_handler)
{

	int in_slot = nrf_rpc_cbkproxy_in_set(discover_cb);

	slot_cnt++;
	cb_called = false;
	mock_nrf_rpc_tr_expect_add(RPC_RSP(), NO_RSP);
	mock_nrf_rpc_tr_receive(RPC_CMD(OT_RPC_CMD_THREAD_DISCOVER_CB, EXT_ADDR, NWK_NAME,
					EXT_PAN_ID, STEERING_DATA, CBOR_UINT16(0x1234),
					CBOR_UINT16(0x4321), CBOR_UINT8(0x22), CBOR_UINT8(0x33),
					CBOR_UINT8(0x44), 0x0f, CBOR_FALSE, CBOR_TRUE, CBOR_FALSE,
					CBOR_UINT32(0xdeadbeef), in_slot));
	mock_nrf_rpc_tr_expect_done();

	zassert_true(cb_called);
}

static void discover_empty_cb(otActiveScanResult *result, void *ctx)
{
	cb_called = true;
	zassert_is_null(result);
	zassert_not_null(ctx);
	zassert_equal_ptr(ctx, (void *)0xdeadbeef);
}

/* Test reception of discover callback with empty active scan result. */
ZTEST(ot_rpc_dataset, test_discover_cb_handler_empty)
{

	int in_slot = nrf_rpc_cbkproxy_in_set(discover_empty_cb);

	slot_cnt++;
	cb_called = false;
	mock_nrf_rpc_tr_expect_add(RPC_RSP(), NO_RSP);
	mock_nrf_rpc_tr_receive(RPC_CMD(OT_RPC_CMD_THREAD_DISCOVER_CB, CBOR_NULL,
					CBOR_UINT32(0xdeadbeef), in_slot));
	mock_nrf_rpc_tr_expect_done();

	zassert_true(cb_called);
}

/* Test serialization of otThreadSetEnabled(false) */
ZTEST(ot_rpc_thread, test_otThreadSetEnabled_false)
{
	otError error;

	mock_nrf_rpc_tr_expect_add(RPC_CMD(OT_RPC_CMD_THREAD_SET_ENABLED, CBOR_FALSE),
				   RPC_RSP(0x00));
	error = otThreadSetEnabled(NULL, false);
	mock_nrf_rpc_tr_expect_done();
	zassert_equal(error, OT_ERROR_NONE);
}

/* Test serialization of otThreadSetEnabled(true) */
ZTEST(ot_rpc_thread, test_otThreadSetEnabled_true)
{
	otError error;

	mock_nrf_rpc_tr_expect_add(RPC_CMD(OT_RPC_CMD_THREAD_SET_ENABLED, CBOR_TRUE),
				   RPC_RSP(0x00));
	error = otThreadSetEnabled(NULL, true);
	mock_nrf_rpc_tr_expect_done();
	zassert_equal(error, OT_ERROR_NONE);
}

/* Test serialization of failed otThreadSetEnabled(true) */
ZTEST(ot_rpc_thread, test_otThreadSetEnabled_true_failed)
{
	otError error;

	mock_nrf_rpc_tr_expect_add(RPC_CMD(OT_RPC_CMD_THREAD_SET_ENABLED, CBOR_TRUE),
				   RPC_RSP(0x01));
	error = otThreadSetEnabled(NULL, true);
	mock_nrf_rpc_tr_expect_done();
	zassert_equal(error, OT_ERROR_FAILED);
}

/* Test serialization of otThreadGetDeviceRole() returning 'disabled' */
ZTEST(ot_rpc_thread, test_otThreadGetDeviceRole_disabled)
{
	otDeviceRole role;

	mock_nrf_rpc_tr_expect_add(RPC_CMD(OT_RPC_CMD_THREAD_GET_DEVICE_ROLE), RPC_RSP(0x00));
	role = otThreadGetDeviceRole(NULL);
	mock_nrf_rpc_tr_expect_done();
	zassert_equal(role, OT_DEVICE_ROLE_DISABLED);
}

/* Test serialization of otThreadGetDeviceRole() returning 'leader' */
ZTEST(ot_rpc_thread, test_otThreadGetDeviceRole_leader)
{
	otDeviceRole role;

	mock_nrf_rpc_tr_expect_add(RPC_CMD(OT_RPC_CMD_THREAD_GET_DEVICE_ROLE), RPC_RSP(0x04));
	role = otThreadGetDeviceRole(NULL);
	mock_nrf_rpc_tr_expect_done();
	zassert_equal(role, OT_DEVICE_ROLE_LEADER);
}

/* Test serialization of otThreadSetLinkMode(-) */
ZTEST(ot_rpc_thread, test_otThreadSetLinkMode_none)
{
	otError error;
	otLinkModeConfig mode;

	memset(&mode, 0, sizeof(mode));

	mock_nrf_rpc_tr_expect_add(RPC_CMD(OT_RPC_CMD_THREAD_SET_LINK_MODE, 0x00), RPC_RSP(0x00));
	error = otThreadSetLinkMode(NULL, mode);
	mock_nrf_rpc_tr_expect_done();
	zassert_equal(error, OT_ERROR_NONE);
}

/* Test serialization of otThreadSetLinkMode(rdn) */
ZTEST(ot_rpc_thread, test_otThreadSetLinkMode_rdn)
{
	otError error;
	otLinkModeConfig mode;

	memset(&mode, 0, sizeof(mode));
	mode.mRxOnWhenIdle = true;
	mode.mDeviceType = true;
	mode.mNetworkData = true;

	mock_nrf_rpc_tr_expect_add(RPC_CMD(OT_RPC_CMD_THREAD_SET_LINK_MODE, 0x07), RPC_RSP(0x00));
	error = otThreadSetLinkMode(NULL, mode);
	mock_nrf_rpc_tr_expect_done();
	zassert_equal(error, OT_ERROR_NONE);
}

/* Test serialization of failed otThreadSetLinkMode(n) */
ZTEST(ot_rpc_thread, test_otThreadSetLinkMode_n)
{
	otError error;
	otLinkModeConfig mode;

	memset(&mode, 0, sizeof(mode));
	mode.mNetworkData = true;

	mock_nrf_rpc_tr_expect_add(RPC_CMD(OT_RPC_CMD_THREAD_SET_LINK_MODE, 0x04), RPC_RSP(0x07));
	error = otThreadSetLinkMode(NULL, mode);
	mock_nrf_rpc_tr_expect_done();
	zassert_equal(error, OT_ERROR_INVALID_ARGS);
}

/* Test serialization of otThreadGetLinkMode() returning '-' */
ZTEST(ot_rpc_thread, test_otThreadGetLinkMode_none)
{
	otLinkModeConfig mode;

	mock_nrf_rpc_tr_expect_add(RPC_CMD(OT_RPC_CMD_THREAD_GET_LINK_MODE), RPC_RSP(0x00));
	mode = otThreadGetLinkMode(NULL);
	mock_nrf_rpc_tr_expect_done();
	zassert_false(mode.mRxOnWhenIdle);
	zassert_false(mode.mDeviceType);
	zassert_false(mode.mNetworkData);
}

/* Test serialization of otThreadGetLinkMode() returning 'rdn' */
ZTEST(ot_rpc_thread, test_otThreadGetLinkMode_rdn)
{
	otLinkModeConfig mode;

	mock_nrf_rpc_tr_expect_add(RPC_CMD(OT_RPC_CMD_THREAD_GET_LINK_MODE), RPC_RSP(0x07));
	mode = otThreadGetLinkMode(NULL);
	mock_nrf_rpc_tr_expect_done();
	zassert_true(mode.mRxOnWhenIdle);
	zassert_true(mode.mDeviceType);
	zassert_true(mode.mNetworkData);
}

/* Test serialization of otThreadGetVersion() returning 1.4 */
ZTEST(ot_rpc_thread, test_otThreadGetVersion)
{
	uint16_t version;

	mock_nrf_rpc_tr_expect_add(RPC_CMD(OT_RPC_CMD_THREAD_GET_VERSION),
				   RPC_RSP(OT_THREAD_VERSION_1_4));
	version = otThreadGetVersion();
	mock_nrf_rpc_tr_expect_done();
	zassert_equal(version, OT_THREAD_VERSION_1_4);
}

/* Test serialization of otThreadGetExtendedPanId() */
ZTEST(ot_rpc_thread, test_otThreadGetExtendedPanId)
{
	const otExtendedPanId exp_version = {{INT_SEQUENCE(OT_EXT_PAN_ID_SIZE)}};
	const otExtendedPanId *version;

	mock_nrf_rpc_tr_expect_add(RPC_CMD(OT_RPC_CMD_THREAD_GET_EXTENDED_PANID),
				   RPC_RSP(EXT_PAN_ID));
	version = otThreadGetExtendedPanId(NULL);
	mock_nrf_rpc_tr_expect_done();

	zassert_mem_equal(version, &exp_version, OT_EXT_PAN_ID_SIZE);
}

/* Test serialization of otThreadGetLeaderRouterId() */
ZTEST(ot_rpc_thread, test_otThreadGetLeaderRouterId)
{
	uint8_t id;

	mock_nrf_rpc_tr_expect_add(RPC_CMD(OT_RPC_CMD_THREAD_GET_LEADER_ROUTER_ID),
				   RPC_RSP(CBOR_UINT8(UINT8_MAX)));
	id = otThreadGetLeaderRouterId(NULL);
	mock_nrf_rpc_tr_expect_done();

	zassert_equal(id, UINT8_MAX);
}

/* Test serialization of otThreadGetLeaderWeight() */
ZTEST(ot_rpc_thread, test_otThreadGetLeaderWeight)
{
	uint8_t weight;

	mock_nrf_rpc_tr_expect_add(RPC_CMD(OT_RPC_CMD_THREAD_GET_LEADER_WEIGHT),
				   RPC_RSP(CBOR_UINT8(UINT8_MAX)));
	weight = otThreadGetLeaderWeight(NULL);
	mock_nrf_rpc_tr_expect_done();

	zassert_equal(weight, UINT8_MAX);
}

/* Test serialization of otThreadGetMeshLocalPrefix() */
ZTEST(ot_rpc_thread, test_otThreadGetMeshLocalPrefix)
{
	const otMeshLocalPrefix exp_prefix = {{MESH_LOCAL_PREFIX}};
	const otMeshLocalPrefix *prefix;

	mock_nrf_rpc_tr_expect_add(RPC_CMD(OT_RPC_CMD_THREAD_GET_MESH_LOCAL_PREFIX),
				   RPC_RSP(CBOR_MESH_LOCAL_PREFIX));
	prefix = otThreadGetMeshLocalPrefix(NULL);
	mock_nrf_rpc_tr_expect_done();

	zassert_mem_equal(prefix, &exp_prefix, OT_MESH_LOCAL_PREFIX_SIZE);
}

/* Test serialization of otThreadGetNetworkName() */
ZTEST(ot_rpc_thread, test_otThreadGetNetworkName)
{
	const char exp_name[] = {STR_SEQUENCE(OT_NETWORK_NAME_MAX_SIZE), '\0'};
	const char *name;

	mock_nrf_rpc_tr_expect_add(RPC_CMD(OT_RPC_CMD_THREAD_GET_NETWORK_NAME),
				   RPC_RSP(0x50, STR_SEQUENCE(OT_NETWORK_NAME_MAX_SIZE)));
	name = otThreadGetNetworkName(NULL);
	mock_nrf_rpc_tr_expect_done();

	zassert_str_equal(name, exp_name);
}

/* Test serialization of otThreadGetPartitionId() */
ZTEST(ot_rpc_thread, test_otThreadGetPartitionId)
{
	uint32_t id;

	mock_nrf_rpc_tr_expect_add(RPC_CMD(OT_RPC_CMD_THREAD_GET_PARTITION_ID),
				   RPC_RSP(CBOR_UINT32(UINT32_MAX)));
	id = otThreadGetPartitionId(NULL);
	mock_nrf_rpc_tr_expect_done();

	zassert_equal(id, UINT32_MAX);
}

ZTEST_SUITE(ot_rpc_thread, NULL, NULL, tc_setup, NULL, NULL);
```
