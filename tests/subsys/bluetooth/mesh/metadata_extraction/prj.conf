## CMakeLists.txt
```
#
# Copyright (c) 2024 Nordic Semiconductor ASA
#
# SPDX-License-Identifier: LicenseRef-Nordic-5-Clause
#
cmake_minimum_required(VERSION 3.20.0)

find_package(Zephyr REQUIRED HINTS $ENV{ZEPHYR_BASE})
project(bt_mesh_metadata_extraction_test)

FILE(GLOB app_sources src/*.c)
target_sources(app PRIVATE ${app_sources})

set(script_args ${PROJECT_BINARY_DIR})

if(CONFIG_COMP_DATA_LAYOUT_SINGLE)
  list(PREPEND script_args --single)
else()
  list(PREPEND script_args --multiple)
endif()

list(APPEND script_args childparent)

if(NOT SYSBUILD)
  add_custom_target(verify_metadata ALL
    ${PYTHON_EXECUTABLE} ${PROJECT_SOURCE_DIR}/verify_metadata.py ${script_args}
    DEPENDS parse_mesh_metadata
  )
endif()
```

## Kconfig.sysbuild
```
choice COMP_DATA_LAYOUT
	prompt "Composition data layout"
	default COMP_DATA_LAYOUT_SINGLE

config COMP_DATA_LAYOUT_SINGLE
	bool "Single composition data"

config COMP_DATA_LAYOUT_MULTIPLE
	bool "Multiple composition data as separate variables"

config COMP_DATA_LAYOUT_ARRAY
	bool "Multiple composition data as an array"

endchoice

source "${ZEPHYR_BASE}/share/sysbuild/Kconfig"
```

## prj.conf
```kconfig
#
# Copyright (c) 2024 Nordic Semiconductor ASA
#
# SPDX-License-Identifier: LicenseRef-Nordic-5-Clause
#

# Bootloader configuration
CONFIG_BOOTLOADER_MCUBOOT=y
CONFIG_MCUBOOT_IMGTOOL_SIGN_VERSION="1.2.3+4"

# Bluetooth configuration
CONFIG_BT=y
CONFIG_BT_OBSERVER=y
CONFIG_BT_PERIPHERAL=y

# Bluetooth Mesh configuration
CONFIG_BT_MESH=y
CONFIG_BT_MESH_DFU_METADATA_ON_BUILD=y

# Set to something other than default to check that it is parsed correctly
CONFIG_BT_MESH_CRPL=64

# Enable extra mesh features to check that the features field is parsed correctly
CONFIG_BT_MESH_RELAY=y
CONFIG_BT_MESH_FRIEND=y

# Bluetooth Mesh models
CONFIG_BT_MESH_LVL_CLI=y
CONFIG_BT_MESH_ONOFF_CLI=y
```

## src/main.c
```c
/*
 * Copyright (c) 2024 Nordic Semiconductor ASA
 *
 * SPDX-License-Identifier: LicenseRef-Nordic-5-Clause
 */

/** @file
 *  @brief Bluetooth Mesh DFU Target role sample
 */
#include <zephyr/kernel.h>
#include <zephyr/bluetooth/bluetooth.h>
#include <zephyr/bluetooth/mesh.h>
#include <bluetooth/mesh/models.h>


static struct bt_mesh_health_srv health_srv;

BT_MESH_HEALTH_PUB_DEFINE(health_pub, 0);

static struct bt_mesh_model models[] = {
	BT_MESH_MODEL_CFG_SRV,
	BT_MESH_MODEL_HEALTH_SRV(&health_srv, &health_pub),
};

static struct bt_mesh_elem elements[] = {
	BT_MESH_ELEM(1, models, BT_MESH_MODEL_NONE),
};

#ifndef CONFIG_COMP_DATA_LAYOUT_SINGLE
static struct bt_mesh_onoff_cli onoff_cli;
static struct bt_mesh_lvl_cli lvl_cli;

static struct bt_mesh_model extra_models[] = {
	BT_MESH_MODEL_ONOFF_CLI(&onoff_cli),
	BT_MESH_MODEL_LVL_CLI(&lvl_cli),
};

static struct bt_mesh_elem elements_alt[] = {
	BT_MESH_ELEM(1, models, BT_MESH_MODEL_NONE),
	BT_MESH_ELEM(2, extra_models, BT_MESH_MODEL_NONE),
};
#endif

#ifdef CONFIG_COMP_DATA_LAYOUT_ARRAY
const struct bt_mesh_comp comp[2] = {
	{
		.cid = 1,
		.pid = 2,
		.vid = 3,
		.elem = elements,
		.elem_count = ARRAY_SIZE(elements),
	},
	{
		.cid = 4,
		.pid = 5,
		.vid = 6,
		.elem = elements_alt,
		.elem_count = ARRAY_SIZE(elements_alt),
	},
};
#else /* defined(COMP_DATA_LAYOUT_SINGLE) || defined(COMP_DATA_LAYOUT_MULTIPLE) */
static const struct bt_mesh_comp comp = {
	.cid = 1,
	.pid = 2,
	.vid = 3,
	.elem = elements,
	.elem_count = ARRAY_SIZE(elements),
};
#ifdef CONFIG_COMP_DATA_LAYOUT_MULTIPLE
static const struct bt_mesh_comp comp_alt = {
	.cid = 4,
	.pid = 5,
	.vid = 6,
	.elem = elements_alt,
	.elem_count = ARRAY_SIZE(elements_alt),
};
#endif /* CONFIG_COMP_DATA_LAYOUT_MULTIPLE */
#endif /* defined(COMP_DATA_LAYOUT_SINGLE) || defined(COMP_DATA_LAYOUT_MULTIPLE) */

static const uint8_t dev_uuid[16];

static const struct bt_mesh_prov prov = {
	.uuid = dev_uuid,
};

#ifndef CONFIG_COMP_DATA_LAYOUT_SINGLE
/* Since the value of this variable is never changed by the code, the compiler
 * might optimize it out, including any conditions that depend on it (and by
 * by extension, the entire alternate composition data structure). To prevent
 * this, the `volatile` qualifier is used.
 */
volatile bool use_alt;
#endif

static void bt_ready(int err)
{
	if (err) {
		return;
	}

#ifdef CONFIG_COMP_DATA_LAYOUT_ARRAY
	if (use_alt) {
		bt_mesh_init(&prov, &comp[1]);
	} else {
		bt_mesh_init(&prov, &comp[0]);
	}
#else /* defined(COMP_DATA_LAYOUT_SINGLE) || defined(COMP_DATA_LAYOUT_MULTIPLE) */
#ifdef CONFIG_COMP_DATA_LAYOUT_MULTIPLE
	if (use_alt) {
		bt_mesh_init(&prov, &comp_alt);
	} else
#endif /* CONFIG_COMP_DATA_LAYOUT_MULTIPLE */
	{
		bt_mesh_init(&prov, &comp);
	}
#endif /* defined(COMP_DATA_LAYOUT_SINGLE) || defined(COMP_DATA_LAYOUT_MULTIPLE) */
}

int main(void)
{
	bt_enable(bt_ready);

	return 0;
}
```
