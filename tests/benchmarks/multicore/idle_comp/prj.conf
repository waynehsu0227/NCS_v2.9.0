## prj.conf
```kconfig
CONFIG_COMPARATOR=y
CONFIG_GPIO=y

CONFIG_PM=y
CONFIG_PM_S2RAM=y
CONFIG_PM_S2RAM_CUSTOM_MARKING=y
CONFIG_PM_DEVICE=y
CONFIG_PM_DEVICE_RUNTIME=y
CONFIG_POWEROFF=y
CONFIG_BOOT_BANNER=n
CONFIG_SOC_NRF54H20_NO_MRAM_LATENCY=n
CONFIG_ASSERT=y

# Enable for debugging purposes only
CONFIG_PRINTK=n
CONFIG_LOG=n
CONFIG_CONSOLE=n
CONFIG_UART_CONSOLE=n
CONFIG_SERIAL=n
```

## boards/nrf54h20dk_nrf54h20_cpuapp.overlay
```dts
/*
 * Copyright (c) 2024 Nordic Semiconductor ASA
 *
 * SPDX-License-Identifier: LicenseRef-Nordic-5-Clause
 */

/ {
	aliases {
		test-comp = &comp;
	};

	zephyr,user {
		test-gpios = <&gpio1 3 GPIO_ACTIVE_HIGH>;
	};
};

&gpio1 {
	status = "okay";
};
```

## src/main.c
```c
/*
 * Copyright (c) 2024 Nordic Semiconductor ASA
 *
 * SPDX-License-Identifier: LicenseRef-Nordic-5-Clause
 */

#include <zephyr/drivers/comparator.h>
#include <zephyr/drivers/gpio.h>
#include <zephyr/kernel.h>
#include <zephyr/pm/device_runtime.h>

static const struct device *test_dev = DEVICE_DT_GET(DT_ALIAS(test_comp));
static const struct gpio_dt_spec test_pin = GPIO_DT_SPEC_GET(DT_PATH(zephyr_user), test_gpios);

volatile int counter;
static void test_callback(const struct device *dev, void *user_data)
{
	counter++;
}

int main(void)
{

	int rc;

	gpio_pin_configure_dt(&test_pin, GPIO_OUTPUT_INACTIVE);

	pm_device_runtime_enable(test_dev);
	pm_device_runtime_get(test_dev);

	rc = comparator_set_trigger_callback(test_dev, test_callback, NULL);
	__ASSERT_NO_MSG(rc == 0);

	rc = comparator_set_trigger(test_dev, COMPARATOR_TRIGGER_BOTH_EDGES);
	__ASSERT_NO_MSG(rc == 0);

	while (1) {
		counter = 0;
		k_msleep(200);
		gpio_pin_set_dt(&test_pin, 1);
		k_msleep(400);
		__ASSERT_NO_MSG(counter == 1);
		gpio_pin_set_dt(&test_pin, 0);
		k_msleep(400);
		__ASSERT_NO_MSG(counter == 2);
		pm_device_runtime_put(test_dev);
		k_msleep(1000);

		pm_device_runtime_get(test_dev);
		k_msleep(1);
	}
	return 0;
}
```
