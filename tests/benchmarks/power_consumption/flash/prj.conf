## prj.conf
```kconfig
CONFIG_FLASH=y

# Enable runtime power management for peripheral
CONFIG_PM_DEVICE=y
CONFIG_PM_DEVICE_RUNTIME=y

CONFIG_PM=y
CONFIG_PM_S2RAM=y
CONFIG_POWEROFF=y
CONFIG_PM_S2RAM_CUSTOM_MARKING=y
CONFIG_CONSOLE=n
CONFIG_UART_CONSOLE=n
CONFIG_SERIAL=n
CONFIG_BOOT_BANNER=n
CONFIG_SOC_NRF54H20_NO_MRAM_LATENCY=n
```

## boards/nrf54h20dk_nrf54h20_cpuapp.overlay
```dts
&mx25uw63 {
	status = "okay";
};

/ {
	aliases {
		jedec-spi-nor = &mx25uw63;
	};
};
```

## src/driver_test.c
```c
/*
 * Copyright (c) 2024 Nordic Semiconductor ASA
 *
 * SPDX-License-Identifier: LicenseRef-Nordic-5-Clause
 */

#include <zephyr/drivers/flash.h>
#include <zephyr/storage/flash_map.h>
#include <zephyr/kernel.h>

#define TEST_AREA_OFFSET	0xff000
#define EXPECTED_SIZE	512
uint8_t buf[EXPECTED_SIZE];

static const struct device *flash_dev = DEVICE_DT_GET(DT_INST(0, jedec_spi_nor));


void thread_definition(void)
{
	int ret;

	while (1) {
		ret = flash_read(flash_dev, TEST_AREA_OFFSET, buf, EXPECTED_SIZE);
		if (ret < 0) {
			printk("Failure in reading byte %d", ret);
			return;
		}
	};
};
```
