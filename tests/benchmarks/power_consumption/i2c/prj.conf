## prj.conf
```kconfig
# Drivers and peripherals
CONFIG_I2C=y

# Enable runtime power management for peripheral
CONFIG_PM_DEVICE=y
CONFIG_PM_DEVICE_RUNTIME=y

CONFIG_PM=y
CONFIG_PM_S2RAM=y
CONFIG_POWEROFF=y
CONFIG_PM_S2RAM_CUSTOM_MARKING=y
CONFIG_CONSOLE=n
CONFIG_UART_CONSOLE=n
CONFIG_SERIAL=n
CONFIG_BOOT_BANNER=n
CONFIG_SOC_NRF54H20_NO_MRAM_LATENCY=n
```

## src/driver_test.c
```c
/*
 * Copyright (c) 2024 Nordic Semiconductor ASA
 *
 * SPDX-License-Identifier: LicenseRef-Nordic-5-Clause
 */

#include <zephyr/drivers/i2c.h>
#include <zephyr/kernel.h>

static const struct device *i2c = DEVICE_DT_GET(DT_ALIAS(sensor_bme688));


void thread_definition(void)
{
	int ret;
	uint8_t value;

	while (1) {
		ret = i2c_reg_read_byte(i2c, 0x76, 0x75, &value);
		if (ret < 0) {
			printk("Failure in reading byte %d", ret);
			return;
		}
	};
};
```
