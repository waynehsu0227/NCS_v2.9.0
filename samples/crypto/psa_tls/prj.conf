## CMakeLists.txt
```
#
# Copyright (c) 2021 Nordic Semiconductor ASA
#
# SPDX-License-Identifier: LicenseRef-Nordic-5-Clause
#

cmake_minimum_required(VERSION 3.20.0)

find_package(Zephyr REQUIRED HINTS $ENV{ZEPHYR_BASE})

project(psa_tls_sample)

zephyr_include_directories(src ${COMMON_DIR})
target_include_directories(app PUBLIC ./include)
target_sources(app PRIVATE src/main.c
                           src/psa_tls_common.c)

if(CONFIG_BUILD_WITH_TFM)
  set(TLS_SRC_PATH "non-secure")
else()
  set(TLS_SRC_PATH "secure")
endif()

if(CONFIG_PSA_TLS_SAMPLE_TYPE_SERVER)
    target_sources(app PRIVATE src/${TLS_SRC_PATH}/psa_tls_credentials_server.c)
    if(CONFIG_NET_SOCKETS_ENABLE_DTLS)
        target_sources(app PRIVATE src/psa_dtls_functions_server.c)
    else()
        target_sources(app PRIVATE src/psa_tls_functions_server.c)
    endif()
else()
    target_sources(app PRIVATE src/${TLS_SRC_PATH}/psa_tls_credentials_client.c)
    if(CONFIG_NET_SOCKETS_ENABLE_DTLS)
        target_sources(app PRIVATE src/psa_dtls_functions_client.c)
    else()
        target_sources(app PRIVATE src/psa_tls_functions_client.c)
    endif()
endif()

set(gen_dir ${ZEPHYR_BINARY_DIR}/include/generated/)

foreach(inc_file
  ec-root-cert.der
	ec-echo-apps-cert.der
	ec-echo-apps-key.der
    )
  generate_inc_file_for_target(
    app
    certs/ecdsa/${inc_file}
    ${gen_dir}/${inc_file}.inc
    )
endforeach()

foreach(inc_file
  root-cert.der
	echo-apps-cert.der
	echo-apps-key.der
    )
  generate_inc_file_for_target(
    app
    certs/rsa/${inc_file}
    ${gen_dir}/${inc_file}.inc
    )
endforeach()
```

## sample.yaml
```
sample:
  description: |
    This app provides an example of performing TLS handshake as either server or client
  name: TLS Sample
tests:
  ################################################################################
  ## PSA APIs with Cryptocell and Oberon
  ################################################################################
  sample.psa_tls.tls_server.ecdsa.cc3xx_oberon:
    sysbuild: true
    build_only: true
    extra_args: >
      OVERLAY_CONFIG="overlays/server.conf;overlays/ecdsa.conf;overlays/cc3xx-oberon-psa.conf"
    platform_allow: >
      nrf5340dk/nrf5340/cpuapp nrf9160dk/nrf9160 nrf5340dk/nrf5340/cpuapp/ns
      nrf9160dk/nrf9160/ns nrf9161dk/nrf9161 nrf9161dk/nrf9161/ns nrf9151dk/nrf9151
      nrf9151dk/nrf9151/ns
    integration_platforms:
      - nrf5340dk/nrf5340/cpuapp
      - nrf5340dk/nrf5340/cpuapp/ns
      - nrf9160dk/nrf9160
      - nrf9160dk/nrf9160/ns
      - nrf9161dk/nrf9161
      - nrf9161dk/nrf9161/ns
      - nrf9151dk/nrf9151
      - nrf9151dk/nrf9151/ns
    tags: ci_build cc3xx_oberon sysbuild ci_samples_crypto
  sample.psa_tls.dtls_server.ecdsa.cc3xx_oberon:
    sysbuild: true
    build_only: true
    extra_args: >
      OVERLAY_CONFIG="overlays/server.conf;overlays/ecdsa.conf;overlays/cc3xx-oberon-psa.conf;overlays/dtls.conf"
    platform_allow: >
      nrf5340dk/nrf5340/cpuapp nrf9160dk/nrf9160 nrf5340dk/nrf5340/cpuapp/ns
      nrf9160dk/nrf9160/ns nrf9161dk/nrf9161 nrf9161dk/nrf9161/ns nrf9151dk/nrf9151
      nrf9151dk/nrf9151/ns
    integration_platforms:
      - nrf5340dk/nrf5340/cpuapp
      - nrf5340dk/nrf5340/cpuapp/ns
      - nrf9160dk/nrf9160
      - nrf9160dk/nrf9160/ns
      - nrf9161dk/nrf9161
      - nrf9161dk/nrf9161/ns
      - nrf9151dk/nrf9151
      - nrf9151dk/nrf9151/ns
    tags: ci_build cc3xx_oberon dtls sysbuild ci_samples_crypto
  sample.psa_tls.tls_client.ecdsa.cc3xx_oberon:
    sysbuild: true
    build_only: true
    extra_args: >
      OVERLAY_CONFIG="overlays/client.conf;overlays/ecdsa.conf;overlays/cc3xx-oberon-psa.conf"
    platform_allow: >
      nrf5340dk/nrf5340/cpuapp nrf9160dk/nrf9160 nrf5340dk/nrf5340/cpuapp/ns nrf9160dk/nrf9160/ns
      nrf9161dk/nrf9161 nrf9161dk/nrf9161/ns nrf9151dk/nrf9151 nrf9151dk/nrf9151/ns
    integration_platforms:
      - nrf5340dk/nrf5340/cpuapp
      - nrf5340dk/nrf5340/cpuapp/ns
      - nrf9160dk/nrf9160
      - nrf9160dk/nrf9160/ns
      - nrf9161dk/nrf9161
      - nrf9161dk/nrf9161/ns
      - nrf9151dk/nrf9151
      - nrf9151dk/nrf9151/ns
    tags: ci_build cc3xx_oberon sysbuild ci_samples_crypto
  sample.psa_tls.dtls_client.ecdsa.cc3xx_oberon:
    sysbuild: true
    build_only: true
    extra_args: >
      OVERLAY_CONFIG="overlays/client.conf;overlays/ecdsa.conf;overlays/cc3xx-oberon-psa.conf;overlays/dtls.conf"
    platform_allow: >
      nrf5340dk/nrf5340/cpuapp nrf9160dk/nrf9160 nrf5340dk/nrf5340/cpuapp/ns
      nrf9160dk/nrf9160/ns nrf9161dk/nrf9161 nrf9161dk/nrf9161/ns nrf9151dk/nrf9151
      nrf9151dk/nrf9151/ns
    integration_platforms:
      - nrf5340dk/nrf5340/cpuapp
      - nrf5340dk/nrf5340/cpuapp/ns
      - nrf9160dk/nrf9160
      - nrf9160dk/nrf9160/ns
      - nrf9161dk/nrf9161
      - nrf9161dk/nrf9161/ns
      - nrf9151dk/nrf9151
      - nrf9151dk/nrf9151/ns
    tags: ci_build cc3xx_oberon dtls sysbuild ci_samples_crypto
  ################################################################################
  ## PSA APIs with Oberon
  ################################################################################
  sample.psa_tls.server.ecdsa.oberon:
    sysbuild: true
    build_only: true
    extra_args: >
      OVERLAY_CONFIG="overlays/server.conf;overlays/ecdsa.conf;overlays/oberon-psa.conf"
    platform_allow: >
      nrf54l15dk/nrf54l15/cpuapp
    integration_platforms:
      - nrf54l15dk/nrf54l15/cpuapp
    tags: ci_build oberon sysbuild ci_samples_crypto
  sample.psa_tls.client.ecdsa.oberon:
    sysbuild: true
    build_only: true
    extra_args: >
      OVERLAY_CONFIG="overlays/client.conf;overlays/ecdsa.conf;overlays/oberon-psa.conf"
    platform_allow: >
      nrf54l15dk/nrf54l15/cpuapp
    integration_platforms:
      - nrf54l15dk/nrf54l15/cpuapp
    tags: ci_build oberon sysbuild ci_samples_crypto
  ################################################################################
  ## PSA APIs with Cracen
  ################################################################################
  sample.psa_tls.server.ecdsa.cracen:
    sysbuild: true
    build_only: true
    extra_args: >
      OVERLAY_CONFIG="overlays/server.conf;overlays/ecdsa.conf;overlays/cracen-psa.conf"
    platform_allow: >
      nrf54l15dk/nrf54l15/cpuapp
      nrf54l15dk/nrf54l15/cpuapp/ns
      nrf54l15dk/nrf54l10/cpuapp
    integration_platforms:
      - nrf54l15dk/nrf54l15/cpuapp
      - nrf54l15dk/nrf54l15/cpuapp/ns
      - nrf54l15dk/nrf54l10/cpuapp
    tags: ci_build cracen sysbuild ci_samples_crypto
  sample.psa_tls.client.ecdsa.cracen:
    sysbuild: true
    build_only: true
    extra_args: >
      OVERLAY_CONFIG="overlays/client.conf;overlays/ecdsa.conf;overlays/cracen-psa.conf"
    platform_allow: >
      nrf54l15dk/nrf54l15/cpuapp
      nrf54l15dk/nrf54l15/cpuapp/ns
      nrf54l15dk/nrf54l10/cpuapp
    integration_platforms:
      - nrf54l15dk/nrf54l15/cpuapp
      - nrf54l15dk/nrf54l15/cpuapp/ns
      - nrf54l15dk/nrf54l10/cpuapp
    tags: ci_build cracen sysbuild ci_samples_crypto
  ################################################################################
  ## Legacy APIs with Cryptocell (secure-only)
  ################################################################################
  sample.psa_tls.tls_server.rsa.cc3xx_legacy:
    sysbuild: true
    build_only: true
    extra_args: >
      OVERLAY_CONFIG="overlays/server.conf;overlays/rsa.conf;overlays/cc3xx-legacy.conf"
    platform_allow: nrf52840dk/nrf52840 nrf9160dk/nrf9160 nrf5340dk/nrf5340/cpuapp nrf9151dk/nrf9151
    integration_platforms:
      - nrf52840dk/nrf52840
      - nrf5340dk/nrf5340/cpuapp
      - nrf9160dk/nrf9160
      - nrf9151dk/nrf9151
    tags: ci_build legacy cc3xx_legacy sysbuild ci_samples_crypto
  sample.psa_tls.tls_client.rsa.cc3xx_legacy:
    sysbuild: true
    build_only: true
    extra_args: >
      OVERLAY_CONFIG="overlays/client.conf;overlays/rsa.conf;overlays/cc3xx-legacy.conf"
    platform_allow: nrf52840dk/nrf52840 nrf9160dk/nrf9160 nrf5340dk/nrf5340/cpuapp nrf9151dk/nrf9151
    integration_platforms:
      - nrf52840dk/nrf52840
      - nrf5340dk/nrf5340/cpuapp
      - nrf9160dk/nrf9160
      - nrf9151dk/nrf9151
    tags: ci_build legacy cc3xx_legacy sysbuild ci_samples_crypto
  sample.psa_tls.tls_server.ecdsa.cc3xx_legacy:
    sysbuild: true
    build_only: true
    extra_args: >
      OVERLAY_CONFIG="overlays/server.conf;overlays/ecdsa.conf;overlays/cc3xx-legacy.conf"
    platform_allow: nrf52840dk/nrf52840 nrf9160dk/nrf9160 nrf5340dk/nrf5340/cpuapp nrf9151dk/nrf9151
    integration_platforms:
      - nrf52840dk/nrf52840
      - nrf5340dk/nrf5340/cpuapp
      - nrf9160dk/nrf9160
      - nrf9151dk/nrf9151
    tags: ci_build legacy cc3xx_legacy sysbuild ci_samples_crypto
  sample.psa_tls.tls_client.ecdsa.cc3xx_legacy:
    sysbuild: true
    build_only: true
    extra_args: >
      OVERLAY_CONFIG="overlays/client.conf;overlays/ecdsa.conf;overlays/cc3xx-legacy.conf"
    platform_allow: nrf52840dk/nrf52840 nrf9160dk/nrf9160 nrf5340dk/nrf5340/cpuapp nrf9151dk/nrf9151
    integration_platforms:
      - nrf52840dk/nrf52840
      - nrf5340dk/nrf5340/cpuapp
      - nrf9160dk/nrf9160
      - nrf9151dk/nrf9151
    tags: ci_build legacy cc3xx_legacy sysbuild ci_samples_crypto
  ################################################################################
  ## Legacy APIs with Oberon (secure-only)
  ################################################################################
  sample.psa_tls.tls_server.rsa.oberon_legacy:
    sysbuild: true
    build_only: true
    extra_args: >
      OVERLAY_CONFIG="overlays/server.conf;overlays/rsa.conf;overlays/oberon-legacy.conf"
    platform_allow: nrf52840dk/nrf52840 nrf9160dk/nrf9160 nrf5340dk/nrf5340/cpuapp nrf9151dk/nrf9151
    integration_platforms:
      - nrf52840dk/nrf52840
      - nrf5340dk/nrf5340/cpuapp
      - nrf9160dk/nrf9160
      - nrf9151dk/nrf9151
    tags: ci_build legacy oberon_legacy sysbuild ci_samples_crypto
  sample.psa_tls.tls_client.rsa.oberon_legacy:
    sysbuild: true
    build_only: true
    extra_args: >
      OVERLAY_CONFIG="overlays/client.conf;overlays/rsa.conf;overlays/oberon-legacy.conf"
    platform_allow: nrf52840dk/nrf52840 nrf9160dk/nrf9160 nrf5340dk/nrf5340/cpuapp nrf9151dk/nrf9151
    integration_platforms:
      - nrf52840dk/nrf52840
      - nrf5340dk/nrf5340/cpuapp
      - nrf9160dk/nrf9160
      - nrf9151dk/nrf9151
    tags: ci_build legacy oberon_legacy sysbuild ci_samples_crypto
  sample.psa_tls.tls_server.ecdsa.oberon_legacy:
    sysbuild: true
    build_only: true
    extra_args: >
      OVERLAY_CONFIG="overlays/server.conf;overlays/ecdsa.conf;overlays/oberon-legacy.conf"
    platform_allow: nrf52840dk/nrf52840 nrf9160dk/nrf9160 nrf5340dk/nrf5340/cpuapp nrf9151dk/nrf9151
    integration_platforms:
      - nrf52840dk/nrf52840
      - nrf5340dk/nrf5340/cpuapp
      - nrf9160dk/nrf9160
      - nrf9151dk/nrf9151
    tags: ci_build legacy oberon_legacy sysbuild ci_samples_crypto
  sample.psa_tls.tls_client.ecdsa.oberon_legacy:
    sysbuild: true
    build_only: true
    extra_args: >
      OVERLAY_CONFIG="overlays/client.conf;overlays/ecdsa.conf;overlays/oberon-legacy.conf"
    platform_allow: nrf52840dk/nrf52840 nrf9160dk/nrf9160 nrf5340dk/nrf5340/cpuapp nrf9151dk/nrf9151
    integration_platforms:
      - nrf52840dk/nrf52840
      - nrf5340dk/nrf5340/cpuapp
      - nrf9160dk/nrf9160
      - nrf9151dk/nrf9151
    tags: ci_build legacy oberon_legacy sysbuild ci_samples_crypto
```

## prj.conf
```kconfig
#
# Copyright (c) 2021 Nordic Semiconductor ASA
#
# SPDX-License-Identifier: LicenseRef-Nordic-5-Clause
#

# Main thread
CONFIG_MAIN_STACK_SIZE=8192

# Logging
CONFIG_LOG=y
CONFIG_PRINTK=y
CONFIG_NET_LOG=y
CONFIG_LOG_DEFAULT_LEVEL=3
CONFIG_LOG_MODE_IMMEDIATE=y
CONFIG_LOG_ALWAYS_RUNTIME=y

# Networking
CONFIG_NETWORKING=y
CONFIG_NET_UDP=n
CONFIG_NET_TCP=y
CONFIG_NET_IPV6=n
CONFIG_NET_IPV4=y
CONFIG_NET_SOCKETS=y
CONFIG_NET_TCP_ISN_RFC6528=n
CONFIG_NET_CONFIG_SETTINGS=y
CONFIG_NET_CONFIG_NEED_IPV6=n
CONFIG_NET_CONFIG_NEED_IPV4=y
CONFIG_POSIX_API=y
CONFIG_NET_CONNECTION_MANAGER=n
CONFIG_NET_CONTEXT_NET_PKT_POOL=y

# TLS networking
CONFIG_ZVFS_OPEN_MAX=8
CONFIG_NET_SOCKETS_SOCKOPT_TLS=y
CONFIG_NET_SOCKETS_ENABLE_DTLS=n
CONFIG_NET_SOCKETS_TLS_MAX_CONTEXTS=6
CONFIG_NET_SOCKETS_TLS_MAX_CIPHERSUITES=16

# Network buffers
CONFIG_NET_MAX_CONTEXTS=6
CONFIG_NET_PKT_RX_COUNT=16
CONFIG_NET_PKT_TX_COUNT=16
CONFIG_NET_BUF_RX_COUNT=100
CONFIG_NET_BUF_TX_COUNT=100

# mbed TLS and security
CONFIG_MBEDTLS_PK_C=y

CONFIG_MBEDTLS_ENABLE_HEAP=y
CONFIG_MBEDTLS_HEAP_SIZE=32768
CONFIG_MBEDTLS_SSL_IN_CONTENT_LEN=2304
CONFIG_MBEDTLS_SSL_OUT_CONTENT_LEN=2304
CONFIG_MBEDTLS_SSL_CLI_C=y
CONFIG_MBEDTLS_TLS_LIBRARY=y
CONFIG_MBEDTLS_X509_LIBRARY=y
CONFIG_NRF_SECURITY_ADVANCED=y

# NB: This list of PSA dependencies may be too long
CONFIG_PSA_WANT_GENERATE_RANDOM=y
CONFIG_PSA_WANT_KEY_TYPE_AES=y
CONFIG_PSA_WANT_ALG_CCM=y
CONFIG_PSA_WANT_ALG_GCM=y
CONFIG_PSA_WANT_ALG_CHACHA20_POLY1305=y
CONFIG_PSA_WANT_ALG_CMAC=y
CONFIG_PSA_WANT_ALG_HMAC=y
CONFIG_PSA_WANT_ALG_SHA_1=y
CONFIG_PSA_WANT_ALG_SHA_224=y
CONFIG_PSA_WANT_ALG_SHA_256=y
CONFIG_PSA_WANT_ALG_SHA_384=y
CONFIG_PSA_WANT_ALG_SHA_512=y
CONFIG_PSA_WANT_ALG_ECB_NO_PADDING=y
CONFIG_PSA_WANT_ALG_CBC_NO_PADDING=y
CONFIG_PSA_WANT_ALG_CBC_PKCS7=y
CONFIG_PSA_WANT_ALG_CTR=y
CONFIG_PSA_WANT_ALG_HKDF=y
CONFIG_PSA_WANT_ALG_TLS12_PRF=y
CONFIG_PSA_WANT_ALG_ECDH=y
CONFIG_PSA_WANT_ALG_ECDSA=y
CONFIG_PSA_WANT_ALG_DETERMINISTIC_ECDSA=y
CONFIG_PSA_WANT_ALG_JPAKE=y
CONFIG_PSA_WANT_ECC_SECP_R1_256=y
CONFIG_PSA_WANT_KEY_TYPE_ECC_KEY_PAIR_IMPORT=y
CONFIG_PSA_WANT_KEY_TYPE_ECC_KEY_PAIR_EXPORT=y
CONFIG_PSA_WANT_KEY_TYPE_ECC_KEY_PAIR_DERIVE=y
CONFIG_PSA_WANT_KEY_TYPE_ECC_KEY_PAIR_GENERATE=y
CONFIG_PSA_WANT_ALG_STREAM_CIPHER=y
CONFIG_PSA_WANT_KEY_TYPE_CHACHA20=y
CONFIG_PSA_WANT_ALG_TLS12_PSK_TO_MS=y

# RTT ethernet driver
CONFIG_ETH_RTT=y

# Optimizations
CONFIG_SPEED_OPTIMIZATIONS=y
```

## boards/nrf54l15dk_nrf54l15_cpuapp_ns.conf
```kconfig
#
# Copyright (c) 2024 Nordic Semiconductor ASA
#
# SPDX-License-Identifier: LicenseRef-Nordic-5-Clause
#
CONFIG_TFM_PROFILE_TYPE_NOT_SET=y
CONFIG_NRF_ENABLE_ICACHE=n
CONFIG_MBEDTLS_USE_PSA_CRYPTO=y
CONFIG_MBEDTLS_PSA_CRYPTO_C=y

# The ECDSA CA certificate is stored persistently with Protected Storage,
# which internally uses Internal Trusted Storage. Since ITS encryption is
# enabled by default for nRF54L20, the sample must be configured with a
# larger ITS asset size than the default 500 bytes. This is because
# encrypted ITS assets must be stored in a single chunk.
CONFIG_TFM_ITS_MAX_ASSET_SIZE_OVERRIDE=y
CONFIG_TFM_ITS_MAX_ASSET_SIZE=600
```

## include/certificate.h
```c
/*
 * Copyright (c) 2021 Nordic Semiconductor ASA.
 *
 * SPDX-License-Identifier: LicenseRef-Nordic-5-Clause
 */

#ifndef __CERTIFICATE_H__
#define __CERTIFICATE_H__

#define CA_CERTIFICATE_TAG 1
#define SERVER_CERTIFICATE_TAG 2
#define PSK_TAG 3


#if defined(CONFIG_PSA_TLS_CERTIFICATE_TYPE_RSA)

static const unsigned char ca_certificate[] = {
#include "root-cert.der.inc"
};
static const unsigned char server_certificate[] = {
#include "echo-apps-cert.der.inc"
};
/* This is the private key in pkcs#8 format. */
static const unsigned char private_key[] = {
#include "echo-apps-key.der.inc"
};

#elif defined(CONFIG_PSA_TLS_CERTIFICATE_TYPE_ECDSA)

static const unsigned char ca_certificate[] = {
#include "ec-root-cert.der.inc"
};
static const unsigned char server_certificate[] = {
#include "ec-echo-apps-cert.der.inc"
};
/* This is the private key in pkcs#8 format. */
static const unsigned char private_key[] = {
#include "ec-echo-apps-key.der.inc"
};

#else

#error "No certificate type selected"

#endif


#endif /* __CERTIFICATE_H__ */
```

## src/psa_tls_functions_client.c
```c
/*
 * Copyright (c) 2021 Nordic Semiconductor ASA.
 *
 * SPDX-License-Identifier: LicenseRef-Nordic-5-Clause
 */

#include <zephyr/logging/log.h>
LOG_MODULE_REGISTER(psa_tls_client);

#include <nrf.h>
#include <errno.h>
#include <zephyr/kernel.h>
#include <zephyr/net/socket.h>
#include <zephyr/net/net_core.h>
#include <zephyr/net/tls_credentials.h>
#include <zephyr/linker/sections.h>

#include "certificate.h"
#include "psa_tls_functions.h"
#include "psa_tls_credentials.h"

static char recv_buffer[RECV_BUFFER_SIZE]; /* Buffer for storing payload */


/** @brief Function for setting up the client socket to use for TLS handshake.
 *
 * @returns The socket identifier.
 */
static int setup_tls_client_socket(void)
{
	int err;
	int sock;
	int verify = TLS_PEER_VERIFY_REQUIRED;

	/* List of security tags to register. */
	sec_tag_t sec_tag_list[] = {
		CA_CERTIFICATE_TAG,
		PSK_TAG,
	};

	sock = socket(AF_INET, SOCK_STREAM, IPPROTO_TLS_1_2);
	if (sock < 0) {
		LOG_ERR("Failed to create a socket. Err: %d", errno);
		return -errno;
	}

	err = setsockopt(sock, SOL_TLS, TLS_PEER_VERIFY,
			 &verify, sizeof(verify));
	if (err < 0) {
		LOG_ERR("Failed to set TLS peer verification. Err %d", errno);
		(void)close(sock);
		return -errno;
	}

	err = setsockopt(sock, SOL_TLS, TLS_SEC_TAG_LIST, sec_tag_list,
			 sizeof(sec_tag_list));
	if (err < 0) {
		LOG_ERR("Failed to set TLS security TAG list. Err: %d", errno);
		(void)close(sock);
		return -errno;
	}

	err = setsockopt(sock, SOL_TLS, TLS_HOSTNAME,
			 TLS_PEER_HOSTNAME, sizeof(TLS_PEER_HOSTNAME));
	if (err < 0) {
		LOG_ERR("Failed to set TLS_HOSTNAME option. Err: %d", errno);
		(void)close(sock);
		return -errno;
	}

	return sock;
}

/** @brief Thread function that handles all the steps of the TLS handshake for
 *  a client. Loops forever and connects on given port number.
 *
 */
void process_psa_tls(void)
{
	int ret;
	int sock;
	int received;
	struct sockaddr_in server_addr;
	socklen_t server_addr_len = sizeof(server_addr);

	server_addr.sin_family = AF_INET;
	server_addr.sin_port = htons(SERVER_PORT);
	inet_pton(AF_INET, CONFIG_NET_CONFIG_PEER_IPV4_ADDR,
		  &server_addr.sin_addr);

	while (true) {

		sock = setup_tls_client_socket();
		if (sock < 0) {
			LOG_INF("Retrying acquiring socket");
			k_sleep(K_MSEC(1000));
			continue;
		}

		LOG_INF("Initiates TLS connection on port %d ...",
			SERVER_PORT);
		ret = connect(sock, (struct sockaddr *)&server_addr,
			      server_addr_len);

		if (ret < 0) {
			LOG_WRN("Cannot make TLS connection. Err: %d", errno);
			LOG_INF("Will re-try connection in 1 second");
			(void)close(sock);
			k_sleep(K_MSEC(1000));
			continue;
		}
		LOG_INF("TLS handshake completed");

		while (true) {
			/* Try to receive data while connected */
			received = recv(sock, recv_buffer,
					sizeof(recv_buffer), 0);

			if (received == 0) {
				/* Connection closed */
				LOG_INF("TLS Connection closed");
				break;

			} else if (received < 0) {
				/* Socket error */
				LOG_ERR("TLS Connection error: %d", errno);
				break;
			}

			LOG_INF("TLS received %d byte(s)", received);

			ret = psa_tls_send_buffer(sock, recv_buffer, received);
			if (ret != 0) {
				LOG_ERR("TLS Failed to send. Err: %d", errno);
				break;
			}

			LOG_INF("TLS replied with %d bytes", received);
		}

		LOG_INF("Closing TLS connection");
		(void)close(sock);
	}
}
```

## src/psa_tls_functions_server.c
```c
/*
 * Copyright (c) 2021 Nordic Semiconductor ASA.
 *
 * SPDX-License-Identifier: LicenseRef-Nordic-5-Clause
 */

#include <zephyr/logging/log.h>
LOG_MODULE_REGISTER(psa_tls_server);

#include <nrf.h>
#include <errno.h>
#include <zephyr/kernel.h>
#include <zephyr/net/socket.h>
#include <zephyr/net/net_core.h>
#include <zephyr/net/tls_credentials.h>
#include <zephyr/linker/sections.h>

#include "certificate.h"
#include "psa_tls_functions.h"
#include "psa_tls_credentials.h"

static char recv_buffer[RECV_BUFFER_SIZE]; /* Buffer for storing payload */


/** @brief Function for setting up the server socket to use for TLS handshake.
 *
 * @returns The socket identifier.
 */
static int setup_tls_server_socket(void)
{
	int err;
	int sock;
	struct sockaddr_in my_addr;

	/* List of security tags to register. */
	sec_tag_t sec_tag_list[] = {
		SERVER_CERTIFICATE_TAG,
		PSK_TAG,
	};

	memset(&my_addr, 0, sizeof(my_addr));
	my_addr.sin_family = AF_INET;
	my_addr.sin_port = htons(SERVER_PORT);
	sock = socket(my_addr.sin_family, SOCK_STREAM, IPPROTO_TLS_1_2);

	err = setsockopt(sock, SOL_TLS, TLS_SEC_TAG_LIST, sec_tag_list,
			 sizeof(sec_tag_list));
	if (err < 0) {
		LOG_ERR("Failed to set TLS security TAG list. Err: %d", errno);
		(void)close(sock);
		return -errno;
	}

	err = bind(sock, (struct sockaddr *)&my_addr, sizeof(my_addr));
	if (err < 0) {
		LOG_ERR("Failed to bind TLS socket. Err: %d", errno);
		(void)close(sock);
		return -errno;
	}

	err = listen(sock, MAX_CLIENT_QUEUE);
	if (err < 0) {
		LOG_ERR("Failed to listen on TLS socket. Err: %d", errno);
		(void)close(sock);
		return -errno;
	}

	return sock;
}

/** @brief Thread function that handles all the steps of the TLS handshake for
 *  a server. Loops forever and accepts connections on the given port number.
 *
 */
void process_psa_tls(void)
{
	int err;
	int sock;
	int client;
	int received;
	struct sockaddr_in client_addr;
	socklen_t client_addr_len = sizeof(client_addr);

	while (true) {
		sock = setup_tls_server_socket();
		if (sock < 0) {
			LOG_INF("Retrying to create a socket");
			k_sleep(K_MSEC(1000));
			continue;
		}

		LOG_INF("Waiting for TLS connection on port %d ...",
			SERVER_PORT);
		client = accept(sock, (struct sockaddr *)&client_addr,
				&client_addr_len);

		if (client < 0) {
			LOG_ERR("TLS accept error (%d)", -errno);
			(void)close(sock);
			k_sleep(K_MSEC(1000));
			continue;
		}
		LOG_INF("Accepted TLS connection");

		while (true) {
			/* Try to receive data while connected */
			received = recv(client, recv_buffer,
					sizeof(recv_buffer), 0);

			if (received == 0) {
				/* Connection closed */
				LOG_INF("TLS Connection closed");
				break;

			} else if (received < 0) {
				/* Socket error */
				LOG_ERR("TLS Connection error: %d", errno);
				break;
			}

			LOG_INF("TLS received %d bytes", received);

			err = psa_tls_send_buffer(client, recv_buffer, received);
			if (err != 0) {
				LOG_ERR("TLS Failed to send. Err: %d", errno);
				break;
			}

			LOG_INF("TLS replied with %d bytes", received);
		}

		LOG_INF("Closing TLS connection");
		(void)close(client);
		(void)close(sock);

		/* Give some time to properly close sockets before creating new ones */
		k_sleep(K_MSEC(200));
	}
}
```
