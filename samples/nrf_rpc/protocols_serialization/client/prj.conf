## CMakeLists.txt
```
#
# Copyright (c) 2024 Nordic Semiconductor ASA
#
# SPDX-License-Identifier: LicenseRef-Nordic-5-Clause
#
cmake_minimum_required(VERSION 3.20.0)

find_package(Zephyr REQUIRED HINTS $ENV{ZEPHYR_BASE})

project(protocols_serialization_client)

# NORDIC SDK APP START
target_sources(app PRIVATE
    src/main.c
)

zephyr_library_sources_ifdef(CONFIG_OPENTHREAD_RPC src/ot_shell.c)
zephyr_library_sources_ifdef(CONFIG_MPSL_CX_SOFTWARE src/coex_shell.c)
zephyr_library_sources_ifdef(CONFIG_LOG_FORWARDER_RPC src/log_rpc_shell.c)
zephyr_library_sources_ifdef(CONFIG_NFC_RPC src/nfc_shell.c)
zephyr_library_sources_ifdef(CONFIG_NRF_RPC_DEV_INFO src/dev_info_shell.c)
# NORDIC SDK APP START
```

## Kconfig
```
#
# Copyright (c) 2024 Nordic Semiconductor ASA
#
# SPDX-License-Identifier: LicenseRef-Nordic-5-Clause
#

menu "Protocols serialization client"

config BT_CTLR
	default n

choice BT_NUS_LOG_LEVEL_CHOICE
	default BT_NUS_LOG_LEVEL_DBG if DEBUG
endchoice

config RPC_CRASH_LOG_READ_BUFFER_SIZE
	int "Crash log read buffer size"
	depends on LOG_FORWARDER_RPC
	default 256
	help
	  Size of the stack buffer used for reading a single chunk of the crash
	  log from the server device.

module = NRF_PS_CLIENT
module-str = nrf_ps_client
source "${ZEPHYR_BASE}/subsys/logging/Kconfig.template.log_config"

endmenu # "Protocols serialization client"

menu "Zephyr Kernel"
source "Kconfig.zephyr"
endmenu
```

## sample.yaml
```
sample:
  name: Protocols serialization client sample
  description: Demonstrates serialization of Bluetooth LE and OpenThread API using nRF RPC
tests:
  samples.nrf_rpc.protocols_serialization.client.rpc_ble:
    build_only: true
    platform_allow: >
      nrf52840dk/nrf52840
      nrf54l15dk/nrf54l15/cpuapp
    tags: ci_build ci_samples_nrf_rpc
    extra_args: >
      SNIPPET="ble"
    integration_platforms:
      - nrf52840dk/nrf52840
      - nrf54l15dk/nrf54l15/cpuapp
  samples.nrf_rpc.protocols_serialization.client.rpc_ot:
    build_only: true
    platform_allow: >
      nrf52840dk/nrf52840
      nrf54l15dk/nrf54l15/cpuapp
    tags: ci_build ci_samples_nrf_rpc
    extra_args: >
      SNIPPET="openthread"
    integration_platforms:
      - nrf52840dk/nrf52840
      - nrf54l15dk/nrf54l15/cpuapp
  samples.nrf_rpc.protocols_serialization.client.rpc:
    build_only: true
    platform_allow: >
      nrf52840dk/nrf52840
      nrf54l15dk/nrf54l15/cpuapp
    tags: ci_build ci_samples_nrf_rpc
    extra_args: >
      SNIPPET="ble;openthread;debug;coex;log_rpc"
    integration_platforms:
      - nrf52840dk/nrf52840
      - nrf54l15dk/nrf54l15/cpuapp
```

## prj.conf
```kconfig
#
# Copyright (c) 2024 Nordic Semiconductor
#
# SPDX-License-Identifier: LicenseRef-Nordic-5-Clause
#
CONFIG_HEAP_MEM_POOL_SIZE=4096

CONFIG_NRF_RPC=y
CONFIG_NRF_RPC_CBOR=y
CONFIG_NRF_RPC_ZCBOR_BACKUPS=1
CONFIG_NRF_RPC_THREAD_STACK_SIZE=4096
CONFIG_NRF_RPC_GROUP_INIT_WAIT_TIME=-1
CONFIG_NRF_RPC_UART_TRANSPORT=y
CONFIG_NRF_RPC_UART_RELIABLE=y

CONFIG_UART_LINE_CTRL=y
CONFIG_UART_INTERRUPT_DRIVEN=y

CONFIG_SHELL=y
CONFIG_LOG=y
CONFIG_LOG_MODE_DEFERRED=y
CONFIG_LOG_BUFFER_SIZE=4096
CONFIG_LOG_FUNC_NAME_PREFIX_DBG=n
CONFIG_LOG_BACKEND_RTT=n
CONFIG_SHELL_LOG_BACKEND=y

CONFIG_NRF_RPC_DEV_INFO=y
```

## src/dev_info_shell.c
```c
/*
 * Copyright (c) 2024 Nordic Semiconductor ASA
 *
 * SPDX-License-Identifier: LicenseRef-Nordic-5-Clause
 */

#include <zephyr/shell/shell.h>
#include <nrf_rpc/nrf_rpc_dev_info.h>

static int remote_version_cmd(const struct shell *sh, size_t argc, char *argv[])
{
	const char *version = nrf_rpc_get_ncs_commit_sha();

	shell_print(sh, "Remote version: %s", version);

	return 0;
}

SHELL_STATIC_SUBCMD_SET_CREATE(util_cmds,
			       SHELL_CMD_ARG(remote_version, NULL, "Get server version",
					     remote_version_cmd, 1, 0),
			       SHELL_SUBCMD_SET_END);

SHELL_CMD_ARG_REGISTER(rpc, &util_cmds, "nRF RPC utility commands", NULL, 1, 0);
```

## src/log_rpc_shell.c
```c
/*
 * Copyright (c) 2024 Nordic Semiconductor ASA
 *
 * SPDX-License-Identifier: LicenseRef-Nordic-5-Clause
 */

#include <logging/log_rpc.h>

#include <zephyr/kernel.h>
#include <zephyr/shell/shell.h>

#include <stdlib.h>

static int cmd_log_rpc_stream_level(const struct shell *sh, size_t argc, char *argv[])
{
	int rc = 0;
	enum log_rpc_level level;

	level = (enum log_rpc_level)shell_strtol(argv[1], 10, &rc);

	if (rc) {
		shell_error(sh, "Invalid argument: %d", rc);
		return -EINVAL;
	}

	rc = log_rpc_set_stream_level(level);

	if (rc) {
		shell_error(sh, "Error: %d", rc);
		return -ENOEXEC;
	}

	return 0;
}

static int cmd_log_rpc_crash(const struct shell *sh, size_t argc, char *argv[])
{
	int rc;
	char buffer[CONFIG_RPC_CRASH_LOG_READ_BUFFER_SIZE];
	size_t offset = 0;

	while (true) {
		rc = log_rpc_get_crash_log(offset, buffer, sizeof(buffer));
		if (rc <= 0) {
			break;
		}

		shell_fprintf(sh, SHELL_NORMAL, "%.*s", (size_t)rc, buffer);
		offset += (size_t)rc;
	}

	shell_fprintf(sh, SHELL_NORMAL, "\n");

	if (rc) {
		shell_error(sh, "Error: %d", rc);
		return -ENOEXEC;
	}

	return 0;
}

SHELL_STATIC_SUBCMD_SET_CREATE(log_rpc_cmds,
			       SHELL_CMD_ARG(stream_level, NULL, "Set stream logging level",
					     cmd_log_rpc_stream_level, 2, 0),
			       SHELL_CMD_ARG(crash, NULL, "Retrieve remote device crash log",
					     cmd_log_rpc_crash, 1, 0),
			       SHELL_SUBCMD_SET_END);

SHELL_CMD_ARG_REGISTER(log_rpc, &log_rpc_cmds, "RPC logging commands", NULL, 1, 0);
```
