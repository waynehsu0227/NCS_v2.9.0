## CMakeLists.txt
```
#
# Copyright (c) 2024 Nordic Semiconductor ASA
#
# SPDX-License-Identifier: LicenseRef-Nordic-5-Clause
#
cmake_minimum_required(VERSION 3.20.0)

find_package(Zephyr REQUIRED HINTS $ENV{ZEPHYR_BASE})

project(protocols_serialization_server)

# NORDIC SDK APP START
target_sources(app PRIVATE src/main.c)

if(CONFIG_NRF_PS_SERVER_FATAL_ERROR_TRIGGER)
    target_sources(app PRIVATE src/fatal_error_trigger.c)
endif()
# NORDIC SDK APP END

# Link OpenThread CLI even though OPENTHREAD_SHELL is not selected
if(CONFIG_OPENTHREAD_RPC)
    zephyr_link_libraries(openthread-cli-ftd)
endif()
```

## Kconfig
```
#
# Copyright (c) 2024 Nordic Semiconductor ASA
#
# SPDX-License-Identifier: LicenseRef-Nordic-5-Clause
#

menu "Protocols serialization server"

choice LOG_MODE
	default LOG_MODE_DEFERRED
endchoice

config LOG_BUFFER_SIZE
	default 8192

config LOG_FUNC_NAME_PREFIX_DBG
	default n

config LOG_BACKEND_RTT
	default n

config LOG_BACKEND_UART
	default n

if SOC_NRF54L15

config BT_CTLR_ECDH
	default n

config BT_USE_PSA_API
	default y if BT_TINYCRYPT_ECC
	select PSA_WANT_ALG_ECB_NO_PADDING

config BT_LONG_WQ_STACK_SIZE
	default 2048 if BT_USE_PSA_API

endif

config NRF_PS_SERVER_FATAL_ERROR_TRIGGER
	bool "Fatal error trigger"
	select DK_LIBRARY
	help
	  Enables triggering a fatal error by pressing Button 1 on the development
	  kit. This trigger allows for testing the feature of logging over RPC that
	  provides an RPC client with access to the crash log stored in the retained
	  RAM partition.

module = NRF_PS_SERVER
module-str = nrf_ps_server
source "${ZEPHYR_BASE}/subsys/logging/Kconfig.template.log_config"

endmenu # "Protocols serialization server"

menu "Zephyr Kernel"
source "Kconfig.zephyr"
endmenu
```

## sample.yaml
```
sample:
  name: Protocols serialization server sample
  description: Demonstrates serialization of Bluetooth LE and OpenThread API using nRF RPC
tests:
  samples.nrf_rpc.protocols_serialization.server.rpc_ble:
    build_only: true
    platform_allow: >
      nrf52840dk/nrf52840
      nrf54l15dk/nrf54l15/cpuapp
    tags: ci_build ci_samples_nrf_rpc
    extra_args: >
      SNIPPET="ble"
    integration_platforms:
      - nrf52840dk/nrf52840
      - nrf54l15dk/nrf54l15/cpuapp
  samples.nrf_rpc.protocols_serialization.server.rpc_ot:
    build_only: true
    platform_allow: >
      nrf52840dk/nrf52840
      nrf54l15dk/nrf54l15/cpuapp
    tags: ci_build ci_samples_nrf_rpc
    extra_args: >
      SNIPPET="openthread"
    integration_platforms:
      - nrf52840dk/nrf52840
      - nrf54l15dk/nrf54l15/cpuapp
  samples.nrf_rpc.protocols_serialization.server.rpc:
    build_only: true
    platform_allow: >
      nrf52840dk/nrf52840
      nrf54l15dk/nrf54l15/cpuapp
    tags: ci_build ci_samples_nrf_rpc
    extra_args: >
      SNIPPET="ble;openthread;debug;coex;log_rpc"
    integration_platforms:
      - nrf52840dk/nrf52840
      - nrf54l15dk/nrf54l15/cpuapp
```

## prj.conf
```kconfig
#
# Copyright (c) 2024 Nordic Semiconductor
#
# SPDX-License-Identifier: LicenseRef-Nordic-5-Clause
#
CONFIG_HEAP_MEM_POOL_SIZE=4096

CONFIG_NRF_RPC=y
CONFIG_NRF_RPC_CBOR=y
CONFIG_NRF_RPC_ZCBOR_BACKUPS=1
CONFIG_NRF_RPC_THREAD_STACK_SIZE=4096
CONFIG_NRF_RPC_GROUP_INIT_WAIT_TIME=-1
CONFIG_NRF_RPC_UART_TRANSPORT=y
CONFIG_NRF_RPC_UART_RELIABLE=y

CONFIG_UART_LINE_CTRL=y
CONFIG_UART_INTERRUPT_DRIVEN=y

CONFIG_NRF_RPC_DEV_INFO=y
CONFIG_NRF_RPC_DEV_INFO_SERVER=y
```

## boards/nrf54l15dk_nrf54l15_cpuapp.conf
```kconfig
#
# Copyright (c) 2024 Nordic Semiconductor
#
# SPDX-License-Identifier: LicenseRef-Nordic-5-Clause
#
CONFIG_MAIN_STACK_SIZE=4196
CONFIG_NRF_RPC_THREAD_STACK_SIZE=6144

# USE HASH UID instead of HUK for this sample, because Partition Manager is not available
CONFIG_TRUSTED_STORAGE_BACKEND_AEAD_KEY_HASH_UID=y

# Workaround required as Zephyr L2 implies usage of NVS backend for settings.
# It should be removed once the proper fix will be applied in Zephyr.
CONFIG_NVS=n
CONFIG_ZMS=y
CONFIG_SETTINGS_ZMS=y
```

## src/main.c
```c
/*
 * Copyright (c) 2024 Nordic Semiconductor ASA
 *
 * SPDX-License-Identifier: LicenseRef-Nordic-5-Clause
 */

#include <zephyr/logging/log.h>

#include <nrf_rpc.h>

LOG_MODULE_REGISTER(nrf_ps_server, CONFIG_NRF_PS_SERVER_LOG_LEVEL);

static void err_handler(const struct nrf_rpc_err_report *report)
{
	LOG_ERR("nRF RPC error %d ocurred. See nRF RPC logs for more details", report->code);
}

int main(void)
{
	int ret;

	LOG_INF("Initializing RPC server");

	ret = nrf_rpc_init(err_handler);

	if (ret != 0) {
		LOG_ERR("RPC init failed");
	}

	LOG_INF("RPC server ready");

	return 0;
}
```

## src/fatal_error_trigger.c
```c
/*
 * Copyright (c) 2024 Nordic Semiconductor ASA
 *
 * SPDX-License-Identifier: LicenseRef-Nordic-5-Clause
 */

#include <dk_buttons_and_leds.h>

#include <zephyr/init.h>
#include <zephyr/kernel.h>
#include <zephyr/logging/log.h>

LOG_MODULE_DECLARE(nrf_ps_server, CONFIG_NRF_PS_SERVER_LOG_LEVEL);

static void button_handler(uint32_t button_state, uint32_t has_changed)
{
	if (button_state & DK_BTN1_MSK) {
		LOG_ERR("Fatal error button pressed - triggering k_oops");
		k_oops();
	}
}

static int button_handler_init(void)
{
	return dk_buttons_init(button_handler);
}

SYS_INIT(button_handler_init, APPLICATION, CONFIG_APPLICATION_INIT_PRIORITY);
```
