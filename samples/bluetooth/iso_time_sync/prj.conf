## Kconfig.sysbuild
```
#
# Copyright (c) 2023 Nordic Semiconductor
#
# SPDX-License-Identifier: LicenseRef-Nordic-5-Clause
#

source "${ZEPHYR_BASE}/share/sysbuild/Kconfig"

config NRF_DEFAULT_BLUETOOTH
	default y

config NETCORE_IPC_RADIO_BT_HCI_IPC
	default y
```

## sample.yaml
```
sample:
  description: Bluetooth ISO time sync sample
  name: Bluetooth ISO time sync
tests:
  sample.bluetooth.iso_time_sync:
    sysbuild: true
    build_only: true
    integration_platforms:
      - nrf52840dk/nrf52840
      - nrf52833dk/nrf52833
      - nrf5340dk/nrf5340/cpuapp
      - nrf54l15dk/nrf54l05/cpuapp
      - nrf54l15dk/nrf54l10/cpuapp
      - nrf54l15dk/nrf54l15/cpuapp
      - nrf54h20dk/nrf54h20/cpuapp
    platform_allow:
      - nrf52840dk/nrf52840
      - nrf52833dk/nrf52833
      - nrf5340dk/nrf5340/cpuapp
      - nrf54l15dk/nrf54l05/cpuapp
      - nrf54l15dk/nrf54l10/cpuapp
      - nrf54l15dk/nrf54l15/cpuapp
      - nrf54h20dk/nrf54h20/cpuapp
    tags: bluetooth ci_build sysbuild
```

## prj.conf
```kconfig
CONFIG_BT=y
CONFIG_BT_ISO_BROADCASTER=y
CONFIG_BT_ISO_SYNC_RECEIVER=y
CONFIG_BT_ISO_CENTRAL=y
CONFIG_BT_ISO_PERIPHERAL=y
CONFIG_BT_OBSERVER=y
CONFIG_BT_DEVICE_NAME="Nordic_ISO"

CONFIG_BT_MAX_CONN=5
CONFIG_BT_CTLR_SDC_PERIPHERAL_COUNT=1

CONFIG_BT_ISO_MAX_CHAN=4
CONFIG_BT_ISO_TX_BUF_COUNT=4
CONFIG_BT_CTLR_ADV_ISO_STREAM_COUNT=4
CONFIG_BT_CTLR_SYNC_ISO_STREAM_COUNT=4
CONFIG_BT_CTLR_CONN_ISO_STREAMS=4

CONFIG_BT_ISO_TX_MTU=6
CONFIG_BT_ISO_RX_MTU=23

CONFIG_CONSOLE=y
CONFIG_CONSOLE_SUBSYS=y
CONFIG_CONSOLE_HANDLER=y
CONFIG_CONSOLE_GETCHAR=y
```

## boards/nrf54h20dk_nrf54h20_cpuapp.overlay
```dts
&dppic130 {
	status = "okay";

	// Use channel 4 to connect the PPIB to the LED/GPIO
	owned-channels = <4>;
	sink-channels = <4>;
};

&dppic132 {
	status = "okay";

	// Use channel 4 to connect the GRTC to the PPIB.
	source-channels = < 4 >;
	owned-channels = <4>;
};

&grtc {
	status = "okay";

	// Change channel 6 to be owned by the application (not child)
	child-owned-channels = < 0x5>;
	// Change channel 6 to be secure
	nonsecure-channels = < 0x5>;
	owned-channels = < 0x4 0x5 0x6>;
};
```

## src/cis_peripheral.c
```c
/*
 * Copyright (c) 2024 Nordic Semiconductor ASA
 *
 * SPDX-License-Identifier: LicenseRef-Nordic-5-Clause
 */

/** CIS peripheral implementation for the time sync sample
 *
 * This file implements a device that acts as a CIS peripheral.
 * The peripheral can either be configured as a transmitter or a receiver.
 */

#include <zephyr/kernel.h>
#include <zephyr/bluetooth/bluetooth.h>
#include <zephyr/bluetooth/conn.h>
#include <zephyr/bluetooth/iso.h>
#include <zephyr/bluetooth/hci.h>

#include "iso_time_sync.h"

static bool configured_for_tx;

static const struct bt_data ad[] = {
	BT_DATA(BT_DATA_NAME_COMPLETE, CONFIG_BT_DEVICE_NAME, sizeof(CONFIG_BT_DEVICE_NAME) - 1),
};

static void connected(struct bt_conn *conn, uint8_t err)
{
	char addr[BT_ADDR_LE_STR_LEN];

	bt_addr_le_to_str(bt_conn_get_dst(conn), addr, sizeof(addr));

	if (err) {
		printk("Failed to connect to %s 0x%02x %s\n", addr, err, bt_hci_err_to_str(err));
		return;
	}

	printk("Connected: %s\n", addr);
}

static void disconnected(struct bt_conn *conn, uint8_t reason)
{
	char addr[BT_ADDR_LE_STR_LEN];

	bt_addr_le_to_str(bt_conn_get_dst(conn), addr, sizeof(addr));

	printk("Disconnected from %s, reason 0x%02x %s\n", addr, reason, bt_hci_err_to_str(reason));
}

static struct bt_conn_cb conn_callbacks = {
	.connected = connected,
	.disconnected = disconnected,
};

static int iso_accept(const struct bt_iso_accept_info *info, struct bt_iso_chan **chan)
{
	printk("Incoming request from %p\n", (void *)info->acl);

	struct bt_iso_chan **iso_channels =
		configured_for_tx ? iso_tx_channels_get() : iso_rx_channels_get();

	if (iso_channels[0]->iso) {
		printk("No channels available\n");
		return -ENOMEM;
	}

	*chan = iso_channels[0];

	return 0;
}

static struct bt_iso_server iso_server = {
#if defined(CONFIG_BT_SMP)
	.sec_level = BT_SECURITY_L1,
#endif /* CONFIG_BT_SMP */
	.accept = iso_accept,
};

void cis_peripheral_start(bool do_tx)
{
	int err;
	uint8_t unused_rtn = 0;

	configured_for_tx = do_tx;

	/* It is the central that sets the RTN */
	if (do_tx) {
		iso_tx_init(unused_rtn, NULL);
	} else {
		iso_rx_init(unused_rtn, NULL);
	}

	bt_conn_cb_register(&conn_callbacks);

	err = bt_iso_server_register(&iso_server);
	if (err) {
		printk("Unable to register ISO server (err %d)\n", err);
		return;
	}

	err = bt_le_adv_start(BT_LE_ADV_CONN, ad, ARRAY_SIZE(ad), NULL, 0);
	if (err) {
		printk("Advertising failed to start (err %d)\n", err);
		return;
	}

	printk("CIS peripheral started advertising\n");
}
```

## src/controller_time_nrf52.c
```c
/*
 * Copyright (c) 2024 Nordic Semiconductor ASA
 *
 * SPDX-License-Identifier: LicenseRef-Nordic-5-Clause
 */

/** This file implements controller time management for 52 Series devices
 *
 * As the controller clock is not directly accessible, the controller
 * time is obtained using a mirrored RTC peripheral.
 * To achieve microsecond accurate toggling, a timer peripheral is also used.
 */

#include <zephyr/kernel.h>
#include <zephyr/sys/barrier.h>
#include <mpsl_clock.h>
#include <nrfx_rtc.h>
#include <nrfx_timer.h>
#include <helpers/nrfx_gppi.h>
#include <hal/nrf_egu.h>
#include <soc.h>
#include "iso_time_sync.h"

static const nrfx_rtc_t app_rtc_instance = NRFX_RTC_INSTANCE(2);
static const nrfx_timer_t app_timer_instance = NRFX_TIMER_INSTANCE(1);

static uint8_t ppi_chan_on_rtc_match;
static volatile uint32_t num_rtc_overflows;

static uint32_t offset_ticks_and_controller_to_app_rtc;

static void rtc_isr_handler(nrfx_rtc_int_type_t int_type)
{
	if (int_type == NRFX_RTC_INT_OVERFLOW) {
		num_rtc_overflows++;
	}
}

static void unused_timer_isr_handler(nrf_timer_event_t event_type, void *ctx)
{
	ARG_UNUSED(event_type);
	ARG_UNUSED(ctx);
}

static int32_t rtc_diff_get(void)
{
	uint32_t controller_ticks = nrf_rtc_counter_get(NRF_RTC0);
	uint32_t app_ticks = nrf_rtc_counter_get(app_rtc_instance.p_reg);

	return controller_ticks - app_ticks;
}

static int rtc_config(void)
{
	int ret;

	const nrfx_rtc_config_t rtc_cfg = NRFX_RTC_DEFAULT_CONFIG;

	ret = nrfx_rtc_init(&app_rtc_instance, &rtc_cfg, rtc_isr_handler);
	if (ret != NRFX_SUCCESS) {
		printk("Failed initializing RTC (ret: %d)\n", ret - NRFX_ERROR_BASE_NUM);
		return -ENODEV;
	}

#ifndef BT_CTLR_SDC_BSIM_BUILD
	IRQ_CONNECT(NRFX_IRQ_NUMBER_GET(NRF_RTC_INST_GET(2)), IRQ_PRIO_LOWEST,
		    NRFX_RTC_INST_HANDLER_GET(2), NULL, 0);
#else
	IRQ_CONNECT(NRFX_IRQ_NUMBER_GET(NRF_RTC_INST_GET(2)), 0,
		    (void *)NRFX_RTC_INST_HANDLER_GET(2), NULL, 0);
#endif

	nrfx_rtc_overflow_enable(&app_rtc_instance, true);
	nrfx_rtc_tick_enable(&app_rtc_instance, false);
	nrfx_rtc_enable(&app_rtc_instance);

	/* To obtain the controller timestamp without modifying the state of RTC0,
	 * we find the offset between RTC0 and our mirrored RTC.
	 * We achieve this by reading out the counter value of both of them.
	 * When the diff between those two have been equal twice, we know the
	 * time difference in ticks.
	 */

	uint32_t sync_attempts = 10;

	while (sync_attempts > 0) {
		sync_attempts--;

		int32_t diff_measurement_1 = rtc_diff_get();

		/* We need to wait half an RTC tick to ensure we are not measuring
		 * the diff between the two RTCs at the point in time where their
		 * values are transitioning.
		 */
		k_busy_wait(15);

		int32_t diff_measurement_2 = rtc_diff_get();

		if (diff_measurement_1 == diff_measurement_2) {
			offset_ticks_and_controller_to_app_rtc = diff_measurement_1;
			return 0;
		}
	}

	printk("Controller time sync failure\n");
	offset_ticks_and_controller_to_app_rtc = 0;
	return -EINVAL;
}

static int timer_config(void)
{
	int ret;
	uint8_t ppi_chan_timer_clear_on_rtc_tick;
	const nrfx_timer_config_t timer_cfg = {
		.frequency = NRFX_MHZ_TO_HZ(1UL),
		.mode = NRF_TIMER_MODE_TIMER,
		.bit_width = NRF_TIMER_BIT_WIDTH_8,
		.interrupt_priority = NRFX_TIMER_DEFAULT_CONFIG_IRQ_PRIORITY,
		.p_context = NULL};

	ret = nrfx_timer_init(&app_timer_instance, &timer_cfg, unused_timer_isr_handler);
	if (ret != NRFX_SUCCESS) {
		printk("Failed initializing timer (ret: %d)\n", ret - NRFX_ERROR_BASE_NUM);
		return -ENODEV;
	}

	/* Clear the TIMER every RTC tick. */
	if (nrfx_gppi_channel_alloc(&ppi_chan_timer_clear_on_rtc_tick) != NRFX_SUCCESS) {
		printk("Failed allocating for clearing TIMER on RTC TICK\n");
		return -ENOMEM;
	}

	nrfx_gppi_channel_endpoints_setup(ppi_chan_timer_clear_on_rtc_tick,
					  nrfx_rtc_event_address_get(&app_rtc_instance,
								     NRF_RTC_EVENT_TICK),
					  nrfx_timer_task_address_get(&app_timer_instance,
								      NRF_TIMER_TASK_CLEAR));

	nrfx_gppi_channels_enable(BIT(ppi_chan_timer_clear_on_rtc_tick));

	nrfx_timer_enable(&app_timer_instance);

	return 0;
}

/** Configure the TIMER and RTC in such a way that microsecond accurate timing can be achieved.
 *
 * To get microsecond accurate toggling, we need to combine both the RTC and TIMER peripheral.
 * That is, both a RTC CC value and TIMER CC value needs to be set.
 * We should only trigger an EGU task when the TIMER CC value matches after the
 * RTC CC value matched.
 * This is achieved using a PPI group. The group is enabled when the RTC CC matches and disabled
 * again then the TIMER CC matches.
 */
int config_egu_trigger_on_rtc_and_timer_match(void)
{
	uint8_t ppi_chan_on_timer_match;

	if (nrfx_gppi_channel_alloc(&ppi_chan_on_rtc_match) != NRFX_SUCCESS) {
		printk("Failed allocating for RTC match\n");
		return -ENOMEM;
	}

	if (nrfx_gppi_channel_alloc(&ppi_chan_on_timer_match) != NRFX_SUCCESS) {
		printk("Failed allocating for TIMER match\n");
		return -ENOMEM;
	}

	nrfx_gppi_group_clear(NRFX_GPPI_CHANNEL_GROUP0);
	nrfx_gppi_group_disable(NRFX_GPPI_CHANNEL_GROUP0);
	nrfx_gppi_channels_include_in_group(
		BIT(ppi_chan_on_timer_match) | BIT(ppi_chan_on_rtc_match),
		NRFX_GPPI_CHANNEL_GROUP0);

	nrfx_gppi_channel_endpoints_setup(ppi_chan_on_rtc_match,
					  nrfx_rtc_event_address_get(&app_rtc_instance,
								     NRF_RTC_EVENT_COMPARE_0),
					  nrfx_gppi_task_address_get(NRFX_GPPI_TASK_CHG0_EN));

	nrfx_gppi_channel_endpoints_setup(ppi_chan_on_timer_match,
					  nrfx_timer_event_address_get(&app_timer_instance,
								       NRF_TIMER_EVENT_COMPARE0),
					  nrf_egu_task_address_get(NRF_EGU0,
								   NRF_EGU_TASK_TRIGGER0));
	nrfx_gppi_fork_endpoint_setup(ppi_chan_on_timer_match,
				      nrfx_gppi_task_address_get(NRFX_GPPI_TASK_CHG0_DIS));

	return 0;
}

int controller_time_init(void)
{
	int ret;

	ret = rtc_config();
	if (ret) {
		return ret;
	}

	ret = timer_config();
	if (ret) {
		return ret;
	}

	return config_egu_trigger_on_rtc_and_timer_match();
}

static uint64_t rtc_ticks_to_us(uint32_t rtc_ticks)
{
	const uint64_t rtc_ticks_in_femto_units = 30517578125UL;

	return (rtc_ticks * rtc_ticks_in_femto_units) / 1000000000UL;
}

static uint32_t us_to_rtc_ticks(uint32_t timestamp_us)
{
	const uint64_t rtc_ticks_in_femto_units = 30517578125UL;

	return ((uint64_t)(timestamp_us) * 1000000000UL) / rtc_ticks_in_femto_units;
}

uint64_t controller_time_us_get(void)
{
	const uint64_t rtc_overflow_time_us = 512000000UL;

	/* On the 52 series the RTC has to task to capture the current RTC value.
	 * Therefore we cannot capture the TIMER and RTC value simultaneously.
	 * Therefore we only use the RTC to read out the current time here.
	 * This will result in an error of maximum one RTC tick.
	 */

	uint32_t captured_rtc_overflows;
	uint32_t captured_rtc_ticks;

	while (true) {
		captured_rtc_overflows = num_rtc_overflows;

		/* Read out RTC ticks after reading number of overflows. */
		barrier_isync_fence_full();

		captured_rtc_ticks = nrf_rtc_counter_get(app_rtc_instance.p_reg);

		/* Read out number of overflows after reading number of RTC ticks  */
		barrier_isync_fence_full();

		if (captured_rtc_overflows == num_rtc_overflows) {
			/* There were no new overflows after reading ticks.
			 * That is, we can use the captured value.
			 */
			break;
		}
	}

	return rtc_ticks_to_us(captured_rtc_ticks) +
	       (captured_rtc_overflows * rtc_overflow_time_us) +
	       rtc_ticks_to_us(offset_ticks_and_controller_to_app_rtc);
}

void controller_time_trigger_set(uint64_t timestamp_us)
{
	uint64_t timestamp_without_rtc_offset =
		timestamp_us - rtc_ticks_to_us(offset_ticks_and_controller_to_app_rtc);

	uint32_t num_overflows = timestamp_without_rtc_offset / 512000000UL;
	uint64_t overflow_time_us = num_overflows * 512000000UL;

	uint32_t rtc_remainder_time_us = timestamp_without_rtc_offset - overflow_time_us;
	uint32_t rtc_val = us_to_rtc_ticks(rtc_remainder_time_us);
	uint8_t timer_val =	timestamp_without_rtc_offset - rtc_ticks_to_us(rtc_val);

	/* Ensure the timer value lies between 1 and 30 so that it will
	 * always be between two RTC ticks.
	 */
	timer_val = MAX(timer_val, 1);
	timer_val = MIN(timer_val, 30);

	if (nrfx_rtc_cc_set(&app_rtc_instance, 0, rtc_val, false) != NRFX_SUCCESS) {
		printk("Failed setting trigger\n");
	}

	nrfx_timer_compare(&app_timer_instance, 0, timer_val, false);
	nrfx_gppi_channels_enable(BIT(ppi_chan_on_rtc_match));
}

uint32_t controller_time_trigger_event_addr_get(void)
{
	return nrf_egu_event_address_get(NRF_EGU0, NRF_EGU_EVENT_TRIGGERED0);
}

SYS_INIT(controller_time_init, POST_KERNEL, CONFIG_KERNEL_INIT_PRIORITY_DEFAULT);
```

## src/controller_time_nrf53_app.c
```c
/*
 * Copyright (c) 2024 Nordic Semiconductor ASA
 *
 * SPDX-License-Identifier: LicenseRef-Nordic-5-Clause
 */

/** This file implements controller time management for 53 Series devices
 *
 * As the controller clock is not directly accessible, the controller
 * time is obtained using a mirrored RTC peripheral.
 * The RTC is started upon starting the controller clock on the network core.
 * To achieve microsecond accurate toggling, a timer peripheral is also used.
 */

#include <zephyr/kernel.h>
#include <zephyr/init.h>
#include <zephyr/sys/barrier.h>
#include <helpers/nrfx_gppi.h>
#include <nrfx_rtc.h>
#include <nrfx_timer.h>
#include <hal/nrf_ipc.h>
#include <hal/nrf_egu.h>
#include "iso_time_sync.h"

static const nrfx_rtc_t app_rtc_instance = NRFX_RTC_INSTANCE(0);
static const nrfx_timer_t app_timer_instance = NRFX_TIMER_INSTANCE(0);

static uint8_t ppi_chan_on_rtc_match;
static volatile uint32_t num_rtc_overflows;

static void rtc_isr_handler(nrfx_rtc_int_type_t int_type)
{
	if (int_type == NRFX_RTC_INT_OVERFLOW) {
		num_rtc_overflows++;
	}
}

static void unused_timer_isr_handler(nrf_timer_event_t event_type, void *ctx)
{
	ARG_UNUSED(event_type);
	ARG_UNUSED(ctx);
}

static int rtc_config(void)
{
	int ret;
	uint8_t dppi_channel_rtc_start;
	const nrfx_rtc_config_t rtc_cfg = NRFX_RTC_DEFAULT_CONFIG;

	ret = nrfx_rtc_init(&app_rtc_instance, &rtc_cfg, rtc_isr_handler);
	if (ret != NRFX_SUCCESS) {
		printk("Failed initializing RTC (ret: %d)\n", ret - NRFX_ERROR_BASE_NUM);
		return -ENODEV;
	}

#ifndef BT_CTLR_SDC_BSIM_BUILD
	IRQ_CONNECT(NRFX_IRQ_NUMBER_GET(NRF_RTC_INST_GET(0)), IRQ_PRIO_LOWEST,
		    NRFX_RTC_INST_HANDLER_GET(0), NULL, 0);
#else
	IRQ_CONNECT(NRFX_IRQ_NUMBER_GET(NRF_RTC_INST_GET(0)), 0,
		    (void *)NRFX_RTC_INST_HANDLER_GET(0), NULL, 0);
#endif

	nrfx_rtc_overflow_enable(&app_rtc_instance, true);
	nrfx_rtc_tick_enable(&app_rtc_instance, false);
	nrfx_rtc_enable(&app_rtc_instance);


	/* The application core RTC is started synchronously with the controller
	 * RTC using PPI over IPC.
	 */
	ret = nrfx_gppi_channel_alloc(&dppi_channel_rtc_start);
	if (ret != NRFX_SUCCESS) {
		printk("nrfx DPPI channel alloc error for starting RTC: %d", ret);
		return -ENODEV;
	}

	nrf_ipc_receive_config_set(NRF_IPC, 4, NRF_IPC_CHANNEL_4);

	nrfx_gppi_channel_endpoints_setup(dppi_channel_rtc_start,
					  nrfx_rtc_task_address_get(&app_rtc_instance,
								     NRF_RTC_TASK_CLEAR),
					  nrf_ipc_event_address_get(NRF_IPC,
								    NRF_IPC_EVENT_RECEIVE_4));

	nrfx_gppi_channels_enable(BIT(dppi_channel_rtc_start));

	return 0;
}

static int timer_config(void)
{
	int ret;
	uint8_t ppi_chan_timer_clear_on_rtc_tick;
	const nrfx_timer_config_t timer_cfg = {
		.frequency = NRFX_MHZ_TO_HZ(1UL),
		.mode = NRF_TIMER_MODE_TIMER,
		.bit_width = NRF_TIMER_BIT_WIDTH_8,
		.interrupt_priority = NRFX_TIMER_DEFAULT_CONFIG_IRQ_PRIORITY,
		.p_context = NULL};

	ret = nrfx_timer_init(&app_timer_instance, &timer_cfg, unused_timer_isr_handler);
	if (ret != NRFX_SUCCESS) {
		printk("Failed initializing timer (ret: %d)\n", ret - NRFX_ERROR_BASE_NUM);
		return -ENODEV;
	}

	/* Clear the TIMER every RTC tick. */
	if (nrfx_gppi_channel_alloc(&ppi_chan_timer_clear_on_rtc_tick) != NRFX_SUCCESS) {
		printk("Failed allocating for clearing TIMER on RTC TICK\n");
		return -ENOMEM;
	}

	nrfx_gppi_channel_endpoints_setup(ppi_chan_timer_clear_on_rtc_tick,
					  nrfx_rtc_event_address_get(&app_rtc_instance,
								     NRF_RTC_EVENT_TICK),
					  nrfx_timer_task_address_get(&app_timer_instance,
								      NRF_TIMER_TASK_CLEAR));

	nrfx_gppi_channels_enable(BIT(ppi_chan_timer_clear_on_rtc_tick));

	nrfx_timer_enable(&app_timer_instance);

	return 0;
}

/** Configure the TIMER and RTC in such a way that microsecond accurate timing can be achieved.
 *
 * To get microsecond accurate toggling, we need to combine both the RTC and TIMER peripheral.
 * That is, both a RTC CC value and TIMER CC value needs to be set.
 * We should only trigger an EGU task when the TIMER CC value
 * matches after the RTC CC value matched.
 * This is achieved using a PPI group. The group is enabled when the RTC CC matches and disabled
 * again then the TIMER CC matches.
 */
int config_egu_trigger_on_rtc_and_timer_match(void)
{
	uint8_t ppi_chan_on_timer_match;

	if (nrfx_gppi_channel_alloc(&ppi_chan_on_rtc_match) != NRFX_SUCCESS) {
		printk("Failed allocating for RTC match\n");
		return -ENOMEM;
	}

	if (nrfx_gppi_channel_alloc(&ppi_chan_on_timer_match) != NRFX_SUCCESS) {
		printk("Failed allocating for TIMER match\n");
		return -ENOMEM;
	}

	nrfx_gppi_group_clear(NRFX_GPPI_CHANNEL_GROUP0);
	nrfx_gppi_group_disable(NRFX_GPPI_CHANNEL_GROUP0);
	nrfx_gppi_channels_include_in_group(
		BIT(ppi_chan_on_timer_match) | BIT(ppi_chan_on_rtc_match),
		NRFX_GPPI_CHANNEL_GROUP0);

	nrfx_gppi_channel_endpoints_setup(ppi_chan_on_rtc_match,
					  nrfx_rtc_event_address_get(&app_rtc_instance,
								     NRF_RTC_EVENT_COMPARE_0),
					  nrfx_gppi_task_address_get(NRFX_GPPI_TASK_CHG0_EN));
	nrfx_gppi_channel_endpoints_setup(ppi_chan_on_timer_match,
					  nrfx_timer_event_address_get(&app_timer_instance,
								       NRF_TIMER_EVENT_COMPARE0),
					  nrfx_gppi_task_address_get(NRFX_GPPI_TASK_CHG0_DIS));
	nrfx_gppi_fork_endpoint_setup(ppi_chan_on_timer_match,
				      nrf_egu_task_address_get(NRF_EGU0, NRF_EGU_TASK_TRIGGER0));

	return 0;
}

int controller_time_init(void)
{
	int ret;

	ret = rtc_config();
	if (ret) {
		return ret;
	}

	ret = timer_config();
	if (ret) {
		return ret;
	}

	return config_egu_trigger_on_rtc_and_timer_match();
}

static uint64_t rtc_ticks_to_us(uint32_t rtc_ticks)
{
	const uint64_t rtc_ticks_in_femto_units = 30517578125UL;

	return (rtc_ticks * rtc_ticks_in_femto_units) / 1000000000UL;
}

static uint32_t us_to_rtc_ticks(uint32_t timestamp_us)
{
	const uint64_t rtc_ticks_in_femto_units = 30517578125UL;

	return ((uint64_t)(timestamp_us) * 1000000000UL) / rtc_ticks_in_femto_units;
}

uint64_t controller_time_us_get(void)
{
	/* Simply use the RTC time here.
	 * It is possible to combine RTC and TIMER information here to get a more accurate
	 * timestamp. That requires setting up a PPI channel to capture both values simultaneously.
	 */

	const uint64_t rtc_overflow_time_us = 512000000UL;

	uint32_t captured_rtc_overflows;
	uint32_t captured_rtc_ticks;

	while (true) {
		captured_rtc_overflows = num_rtc_overflows;

		/* Read out RTC ticks after reading number of overflows. */
		barrier_isync_fence_full();

		captured_rtc_ticks = nrf_rtc_counter_get(app_rtc_instance.p_reg);

		/* Read out number of overflows after reading number of RTC ticks  */
		barrier_isync_fence_full();

		if (captured_rtc_overflows == num_rtc_overflows) {
			/* There were no new overflows after reading ticks.
			 * That is, we can use the captured value.
			 */
			break;
		}
	}

	return rtc_ticks_to_us(captured_rtc_ticks) +
	       (captured_rtc_overflows * rtc_overflow_time_us);
}

void controller_time_trigger_set(uint64_t timestamp_us)
{
	uint32_t num_overflows = timestamp_us / 512000000UL;
	uint64_t overflow_time_us = num_overflows * 512000000UL;

	uint32_t remainder_time_us = timestamp_us - overflow_time_us;
	uint32_t rtc_val = us_to_rtc_ticks(remainder_time_us);
	uint8_t timer_val = timestamp_us - rtc_ticks_to_us(rtc_val);

	/* Ensure the timer value lies between 1 and 30 so that it will
	 * always be between two RTC ticks.
	 */
	timer_val = MAX(timer_val, 1);
	timer_val = MIN(timer_val, 30);

	if (nrfx_rtc_cc_set(&app_rtc_instance, 0, rtc_val, false) != NRFX_SUCCESS) {
		printk("Failed setting trigger\n");
	}

	nrfx_timer_compare(&app_timer_instance, 0, timer_val, false);
	nrfx_gppi_channels_enable(BIT(ppi_chan_on_rtc_match));
}

uint32_t controller_time_trigger_event_addr_get(void)
{
	return nrf_egu_event_address_get(NRF_EGU0, NRF_EGU_EVENT_TRIGGERED0);
}

/* The controller time initialization must happen before
 * starting the network core.
 */
SYS_INIT(controller_time_init, POST_KERNEL, CONFIG_KERNEL_INIT_PRIORITY_DEFAULT);
```

## src/iso_rx.c
```c
/*
 * Copyright (c) 2024 Nordic Semiconductor ASA
 *
 * SPDX-License-Identifier: LicenseRef-Nordic-5-Clause
 */

/** This file implements receiving SDUs for the time sync demo
 *
 * When a valid SDU is received two things are done:
 *  1. A LED is toggled immediately
 *  2. A timer trigger is configured to toggle another LED
 *     CONFIG_TIMED_LED_PRESENTATION_DELAY_US after the received timestamp.
 *     This will ensure that all receivers toggle it at the same time.
 */

#include <zephyr/kernel.h>
#include <zephyr/bluetooth/iso.h>
#include <zephyr/device.h>
#include <zephyr/drivers/gpio.h>
#include "iso_time_sync.h"

static void iso_recv(struct bt_iso_chan *chan, const struct bt_iso_recv_info *info,
		     struct net_buf *buf);
static void iso_connected(struct bt_iso_chan *chan);
static void iso_disconnected(struct bt_iso_chan *chan, uint8_t reason);

static void (*iso_chan_disconnected_cb)(void);

static struct gpio_dt_spec led_sdu_received = GPIO_DT_SPEC_GET_OR(DT_ALIAS(led0), gpios, {0});

static struct bt_iso_chan_ops iso_ops = {
	.recv = iso_recv,
	.connected = iso_connected,
	.disconnected = iso_disconnected,
};

static struct bt_iso_chan_io_qos iso_rx_qos = {
	.sdu = SDU_SIZE_BYTES,
	.phy = BT_GAP_LE_PHY_2M,
};

static struct bt_iso_chan_qos iso_qos = {
	.rx = &iso_rx_qos,
};

static struct bt_iso_chan iso_chan[] = {
	{
		.ops = &iso_ops,
		.qos = &iso_qos,
	},
};

static struct bt_iso_chan *iso_channels[] = {
	&iso_chan[0],
};

static void iso_recv(struct bt_iso_chan *chan, const struct bt_iso_recv_info *info,
		     struct net_buf *buf)
{
	if ((info->flags & BT_ISO_FLAGS_VALID) == 0) {
		/* The packet should be valid. */
		return;
	}

	if ((info->flags & BT_ISO_FLAGS_TS) == 0) {
		/* The packet should contain a timestamp */
		return;
	}

	if (buf->len != SDU_SIZE_BYTES) {
		return;
	}

	uint32_t counter = net_buf_remove_le32(buf);
	uint8_t btn_pressed = net_buf_remove_u8(buf);

	if (IS_ENABLED(CONFIG_LED_TOGGLE_IMMEDIATELY_ON_SEND_OR_RECEIVE)) {
		gpio_pin_set_dt(&led_sdu_received, btn_pressed);
	}

	uint32_t trigger_time_us = info->ts + CONFIG_TIMED_LED_PRESENTATION_DELAY_US;

	timed_led_toggle_trigger_at(btn_pressed, trigger_time_us);

	if (counter % 100 == 0) {
		uint32_t current_time_us = controller_time_us_get() & UINT32_MAX;
		int32_t time_to_trigger = trigger_time_us - current_time_us;

		printk("Recv SDU counter %u with timestamp %u us, controller_time %u us, btn_val: %d, LED will be set in %d us\n",
		       counter, info->ts, current_time_us, btn_pressed, time_to_trigger);
	}
}

static void iso_connected(struct bt_iso_chan *chan)
{
	int err;
	struct bt_conn_info conn_info;
	struct bt_iso_info iso_info;

	err = bt_iso_chan_get_info(chan, &iso_info);
	if (err) {
		printk("Failed obtaining ISO info\n");
		return;
	}

	err = bt_conn_get_info(chan->iso, &conn_info);
	if (err) {
		printk("Failed obtaining conn info\n");
		return;
	}

	printk("ISO Channel connected: ");
	iso_chan_info_print(&iso_info, conn_info.role);
}

static void iso_disconnected(struct bt_iso_chan *chan, uint8_t reason)
{
	printk("ISO Channel disconnected with reason 0x%02x\n", reason);

	if (iso_chan_disconnected_cb) {
		iso_chan_disconnected_cb();
	}
}

void iso_rx_init(uint8_t retransmission_number, void (*iso_disconnected_cb)(void))
{
	int err;

	iso_chan_disconnected_cb = iso_disconnected_cb;

	iso_rx_qos.rtn = retransmission_number;

	if (IS_ENABLED(CONFIG_LED_TOGGLE_IMMEDIATELY_ON_SEND_OR_RECEIVE)) {
		err = gpio_pin_configure_dt(&led_sdu_received, GPIO_OUTPUT_INACTIVE);
		if (err != 0) {
			printk("Error %d: failed to configure LED device %s pin %d\n", err,
				led_sdu_received.port->name, led_sdu_received.pin);
		}
	}
}

struct bt_iso_chan **iso_rx_channels_get(void)
{
	return iso_channels;
}
```

## src/iso_tx.c
```c
/*
 * Copyright (c) 2024 Nordic Semiconductor ASA
 *
 * SPDX-License-Identifier: LicenseRef-Nordic-5-Clause
 */

/** This file implements transmitting SDUs for the time sync demo
 *
 * Each SDU contains a counter and the current value of a button.
 * The implementation ensures the following:
 *
 * 1. The SDU is transmitted right before it is supposed to be
 *    sent on air.
 * 2. The SDU is transmitted on all the connected isochronous channels
 *    with the same timestamp. This ensures that all the receivers
 *    can toggle their corresponding LEDs at the same time.
 * 3. A LED is toggled when the data is sent. This can be used
 *    to observe the end-to-end latency.s
 * 4. A LED is toggled when the LED is supposed to be toggled on the
 *    receiving side.
 */

#include <zephyr/kernel.h>
#include <zephyr/device.h>
#include <zephyr/drivers/gpio.h>
#include <zephyr/bluetooth/iso.h>
#include <bluetooth/hci_vs_sdc.h>
#include <sdc_hci.h>

#include "iso_time_sync.h"

static const struct gpio_dt_spec button = GPIO_DT_SPEC_GET_OR(DT_ALIAS(sw0), gpios, {0});
static struct gpio_dt_spec led_on_sdu_send = GPIO_DT_SPEC_GET_OR(DT_ALIAS(led0), gpios, {0});

static void iso_sent(struct bt_iso_chan *chan);
static void iso_connected(struct bt_iso_chan *chan);
static void iso_disconnected(struct bt_iso_chan *chan, uint8_t reason);

static void (*iso_chan_connected_cb)(void);

NET_BUF_POOL_FIXED_DEFINE(tx_pool, CONFIG_BT_ISO_MAX_CHAN,
			  BT_ISO_SDU_BUF_SIZE(CONFIG_BT_ISO_TX_MTU),
			  CONFIG_BT_CONN_TX_USER_DATA_SIZE, NULL);

static bool first_sdu_sent;
static uint32_t tx_sdu_timestamp_us;
static uint32_t num_sdus_sent;

static void sdu_timer_expired(struct k_timer *timer);
static K_TIMER_DEFINE(sdu_timer, sdu_timer_expired, NULL);

static struct bt_iso_chan_ops iso_ops = {
	.connected = iso_connected,
	.sent = iso_sent,
	.disconnected = iso_disconnected,
};

static struct bt_iso_chan_io_qos iso_tx_qos = {
	.sdu = SDU_SIZE_BYTES,
	.phy = BT_GAP_LE_PHY_2M,
};

static struct bt_iso_chan_qos iso_qos = {
	.tx = &iso_tx_qos,
};

/* Create lists of ISO channels and pointers to ISO channels. */
#define _ISO_CHANNEL(_n, _)  {.ops = &iso_ops, .qos = &iso_qos}
static struct bt_iso_chan iso_channels[] = {
	LISTIFY(CONFIG_BT_ISO_MAX_CHAN, _ISO_CHANNEL, (,))
};

#define _ISO_CHANNEL_PTR(_n, _) &iso_channels[_n]
static struct bt_iso_chan *iso_channel_pointers[] = {
	LISTIFY(CONFIG_BT_ISO_MAX_CHAN, _ISO_CHANNEL_PTR, (,))
};

static bool iso_channels_awaiting_iso_sent_cb[CONFIG_BT_ISO_MAX_CHAN];

/* Store info about the ISO channels in use. */
static uint8_t roles[CONFIG_BT_ISO_MAX_CHAN];
static struct bt_iso_info iso_infos[CONFIG_BT_ISO_MAX_CHAN];

void iso_chan_info_print(struct bt_iso_info *info, uint8_t role)
{
	if (info->type == BT_ISO_CHAN_TYPE_CONNECTED) {
		uint8_t bn;
		uint32_t flush_timeout;
		uint32_t transport_latency_us;

		if (role == BT_CONN_ROLE_CENTRAL) {
			bn = info->can_send ?
				info->unicast.central.bn :
				info->unicast.peripheral.bn;
			flush_timeout = info->can_send ?
				info->unicast.central.flush_timeout :
				info->unicast.peripheral.flush_timeout;
			transport_latency_us = info->can_send ?
				info->unicast.central.latency :
				info->unicast.peripheral.latency;
		} else {
			bn = info->can_send ?
				info->unicast.peripheral.bn :
				info->unicast.central.bn;
			flush_timeout = info->can_send ?
				info->unicast.peripheral.flush_timeout :
				info->unicast.central.flush_timeout;
			transport_latency_us = info->can_send ?
				info->unicast.peripheral.latency :
				info->unicast.central.latency;
		}

		printk("interval: %d ms, NSE: %d, BN: %d, FT: %d, transport latency: %d us\n",
				info->iso_interval * 1250 / 1000,
				info->max_subevent,
				bn,
				flush_timeout / info->iso_interval,
				transport_latency_us);
	} else if (info->type == BT_ISO_CHAN_TYPE_BROADCASTER) {
		printk("interval: %d ms, NSE: %d, BN: %d, IRC: %d, PTO: %d, transport latency: %d us\n",
				info->iso_interval * 1250 / 1000,
				info->max_subevent,
				info->broadcaster.bn,
				info->broadcaster.irc,
				info->broadcaster.pto / info->iso_interval,
				info->broadcaster.latency);
	} else if (info->type == BT_ISO_CHAN_TYPE_SYNC_RECEIVER) {
		printk("interval: %d ms, NSE: %d, BN: %d, IRC: %d, PTO: %d, transport latency: %d us\n",
				info->iso_interval * 1250 / 1000,
				info->max_subevent,
				info->sync_receiver.bn,
				info->sync_receiver.irc,
				info->sync_receiver.pto / info->iso_interval,
				info->sync_receiver.latency);
	} else {
		printk("Unknown ISO channel type %d\n", info->type);
	}
}

static int iso_tx_time_stamp_get(struct bt_conn *conn, uint32_t *time_stamp)
{
	int err;
	uint16_t conn_handle = 0;
	sdc_hci_cmd_vs_iso_read_tx_timestamp_t params;
	sdc_hci_cmd_vs_iso_read_tx_timestamp_return_t rsp;

	err = bt_hci_get_conn_handle(conn, &conn_handle);
	if (err) {
		printk("Failed to get conn_handle %d\n", err);
		return err;
	}

	params.conn_handle = conn_handle;

	err = hci_vs_sdc_iso_read_tx_timestamp(&params, &rsp);
	if (err) {
		return err;
	}

	*time_stamp = rsp.tx_time_stamp;

	return 0;
}

static int send_next_sdu(struct bt_iso_chan *chan, bool btn_pressed)
{
	struct net_buf *buf;

	buf = net_buf_alloc(&tx_pool, K_FOREVER);
	if (!buf) {
		printk("Data buffer allocate timeout\n");
		return -ENOMEM;
	}

	net_buf_reserve(buf, BT_ISO_CHAN_SEND_RESERVE);
	net_buf_add_u8(buf, btn_pressed);
	net_buf_add_le32(buf, num_sdus_sent);

	if (first_sdu_sent) {
		return bt_iso_chan_send_ts(chan, buf, 0, tx_sdu_timestamp_us);
	} else {
		return bt_iso_chan_send(chan, buf, 0);
	}

	return 0;
}

static void send_next_sdu_on_all_channels(void)
{
	int err;
	bool btn_pressed = (bool)gpio_pin_get_dt(&button);

	if (IS_ENABLED(CONFIG_LED_TOGGLE_IMMEDIATELY_ON_SEND_OR_RECEIVE)) {
		gpio_pin_set_dt(&led_on_sdu_send, btn_pressed);
	}

	for (size_t i = 0; i < CONFIG_BT_ISO_MAX_CHAN; i++) {

		if (iso_channels[i].state != BT_ISO_STATE_CONNECTED) {
			continue;
		}

		err = send_next_sdu(&iso_channels[i], btn_pressed);
		if (err) {
			printk("Failed sending SDU, counter %d, index %d\n", num_sdus_sent, i);
			return;
		}

		/* Toggle that we are awaiting iso_sent callback on this channel */
		iso_channels_awaiting_iso_sent_cb[i] = true;

		if (!first_sdu_sent) {
			/* The first time we send an SDU, we send it without timestamp.
			 * After that we always send SDUs with timestamps to ensure they
			 * are time synchronized on all channels.
			 *
			 * To avoid reading the timestamp both after sending SDUs and after
			 * the first SDU, we break out early here the very first event.
			 */
			break;
		}
	}
}

static void iso_connected(struct bt_iso_chan *chan)
{
	int err;
	struct bt_conn_info conn_info;
	uint8_t chan_index = ARRAY_INDEX(iso_channels, chan);

	err = bt_iso_chan_get_info(chan, &iso_infos[chan_index]);
	if (err) {
		printk("Failed obtaining ISO info\n");
		return;
	}

	err = bt_conn_get_info(chan->iso, &conn_info);
	if (err) {
		printk("Failed obtaining conn info\n");
		return;
	}

	roles[chan_index] = conn_info.role;

	printk("ISO channel index %d connected: ", chan_index);
	iso_chan_info_print(&iso_infos[chan_index], roles[chan_index]);

	if (iso_chan_connected_cb) {
		iso_chan_connected_cb();
	}

	if (!first_sdu_sent) {
		/* Send the first SDU immediately.
		 * The following SDUs will be sent time-aligned with the controller clock.
		 */
		send_next_sdu_on_all_channels();
	}
}

static void iso_disconnected(struct bt_iso_chan *chan, uint8_t reason)
{
	uint32_t chan_index = ARRAY_INDEX(iso_channels, chan);

	printk("ISO Channel index %d disconnected with reason 0x%02x\n",
	       chan_index, reason);

	iso_channels_awaiting_iso_sent_cb[chan_index] = false;
}

static bool send_more_sdus_with_same_timestamp(struct bt_iso_chan *chan)
{
	if (first_sdu_sent) {
		struct bt_iso_chan *last_chan = NULL;

		/** Check if this is the last ISO channel where we are awaiting
		 * an iso_sent callback. If that is the case, that callback will
		 * be used to send SDUs on all ISO channels.
		 */
		for (size_t i = 0; i < CONFIG_BT_ISO_MAX_CHAN; i++) {
			if (iso_channels_awaiting_iso_sent_cb[i]) {
				last_chan = &iso_channels[i];
			}
		}

		if (chan != last_chan) {
			return true;
		} else {
			return false;
		}
	}

	/* The very first SDU is sent on one channel only. */
	first_sdu_sent = true;
	return false;
}

static uint32_t trigger_time_us_get(uint32_t sdu_sync_ref, uint8_t chan_index)
{
	uint32_t trigger_time_us = sdu_sync_ref + CONFIG_TIMED_LED_PRESENTATION_DELAY_US;

	/* The ISO type determines when to trigger the LED
	 * because of how the SDU synchronization reference is defined.
	 * See Bluetooth Core Specification, Vol 6, Part G, Section 3.2.
	 */

	if (iso_infos[chan_index].type == BT_ISO_CHAN_TYPE_CONNECTED) {
		if (roles[chan_index] == BT_CONN_ROLE_CENTRAL) {
			trigger_time_us += iso_infos[chan_index].unicast.central.latency;
		}
	} else {
		trigger_time_us += iso_infos[chan_index].broadcaster.latency;
	}

	return trigger_time_us;
}

static void iso_sent(struct bt_iso_chan *chan)
{
	int err;
	uint32_t assigned_timestamp;

	if (send_more_sdus_with_same_timestamp(chan)) {
		return;
	}

	err = iso_tx_time_stamp_get(chan->iso, &assigned_timestamp);
	if (err) {
		printk("Failed obtaining timestamp\n");
		return;
	}

	uint8_t chan_index = ARRAY_INDEX(iso_channels, chan);

	/* Set the LED to toggle in sync with all the receivers. */
	bool btn_pressed = (bool)gpio_pin_get_dt(&button);
	uint32_t trigger_time_us = trigger_time_us_get(assigned_timestamp,
						       chan_index);
	timed_led_toggle_trigger_at(btn_pressed, trigger_time_us);

	/* Set up a timer to trigger right before the next set of SDUs are to be sent. */
	uint32_t controller_time_us = controller_time_us_get() & UINT32_MAX;
	int32_t time_to_next_sdu_us =
		assigned_timestamp + CONFIG_SDU_INTERVAL_US
		- controller_time_us
		- HCI_ISO_TX_SDU_ARRIVAL_MARGIN_US;

	/** Update the sent SDU counter before starting
	 * the timer that triggers when the next SDU is sent.
	 * This is done to ensure that counter is updated in time.
	 */
	uint32_t prev_sent_sdu = num_sdus_sent;

	num_sdus_sent++;

	iso_channels_awaiting_iso_sent_cb[chan_index] = false;

	k_timer_start(&sdu_timer, K_USEC(time_to_next_sdu_us), K_NO_WAIT);

	/* Increment the SDU timestamp with one SDU interval. */
	tx_sdu_timestamp_us = assigned_timestamp + CONFIG_SDU_INTERVAL_US;

	if (prev_sent_sdu % 100 == 0) {
		int32_t time_to_trigger = trigger_time_us - controller_time_us;

		printk("Sent SDU counter %u with timestamp %u us, controller_time %u us, ",
			   prev_sent_sdu, assigned_timestamp, controller_time_us);
		printk("btn_val: %d LED will be set in %d us\n",
			   btn_pressed, time_to_trigger);
	}
}

static void sdu_timer_expired(struct k_timer *timer)
{
	ARG_UNUSED(timer);
	send_next_sdu_on_all_channels();
}

void iso_tx_init(uint8_t retransmission_number, void (*iso_connected_cb)(void))
{
	int err;
	iso_chan_connected_cb = iso_connected_cb;

	iso_tx_qos.rtn = retransmission_number;

	if (IS_ENABLED(CONFIG_LED_TOGGLE_IMMEDIATELY_ON_SEND_OR_RECEIVE)) {
		err = gpio_pin_configure_dt(&led_on_sdu_send, GPIO_OUTPUT_INACTIVE);
		if (err != 0) {
			printk("Error %d: failed to configure LED device %s pin %d\n", err,
				led_on_sdu_send.port->name, led_on_sdu_send.pin);
		}
	}

	err = gpio_pin_configure_dt(&button, GPIO_INPUT);
	if (err != 0) {
		printk("Error %d: failed to configure %s pin %d\n", err, button.port->name,
		       button.pin);
	}
}

struct bt_iso_chan **iso_tx_channels_get(void)
{
	return iso_channel_pointers;
}
```

## src/timed_led_toggle.c
```c
/*
 * Copyright (c) 2024 Nordic Semiconductor ASA
 *
 * SPDX-License-Identifier: LicenseRef-Nordic-5-Clause
 */

/** This file implements timed toggling a LED
 *
 * To achieve accurate toggling, it interacts with the controller
 * clock using PPI.
 */

#include <zephyr/kernel.h>
#include <zephyr/device.h>
#include <zephyr/drivers/gpio.h>
#include <soc.h>
#include <hal/nrf_rtc.h>
#include <nrfx_gpiote.h>
#include <helpers/nrfx_gppi.h>
#include "iso_time_sync.h"

#define GPIOTE_INST NRF_DT_GPIOTE_INST(DT_ALIAS(led1), gpios)
#define GPIOTE_NODE DT_NODELABEL(_CONCAT(gpiote, GPIOTE_INST))
#define LED_PIN NRF_DT_GPIOS_TO_PSEL(DT_ALIAS(led1), gpios)

BUILD_ASSERT(IS_ENABLED(_CONCAT(CONFIG_, _CONCAT(NRFX_GPIOTE, GPIOTE_INST))),
	     "NRFX_GPIOTE" STRINGIFY(GPIOTE_INST) " must be enabled in Kconfig");

static const nrfx_gpiote_t gpiote = NRFX_GPIOTE_INSTANCE(GPIOTE_INST);
static struct gpio_dt_spec led = GPIO_DT_SPEC_GET_OR(DT_ALIAS(led1), gpios, {0});

static uint8_t previous_led_value;

int timed_led_toggle_init(void)
{
	int err;
	uint8_t ppi_chan_led_toggle;
	uint8_t gpiote_chan_led_toggle;

	const nrfx_gpiote_output_config_t gpiote_output_cfg = NRFX_GPIOTE_DEFAULT_OUTPUT_CONFIG;

	err = gpio_pin_configure_dt(&led, GPIO_OUTPUT_INACTIVE);
	if (err != 0) {
		printk("Error %d: failed to configure LED device %s pin %d\n", err, led.port->name,
		       led.pin);
		return err;
	}

	if (nrfx_gpiote_channel_alloc(&gpiote, &gpiote_chan_led_toggle) != NRFX_SUCCESS) {
		printk("Failed allocating GPIOTE chan for setting led\n");
		return -ENOMEM;
	}

	const nrfx_gpiote_task_config_t task_cfg_led_toggle = {
		.task_ch = gpiote_chan_led_toggle,
		.polarity = NRF_GPIOTE_POLARITY_TOGGLE,
		.init_val = (led.dt_flags & GPIO_ACTIVE_LOW) ?
			NRF_GPIOTE_INITIAL_VALUE_HIGH : NRF_GPIOTE_INITIAL_VALUE_LOW,
	};

	if (nrfx_gpiote_output_configure(&gpiote, LED_PIN, &gpiote_output_cfg,
					 &task_cfg_led_toggle) != NRFX_SUCCESS) {
		printk("Failed configuring GPIOTE chan for toggling led\n");
		return -ENOMEM;
	}

	if (nrfx_gppi_channel_alloc(&ppi_chan_led_toggle) != NRFX_SUCCESS) {
		printk("Failed allocating PPI chan for toggling led\n");
		return -ENOMEM;
	}

	nrfx_gppi_channel_endpoints_setup(ppi_chan_led_toggle,
					  controller_time_trigger_event_addr_get(),
					  nrfx_gpiote_out_task_address_get(&gpiote, LED_PIN));

	nrfx_gppi_channels_enable(BIT(ppi_chan_led_toggle));
	nrfx_gpiote_out_task_enable(&gpiote, LED_PIN);

	return 0;
}

void timed_led_toggle_trigger_at(uint8_t value, uint32_t timestamp_us)
{
	if (value == previous_led_value) {
		/* No need to set up trigger, as a trigger has already been configured. */
		return;
	}

	/* First obtain the full 64-bit time. */
	const uint64_t current_time_us = controller_time_us_get();
	const uint64_t current_time_most_significant_word = current_time_us & 0xFFFFFFFF00000000UL;

	uint64_t full_timestamp_us = current_time_most_significant_word | timestamp_us;

	if (timestamp_us < (current_time_us & UINT32_MAX)) {
		/* Trigger time is after UINT32 wrap */
		full_timestamp_us += 0x100000000UL;
	}

	controller_time_trigger_set(full_timestamp_us);

	previous_led_value = value;
}
```
