## sample.yaml
```
sample:
  name: nRF Device Provisioning
tests:
  sample.cellular.nrf_provisioning:
    sysbuild: true
    build_only: true
    integration_platforms:
      - nrf9151dk/nrf9151/ns
      - nrf9161dk/nrf9161/ns
    platform_allow:
      - nrf9151dk/nrf9151/ns
      - nrf9160dk/nrf9160/ns
      - nrf9161dk/nrf9161/ns
    tags: sysbuild ci_samples_cellular
```

## prj.conf
```kconfig
#
# Copyright (c) 2023 Nordic Semiconductor ASA
#
# SPDX-License-Identifier: LicenseRef-Nordic-5-Clause
#
CONFIG_NRF_PROVISIONING=y
CONFIG_NRF_PROVISIONING_AUTO_INIT=n
CONFIG_NRF_PROVISIONING_HTTP=y

# Include a certificate as part of the binary. Used only if none has been provisioned
CONFIG_NRF_PROVISIONING_WITH_CERT=y

# Shell
CONFIG_SETTINGS_SHELL=y
CONFIG_NRF_PROVISIONING_SHELL=y
CONFIG_SHELL=y

# Provisioning message content format
CONFIG_NRF_PROVISIONING_CODEC=y
CONFIG_NRF_PROVISIONING_CBOR=y
CONFIG_ZCBOR=y
CONFIG_ZCBOR_CANONICAL=y

# Max provisioning commands per response
CONFIG_NRF_PROVISIONING_CBOR_RECORDS=20

# Maximum length between provisioning requests
CONFIG_NRF_PROVISIONING_INTERVAL_S=86400

# Request spread factor
CONFIG_NRF_PROVISIONING_SPREAD_S=5

# Device's RX buffer size.
# May need to be increased when provisioning large certificates
CONFIG_NRF_PROVISIONING_RX_BUF_SZ=2048

# Networking
CONFIG_NETWORKING=y
CONFIG_NET_SOCKETS=y
CONFIG_POSIX_API=y
CONFIG_NET_NATIVE=n

# MCUBOOT
CONFIG_BOOTLOADER_MCUBOOT=y

# LTE link control
CONFIG_LTE_LINK_CONTROL=y

# Enable settings storage
CONFIG_SETTINGS=y
CONFIG_SETTINGS_FCB=y
CONFIG_FCB=y
CONFIG_FLASH_MAP=y
CONFIG_FLASH=y
CONFIG_FLASH_PAGE_LAYOUT=y

# Enable Date Time service
CONFIG_DATE_TIME=y

# Modem info
CONFIG_MODEM_INFO=y
CONFIG_MODEM_INFO_ADD_DEVICE=n
CONFIG_MODEM_INFO_ADD_NETWORK=n
CONFIG_MODEM_INFO_ADD_SIM=n

# Modem key management
CONFIG_MODEM_KEY_MGMT=y
CONFIG_MODEM_JWT=y
CONFIG_MODEM_ATTEST_TOKEN=y

# System
CONFIG_HEAP_MEM_POOL_SIZE=16384
CONFIG_MAIN_STACK_SIZE=2048
CONFIG_REBOOT=y
CONFIG_FPU=y

# Logging
CONFIG_LOG=y
CONFIG_LOG_MODE_IMMEDIATE=y
CONFIG_UART_INTERRUPT_DRIVEN=y

# Server settings
CONFIG_NRF_PROVISIONING_ROOT_CA_SEC_TAG=50
```

## overlay-at_shell.conf
```kconfig
# Enable AT shell
CONFIG_AT_SHELL=y

# Increase RX ring buffer and command line buffer
# to enable writing of certificates from AT shell
CONFIG_SHELL_BACKEND_SERIAL_RX_RING_BUFFER_SIZE=512
CONFIG_SHELL_CMD_BUFF_SIZE=2048
```

## overlay-coap.conf
```kconfig
# COAP provisioning
CONFIG_NRF_PROVISIONING_HTTP=n
CONFIG_NRF_PROVISIONING_COAP=y
CONFIG_NRF_PROVISIONING_ROOT_CA_SEC_TAG=42

# CoAP client
CONFIG_COAP=y
CONFIG_COAP_EXTENDED_OPTIONS_LEN=y
CONFIG_COAP_EXTENDED_OPTIONS_LEN_VALUE=64
CONFIG_COAP_CLIENT=y
CONFIG_COAP_CLIENT_MESSAGE_SIZE=1536

CONFIG_NET_IPV6=n
CONFIG_NET_IPV4=y
CONFIG_NET_SOCKETS_OFFLOAD=y
```

## src/main.c
```c
/*
 * Copyright (c) 2023 Nordic Semiconductor ASA
 *
 * SPDX-License-Identifier: LicenseRef-Nordic-5-Clause
 */

#include <stdio.h>

#include <zephyr/kernel.h>
#include <zephyr/logging/log.h>
#include <zephyr/logging/log_ctrl.h>
#include <zephyr/sys/reboot.h>

#include <modem/lte_lc.h>
#include <modem/nrf_modem_lib.h>
#include <net/nrf_provisioning.h>
#include "nrf_provisioning_at.h"

LOG_MODULE_REGISTER(nrf_provisioning_sample, CONFIG_NRF_PROVISIONING_SAMPLE_LOG_LEVEL);

static struct nrf_provisioning_dm_change dmode;
static struct nrf_provisioning_mm_change mmode;

static int modem_mode_cb(enum lte_lc_func_mode new_mode, void *user_data)
{
	enum lte_lc_func_mode fmode;
	char time_buf[64];
	int ret;

	ARG_UNUSED(user_data);

	if (lte_lc_func_mode_get(&fmode)) {
		LOG_ERR("Failed to read modem functional mode");
		ret = -EFAULT;
		return ret;
	}

	if (fmode == new_mode) {
		ret = fmode;
	} else if (new_mode == LTE_LC_FUNC_MODE_NORMAL) {
		/* Use the blocking call, because in next step
		 * the service will create a socket and call connect()
		 */
		ret = lte_lc_connect();

		if (ret) {
			LOG_ERR("lte_lc_connect() failed %d", ret);
		}
		LOG_INF("Modem connection restored");

		LOG_INF("Waiting for modem to acquire network time...");

		do {
			k_sleep(K_SECONDS(3));
			ret = nrf_provisioning_at_time_get(time_buf, sizeof(time_buf));
		} while (ret != 0);

		LOG_INF("Network time obtained");
		ret = fmode;
	} else {
		ret = lte_lc_func_mode_set(new_mode);
		if (ret == 0) {
			LOG_DBG("Modem set to requested state %d", new_mode);
			ret = fmode;
		}
	}

	return ret;
}

static void reboot_device(void)
{
	/* Disconnect from network gracefully */
	int ret = lte_lc_func_mode_set(LTE_LC_FUNC_MODE_OFFLINE);

	if (ret != 0) {
		LOG_ERR("Unable to set modem offline, error %d", ret);
	}

	while (log_process()) {
		;
	}

	sys_reboot(SYS_REBOOT_WARM);
}

static void device_mode_cb(enum nrf_provisioning_event event, void *user_data)
{
	ARG_UNUSED(user_data);

	switch (event) {
	case NRF_PROVISIONING_EVENT_START:
		LOG_INF("Provisioning started");
		break;
	case NRF_PROVISIONING_EVENT_STOP:
		LOG_INF("Provisioning stopped");
		break;
	case NRF_PROVISIONING_EVENT_DONE:
		LOG_INF("Provisioning done, rebooting...");
		reboot_device();
		break;
	default:
		LOG_ERR("Unknown event");
		break;
	}
}

int main(void)
{
	int ret;

	mmode.cb = modem_mode_cb;
	mmode.user_data = NULL;
	dmode.cb = device_mode_cb;
	dmode.user_data = NULL;

	LOG_INF("nRF Device Provisioning Sample");

	ret = nrf_modem_lib_init();
	if (ret < 0) {
		LOG_ERR("Unable to init modem library (%d)", ret);
		return 0;
	}

	LOG_INF("Establishing LTE link ...");
	ret = lte_lc_connect();
	if (ret) {
		LOG_ERR("LTE link could not be established (%d)", ret);
		return 0;
	}

	if (!IS_ENABLED(CONFIG_NRF_PROVISIONING_AUTO_INIT)) {
		ret = nrf_provisioning_init(&mmode, &dmode);
		if (ret) {
			LOG_ERR("Failed to initialize provisioning client");
		}
	}

	return 0;
}
```
