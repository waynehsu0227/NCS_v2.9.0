## sample.yaml
```
sample:
  name: GNSS sample
tests:
  sample.cellular.gnss:
    sysbuild: true
    build_only: true
    integration_platforms:
      - nrf9151dk/nrf9151/ns
      - nrf9160dk/nrf9160/ns
      - nrf9161dk/nrf9161/ns
    platform_allow:
      - nrf9151dk/nrf9151/ns
      - nrf9160dk/nrf9160/ns
      - nrf9161dk/nrf9161/ns
    tags: ci_build sysbuild ci_samples_cellular

  # Following configurations will be used by the positioning CI integration job to verify PRs
  sample.cellular.gnss.integration_config_positioning_agnss_nrfcloud_ltem_pvt:
    sysbuild: true
    build_only: true
    extra_configs:
      - CONFIG_LTE_NETWORK_MODE_LTE_M_GPS=y
      - CONFIG_LTE_NETWORK_MODE_NBIOT_GPS=n
      - CONFIG_GNSS_SAMPLE_LTE_ON_DEMAND=y
      - CONFIG_GNSS_SAMPLE_ASSISTANCE_NRF_CLOUD=y
      - CONFIG_GNSS_SAMPLE_NMEA_ONLY=n
      - CONFIG_GNSS_SAMPLE_MODE_PERIODIC=n
      - CONFIG_GNSS_SAMPLE_ASSISTANCE_MINIMAL=n
      - CONFIG_LTE_LC_EDRX_MODULE=y
      - CONFIG_LTE_EDRX_REQ=y
      - CONFIG_FPU=y
      - CONFIG_GNSS_SAMPLE_REFERENCE_LATITUDE="61.49375330"
      - CONFIG_GNSS_SAMPLE_REFERENCE_LONGITUDE="23.77588976"
      - CONFIG_MODEM_ANTENNA_GNSS_EXTERNAL=y
      - CONFIG_LOG_BUFFER_SIZE=2048
    extra_args: gnss_SNIPPET="nrf91-modem-trace-uart"
    integration_platforms:
      - nrf9151dk/nrf9151/ns
    platform_allow:
      - nrf9151dk/nrf9151/ns
    tags: ci_build sysbuild ci_samples_cellular
  sample.cellular.gnss.integration_config_positioning_agnss_nrfcloud_nbiot_nmea_lte_on:
    sysbuild: true
    build_only: true
    extra_configs:
      - CONFIG_LTE_NETWORK_MODE_LTE_M_GPS=n
      - CONFIG_LTE_NETWORK_MODE_NBIOT_GPS=y
      - CONFIG_GNSS_SAMPLE_LTE_ON_DEMAND=n
      - CONFIG_GNSS_SAMPLE_ASSISTANCE_NRF_CLOUD=y
      - CONFIG_GNSS_SAMPLE_NMEA_ONLY=y
      - CONFIG_GNSS_SAMPLE_MODE_PERIODIC=n
      - CONFIG_GNSS_SAMPLE_ASSISTANCE_MINIMAL=n
      - CONFIG_LTE_LC_EDRX_MODULE=y
      - CONFIG_LTE_EDRX_REQ=y
      - CONFIG_FPU=y
      - CONFIG_GNSS_SAMPLE_REFERENCE_LATITUDE="61.49375330"
      - CONFIG_GNSS_SAMPLE_REFERENCE_LONGITUDE="23.77588976"
      - CONFIG_MODEM_ANTENNA_GNSS_EXTERNAL=y
      - CONFIG_LOG_BUFFER_SIZE=2048
    extra_args: gnss_SNIPPET="nrf91-modem-trace-uart"
    integration_platforms:
      - nrf9151dk/nrf9151/ns
    platform_allow:
      - nrf9151dk/nrf9151/ns
    tags: ci_build sysbuild ci_samples_cellular
  sample.cellular.gnss.integration_config_positioning_pgps_nrfcloud_ltem_nmea:
    sysbuild: true
    build_only: true
    extra_configs:
      - CONFIG_LTE_NETWORK_MODE_LTE_M_GPS=y
      - CONFIG_LTE_NETWORK_MODE_NBIOT_GPS=n
      - CONFIG_GNSS_SAMPLE_LTE_ON_DEMAND=n
      - CONFIG_GNSS_SAMPLE_ASSISTANCE_NRF_CLOUD=n
      - CONFIG_GNSS_SAMPLE_NMEA_ONLY=y
      - CONFIG_GNSS_SAMPLE_MODE_PERIODIC=n
      - CONFIG_GNSS_SAMPLE_ASSISTANCE_MINIMAL=n
      - CONFIG_LTE_EDRX_REQ=n
      - CONFIG_FPU=y
      - CONFIG_GNSS_SAMPLE_REFERENCE_LATITUDE="61.49375330"
      - CONFIG_GNSS_SAMPLE_REFERENCE_LONGITUDE="23.77588976"
      - CONFIG_MODEM_ANTENNA_GNSS_EXTERNAL=y
      - CONFIG_LOG_BUFFER_SIZE=2048
    extra_args:
      - EXTRA_CONF_FILE=overlay-pgps.conf
      - gnss_SNIPPET="nrf91-modem-trace-uart"
    integration_platforms:
      - nrf9151dk/nrf9151/ns
    platform_allow:
      - nrf9151dk/nrf9151/ns
    tags: ci_build sysbuild ci_samples_cellular
  sample.cellular.gnss.integration_config_positioning_gnss_ltem_pvt:
    sysbuild: true
    build_only: true
    extra_configs:
      - CONFIG_LTE_NETWORK_MODE_LTE_M_GPS=y
      - CONFIG_LTE_NETWORK_MODE_NBIOT_GPS=n
      - CONFIG_GNSS_SAMPLE_LTE_ON_DEMAND=n
      - CONFIG_GNSS_SAMPLE_ASSISTANCE_NRF_CLOUD=n
      - CONFIG_GNSS_SAMPLE_NMEA_ONLY=n
      - CONFIG_GNSS_SAMPLE_MODE_PERIODIC=n
      - CONFIG_GNSS_SAMPLE_ASSISTANCE_MINIMAL=n
      - CONFIG_LTE_LC_EDRX_MODULE=y
      - CONFIG_LTE_EDRX_REQ=y
      - CONFIG_FPU=y
      - CONFIG_GNSS_SAMPLE_REFERENCE_LATITUDE="61.49375330"
      - CONFIG_GNSS_SAMPLE_REFERENCE_LONGITUDE="23.77588976"
      - CONFIG_MODEM_ANTENNA_GNSS_EXTERNAL=y
      - CONFIG_LOG_BUFFER_SIZE=2048
    extra_args: gnss_SNIPPET="nrf91-modem-trace-uart"
    integration_platforms:
      - nrf9151dk/nrf9151/ns
    platform_allow:
      - nrf9151dk/nrf9151/ns
    tags: ci_build sysbuild ci_samples_cellular
```

## prj.conf
```kconfig
#
# Copyright (c) 2019 Nordic Semiconductor ASA
#
# SPDX-License-Identifier: LicenseRef-Nordic-5-Clause
#

# General
CONFIG_FPU=y
CONFIG_NRF_MODEM_LIB=y
CONFIG_STDOUT_CONSOLE=y
CONFIG_UART_INTERRUPT_DRIVEN=y
CONFIG_PICOLIBC_IO_FLOAT=y
CONFIG_LOG=y
CONFIG_LOG_MODE_IMMEDIATE=y

# GNSS sample
# Enable to use nRF Cloud A-GNSS
CONFIG_GNSS_SAMPLE_ASSISTANCE_NRF_CLOUD=n

# LTE Link Control
CONFIG_LTE_LINK_CONTROL=y
# Request eDRX from the network
CONFIG_LTE_LC_EDRX_MODULE=y
CONFIG_LTE_EDRX_REQ=y
# PSM requested periodic TAU 8 hours
CONFIG_LTE_LC_PSM_MODULE=y
CONFIG_LTE_PSM_REQ_RPTAU="00101000"
# PSM requested active time 6 seconds
CONFIG_LTE_PSM_REQ_RAT="00000011"

# AT Host library - Used to send AT commands directy from an UART terminal and to allow
#		    integration with nRF Connect for Desktop LTE Link monitor application.
CONFIG_AT_HOST_LIBRARY=y

# Networking
CONFIG_NETWORKING=y
CONFIG_NET_SOCKETS_OFFLOAD=y
CONFIG_NET_SOCKETS=y
CONFIG_POSIX_API=y
# Disable native network stack to save some memory
CONFIG_NET_NATIVE=n

# Memory and stack configuration
CONFIG_HEAP_MEM_POOL_SIZE=2048
CONFIG_MAIN_STACK_SIZE=4096
CONFIG_SYSTEM_WORKQUEUE_STACK_SIZE=1536
```

## overlay-supl.conf
```kconfig
#
# Copyright (c) 2023 Nordic Semiconductor ASA
#
# SPDX-License-Identifier: LicenseRef-Nordic-5-Clause
#

# SUPL overlay configuration

# Enable SUPL assistance for GNSS sample
CONFIG_GNSS_SAMPLE_ASSISTANCE_SUPL=y

# SUPL client library requires that the newlib C library is used
CONFIG_NEWLIB_LIBC=y
CONFIG_NEWLIB_LIBC_FLOAT_PRINTF=y
```

## src/main.c
```c
/*
 * Copyright (c) 2019 Nordic Semiconductor ASA
 *
 * SPDX-License-Identifier: LicenseRef-Nordic-5-Clause
 */

#include <stdio.h>
#include <stdlib.h>
#include <string.h>
#include <math.h>
#include <zephyr/kernel.h>
#include <zephyr/logging/log.h>
#include <nrf_modem_at.h>
#include <nrf_modem_gnss.h>
#include <modem/lte_lc.h>
#include <modem/nrf_modem_lib.h>
#include <date_time.h>

LOG_MODULE_REGISTER(gnss_sample, CONFIG_GNSS_SAMPLE_LOG_LEVEL);

#define PI 3.14159265358979323846
#define EARTH_RADIUS_METERS (6371.0 * 1000.0)

#if !defined(CONFIG_GNSS_SAMPLE_ASSISTANCE_NONE) || defined(CONFIG_GNSS_SAMPLE_MODE_TTFF_TEST)
static struct k_work_q gnss_work_q;

#define GNSS_WORKQ_THREAD_STACK_SIZE 2304
#define GNSS_WORKQ_THREAD_PRIORITY   5

K_THREAD_STACK_DEFINE(gnss_workq_stack_area, GNSS_WORKQ_THREAD_STACK_SIZE);
#endif /* !CONFIG_GNSS_SAMPLE_ASSISTANCE_NONE || CONFIG_GNSS_SAMPLE_MODE_TTFF_TEST */

#if !defined(CONFIG_GNSS_SAMPLE_ASSISTANCE_NONE)
#include "assistance.h"

static struct nrf_modem_gnss_agnss_data_frame last_agnss;
static struct k_work agnss_data_get_work;
static volatile bool requesting_assistance;
#endif /* !CONFIG_GNSS_SAMPLE_ASSISTANCE_NONE */

#if defined(CONFIG_GNSS_SAMPLE_MODE_TTFF_TEST)
static struct k_work_delayable ttff_test_got_fix_work;
static struct k_work_delayable ttff_test_prepare_work;
static struct k_work ttff_test_start_work;
static double time_to_fix;
#endif

static const char update_indicator[] = {'\\', '|', '/', '-'};

static struct nrf_modem_gnss_pvt_data_frame last_pvt;
static uint64_t fix_timestamp;
static uint32_t time_blocked;

/* Reference position. */
static bool ref_used;
static double ref_latitude;
static double ref_longitude;

K_MSGQ_DEFINE(nmea_queue, sizeof(struct nrf_modem_gnss_nmea_data_frame *), 10, 4);
static K_SEM_DEFINE(pvt_data_sem, 0, 1);
static K_SEM_DEFINE(time_sem, 0, 1);

static struct k_poll_event events[2] = {
	K_POLL_EVENT_STATIC_INITIALIZER(K_POLL_TYPE_SEM_AVAILABLE,
					K_POLL_MODE_NOTIFY_ONLY,
					&pvt_data_sem, 0),
	K_POLL_EVENT_STATIC_INITIALIZER(K_POLL_TYPE_MSGQ_DATA_AVAILABLE,
					K_POLL_MODE_NOTIFY_ONLY,
					&nmea_queue, 0),
};

BUILD_ASSERT(IS_ENABLED(CONFIG_LTE_NETWORK_MODE_LTE_M_GPS) ||
	     IS_ENABLED(CONFIG_LTE_NETWORK_MODE_NBIOT_GPS) ||
	     IS_ENABLED(CONFIG_LTE_NETWORK_MODE_LTE_M_NBIOT_GPS),
	     "CONFIG_LTE_NETWORK_MODE_LTE_M_GPS, "
	     "CONFIG_LTE_NETWORK_MODE_NBIOT_GPS or "
	     "CONFIG_LTE_NETWORK_MODE_LTE_M_NBIOT_GPS must be enabled");

BUILD_ASSERT((sizeof(CONFIG_GNSS_SAMPLE_REFERENCE_LATITUDE) == 1 &&
	      sizeof(CONFIG_GNSS_SAMPLE_REFERENCE_LONGITUDE) == 1) ||
	     (sizeof(CONFIG_GNSS_SAMPLE_REFERENCE_LATITUDE) > 1 &&
	      sizeof(CONFIG_GNSS_SAMPLE_REFERENCE_LONGITUDE) > 1),
	     "CONFIG_GNSS_SAMPLE_REFERENCE_LATITUDE and "
	     "CONFIG_GNSS_SAMPLE_REFERENCE_LONGITUDE must be both either set or empty");

/* Returns the distance between two coordinates in meters. The distance is calculated using the
 * haversine formula.
 */
static double distance_calculate(double lat1, double lon1,
				 double lat2, double lon2)
{
	double d_lat_rad = (lat2 - lat1) * PI / 180.0;
	double d_lon_rad = (lon2 - lon1) * PI / 180.0;

	double lat1_rad = lat1 * PI / 180.0;
	double lat2_rad = lat2 * PI / 180.0;

	double a = pow(sin(d_lat_rad / 2), 2) +
		   pow(sin(d_lon_rad / 2), 2) *
		   cos(lat1_rad) * cos(lat2_rad);

	double c = 2 * asin(sqrt(a));

	return EARTH_RADIUS_METERS * c;
}

static void print_distance_from_reference(struct nrf_modem_gnss_pvt_data_frame *pvt_data)
{
	if (!ref_used) {
		return;
	}

	double distance = distance_calculate(pvt_data->latitude, pvt_data->longitude,
					     ref_latitude, ref_longitude);

	if (IS_ENABLED(CONFIG_GNSS_SAMPLE_MODE_TTFF_TEST)) {
		LOG_INF("Distance from reference: %.01f", distance);
	} else {
		printf("\nDistance from reference: %.01f\n", distance);
	}
}

static void gnss_event_handler(int event)
{
	int retval;
	struct nrf_modem_gnss_nmea_data_frame *nmea_data;

	switch (event) {
	case NRF_MODEM_GNSS_EVT_PVT:
		retval = nrf_modem_gnss_read(&last_pvt, sizeof(last_pvt), NRF_MODEM_GNSS_DATA_PVT);
		if (retval == 0) {
			k_sem_give(&pvt_data_sem);
		}
		break;

#if defined(CONFIG_GNSS_SAMPLE_MODE_TTFF_TEST)
	case NRF_MODEM_GNSS_EVT_FIX:
		/* Time to fix is calculated here, but it's printed from a delayed work to avoid
		 * messing up the NMEA output.
		 */
		time_to_fix = (k_uptime_get() - fix_timestamp) / 1000.0;
		k_work_schedule_for_queue(&gnss_work_q, &ttff_test_got_fix_work, K_MSEC(100));
		k_work_schedule_for_queue(&gnss_work_q, &ttff_test_prepare_work,
					  K_SECONDS(CONFIG_GNSS_SAMPLE_MODE_TTFF_TEST_INTERVAL));
		break;
#endif /* CONFIG_GNSS_SAMPLE_MODE_TTFF_TEST */

	case NRF_MODEM_GNSS_EVT_NMEA:
		nmea_data = k_malloc(sizeof(struct nrf_modem_gnss_nmea_data_frame));
		if (nmea_data == NULL) {
			LOG_ERR("Failed to allocate memory for NMEA");
			break;
		}

		retval = nrf_modem_gnss_read(nmea_data,
					     sizeof(struct nrf_modem_gnss_nmea_data_frame),
					     NRF_MODEM_GNSS_DATA_NMEA);
		if (retval == 0) {
			retval = k_msgq_put(&nmea_queue, &nmea_data, K_NO_WAIT);
		}

		if (retval != 0) {
			k_free(nmea_data);
		}
		break;

	case NRF_MODEM_GNSS_EVT_AGNSS_REQ:
#if !defined(CONFIG_GNSS_SAMPLE_ASSISTANCE_NONE)
		retval = nrf_modem_gnss_read(&last_agnss,
					     sizeof(last_agnss),
					     NRF_MODEM_GNSS_DATA_AGNSS_REQ);
		if (retval == 0) {
			k_work_submit_to_queue(&gnss_work_q, &agnss_data_get_work);
		}
#endif /* !CONFIG_GNSS_SAMPLE_ASSISTANCE_NONE */
		break;

	default:
		break;
	}
}

#if !defined(CONFIG_GNSS_SAMPLE_ASSISTANCE_NONE)
#if defined(CONFIG_GNSS_SAMPLE_LTE_ON_DEMAND)
K_SEM_DEFINE(lte_ready, 0, 1);

static void lte_lc_event_handler(const struct lte_lc_evt *const evt)
{
	switch (evt->type) {
	case LTE_LC_EVT_NW_REG_STATUS:
		if ((evt->nw_reg_status == LTE_LC_NW_REG_REGISTERED_HOME) ||
		    (evt->nw_reg_status == LTE_LC_NW_REG_REGISTERED_ROAMING)) {
			LOG_INF("Connected to LTE network");
			k_sem_give(&lte_ready);
		}
		break;

	default:
		break;
	}
}

void lte_connect(void)
{
	int err;

	LOG_INF("Connecting to LTE network");

	err = lte_lc_func_mode_set(LTE_LC_FUNC_MODE_ACTIVATE_LTE);
	if (err) {
		LOG_ERR("Failed to activate LTE, error: %d", err);
		return;
	}

	k_sem_take(&lte_ready, K_FOREVER);

	/* Wait for a while, because with IPv4v6 PDN the IPv6 activation takes a bit more time. */
	k_sleep(K_SECONDS(1));
}

void lte_disconnect(void)
{
	int err;

	err = lte_lc_func_mode_set(LTE_LC_FUNC_MODE_DEACTIVATE_LTE);
	if (err) {
		LOG_ERR("Failed to deactivate LTE, error: %d", err);
		return;
	}

	LOG_INF("LTE disconnected");
}
#endif /* CONFIG_GNSS_SAMPLE_LTE_ON_DEMAND */

static const char *get_system_string(uint8_t system_id)
{
	switch (system_id) {
	case NRF_MODEM_GNSS_SYSTEM_INVALID:
		return "invalid";

	case NRF_MODEM_GNSS_SYSTEM_GPS:
		return "GPS";

	case NRF_MODEM_GNSS_SYSTEM_QZSS:
		return "QZSS";

	default:
		return "unknown";
	}
}

static void agnss_data_get_work_fn(struct k_work *item)
{
	ARG_UNUSED(item);

	int err;

	/* GPS data need is always expected to be present and first in list. */
	__ASSERT(last_agnss.system_count > 0,
		 "GNSS system data need not found");
	__ASSERT(last_agnss.system[0].system_id == NRF_MODEM_GNSS_SYSTEM_GPS,
		 "GPS data need not found");

#if defined(CONFIG_GNSS_SAMPLE_ASSISTANCE_SUPL)
	/* SUPL doesn't usually provide NeQuick ionospheric corrections and satellite real time
	 * integrity information. If GNSS asks only for those, the request should be ignored.
	 */
	if (last_agnss.system[0].sv_mask_ephe == 0 &&
	    last_agnss.system[0].sv_mask_alm == 0 &&
	    (last_agnss.data_flags & ~(NRF_MODEM_GNSS_AGNSS_NEQUICK_REQUEST |
				       NRF_MODEM_GNSS_AGNSS_INTEGRITY_REQUEST)) == 0) {
		LOG_INF("Ignoring assistance request for only NeQuick and/or integrity");
		return;
	}
#endif /* CONFIG_GNSS_SAMPLE_ASSISTANCE_SUPL */

#if defined(CONFIG_GNSS_SAMPLE_ASSISTANCE_MINIMAL)
	/* With minimal assistance, the request should be ignored if no GPS time or position
	 * is requested.
	 */
	if (!(last_agnss.data_flags & NRF_MODEM_GNSS_AGNSS_GPS_SYS_TIME_AND_SV_TOW_REQUEST) &&
	    !(last_agnss.data_flags & NRF_MODEM_GNSS_AGNSS_POSITION_REQUEST)) {
		LOG_INF("Ignoring assistance request because no GPS time or position is requested");
		return;
	}
#endif /* CONFIG_GNSS_SAMPLE_ASSISTANCE_MINIMAL */

	if (last_agnss.data_flags == 0 &&
	    last_agnss.system[0].sv_mask_ephe == 0 &&
	    last_agnss.system[0].sv_mask_alm == 0) {
		LOG_INF("Ignoring assistance request because only QZSS data is requested");
		return;
	}

	requesting_assistance = true;

	LOG_INF("Assistance data needed: data_flags: 0x%02x", last_agnss.data_flags);
	for (int i = 0; i < last_agnss.system_count; i++) {
		LOG_INF("Assistance data needed: %s ephe: 0x%llx, alm: 0x%llx",
			get_system_string(last_agnss.system[i].system_id),
			last_agnss.system[i].sv_mask_ephe,
			last_agnss.system[i].sv_mask_alm);
	}

#if defined(CONFIG_GNSS_SAMPLE_LTE_ON_DEMAND)
	lte_connect();
#endif /* CONFIG_GNSS_SAMPLE_LTE_ON_DEMAND */

	err = assistance_request(&last_agnss);
	if (err) {
		LOG_ERR("Failed to request assistance data");
	}

#if defined(CONFIG_GNSS_SAMPLE_LTE_ON_DEMAND)
	lte_disconnect();
#endif /* CONFIG_GNSS_SAMPLE_LTE_ON_DEMAND */

	requesting_assistance = false;
}
#endif /* !CONFIG_GNSS_SAMPLE_ASSISTANCE_NONE */

#if defined(CONFIG_GNSS_SAMPLE_MODE_TTFF_TEST)
static void ttff_test_got_fix_work_fn(struct k_work *item)
{
	LOG_INF("Time to fix: %.01f s", time_to_fix);
	if (time_blocked > 0) {
		LOG_INF("Time GNSS was blocked by LTE: %u s", time_blocked);
	}
	print_distance_from_reference(&last_pvt);
	LOG_INF("Sleeping for %u s", CONFIG_GNSS_SAMPLE_MODE_TTFF_TEST_INTERVAL);
}

static int ttff_test_force_cold_start(void)
{
	int err;
	uint32_t delete_mask;

	LOG_INF("Deleting GNSS data");

	/* Delete everything else except the TCXO offset. */
	delete_mask = NRF_MODEM_GNSS_DELETE_EPHEMERIDES |
		      NRF_MODEM_GNSS_DELETE_ALMANACS |
		      NRF_MODEM_GNSS_DELETE_IONO_CORRECTION_DATA |
		      NRF_MODEM_GNSS_DELETE_LAST_GOOD_FIX |
		      NRF_MODEM_GNSS_DELETE_GPS_TOW |
		      NRF_MODEM_GNSS_DELETE_GPS_WEEK |
		      NRF_MODEM_GNSS_DELETE_UTC_DATA |
		      NRF_MODEM_GNSS_DELETE_GPS_TOW_PRECISION;

	/* With minimal assistance, we want to keep the factory almanac. */
	if (IS_ENABLED(CONFIG_GNSS_SAMPLE_ASSISTANCE_MINIMAL)) {
		delete_mask &= ~NRF_MODEM_GNSS_DELETE_ALMANACS;
	}

	err = nrf_modem_gnss_nv_data_delete(delete_mask);
	if (err) {
		LOG_ERR("Failed to delete GNSS data");
		return -1;
	}

	return 0;
}

#if defined(CONFIG_GNSS_SAMPLE_ASSISTANCE_NRF_CLOUD)
static bool qzss_assistance_is_supported(void)
{
	char resp[32];

	if (nrf_modem_at_cmd(resp, sizeof(resp), "AT+CGMM") == 0) {
		/* nRF9160 does not support QZSS assistance, while nRF91x1 do. */
		if (strstr(resp, "nRF9160") != NULL) {
			return false;
		}
	}

	return true;
}
#endif /* CONFIG_GNSS_SAMPLE_ASSISTANCE_NRF_CLOUD */

static void ttff_test_prepare_work_fn(struct k_work *item)
{
	/* Make sure GNSS is stopped before next start. */
	nrf_modem_gnss_stop();

	if (IS_ENABLED(CONFIG_GNSS_SAMPLE_MODE_TTFF_TEST_COLD_START)) {
		if (ttff_test_force_cold_start() != 0) {
			return;
		}
	}

#if !defined(CONFIG_GNSS_SAMPLE_ASSISTANCE_NONE)
	if (IS_ENABLED(CONFIG_GNSS_SAMPLE_MODE_TTFF_TEST_COLD_START)) {
		/* All A-GNSS data is always requested before GNSS is started. */
		last_agnss.data_flags =
			NRF_MODEM_GNSS_AGNSS_GPS_UTC_REQUEST |
			NRF_MODEM_GNSS_AGNSS_KLOBUCHAR_REQUEST |
			NRF_MODEM_GNSS_AGNSS_NEQUICK_REQUEST |
			NRF_MODEM_GNSS_AGNSS_GPS_SYS_TIME_AND_SV_TOW_REQUEST |
			NRF_MODEM_GNSS_AGNSS_POSITION_REQUEST |
			NRF_MODEM_GNSS_AGNSS_INTEGRITY_REQUEST;
		last_agnss.system_count = 1;
		last_agnss.system[0].sv_mask_ephe = 0xffffffff;
		last_agnss.system[0].sv_mask_alm = 0xffffffff;
#if defined(CONFIG_GNSS_SAMPLE_ASSISTANCE_NRF_CLOUD)
		if (qzss_assistance_is_supported()) {
			last_agnss.system_count = 2;
			last_agnss.system[1].sv_mask_ephe = 0x3ff;
			last_agnss.system[1].sv_mask_alm = 0x3ff;
		}
#endif /* CONFIG_GNSS_SAMPLE_ASSISTANCE_NRF_CLOUD */

		k_work_submit_to_queue(&gnss_work_q, &agnss_data_get_work);
	} else {
		/* Start and stop GNSS to trigger possible A-GNSS data request. If new A-GNSS
		 * data is needed it is fetched before GNSS is started.
		 */
		nrf_modem_gnss_start();
		nrf_modem_gnss_stop();
	}
#endif /* !CONFIG_GNSS_SAMPLE_ASSISTANCE_NONE */

	k_work_submit_to_queue(&gnss_work_q, &ttff_test_start_work);
}

static void ttff_test_start_work_fn(struct k_work *item)
{
	LOG_INF("Starting GNSS");
	if (nrf_modem_gnss_start() != 0) {
		LOG_ERR("Failed to start GNSS");
		return;
	}

	fix_timestamp = k_uptime_get();
	time_blocked = 0;
}
#endif /* CONFIG_GNSS_SAMPLE_MODE_TTFF_TEST */

static void date_time_evt_handler(const struct date_time_evt *evt)
{
	k_sem_give(&time_sem);
}

static int modem_init(void)
{
	if (IS_ENABLED(CONFIG_DATE_TIME)) {
		date_time_register_handler(date_time_evt_handler);
	}

#if defined(CONFIG_GNSS_SAMPLE_LTE_ON_DEMAND)
	lte_lc_register_handler(lte_lc_event_handler);
#elif !defined(CONFIG_GNSS_SAMPLE_ASSISTANCE_NONE)
	lte_lc_psm_req(true);

	LOG_INF("Connecting to LTE network");

	if (lte_lc_connect() != 0) {
		LOG_ERR("Failed to connect to LTE network");
		return -1;
	}

	LOG_INF("Connected to LTE network");

	if (IS_ENABLED(CONFIG_DATE_TIME)) {
		LOG_INF("Waiting for current time");

		/* Wait for an event from the Date Time library. */
		k_sem_take(&time_sem, K_MINUTES(10));

		if (!date_time_is_valid()) {
			LOG_WRN("Failed to get current time, continuing anyway");
		}
	}
#endif

	return 0;
}

static int sample_init(void)
{
	int err = 0;

#if !defined(CONFIG_GNSS_SAMPLE_ASSISTANCE_NONE) || defined(CONFIG_GNSS_SAMPLE_MODE_TTFF_TEST)
	struct k_work_queue_config cfg = {
		.name = "gnss_work_q",
		.no_yield = false
	};

	k_work_queue_start(
		&gnss_work_q,
		gnss_workq_stack_area,
		K_THREAD_STACK_SIZEOF(gnss_workq_stack_area),
		GNSS_WORKQ_THREAD_PRIORITY,
		&cfg);
#endif /* !CONFIG_GNSS_SAMPLE_ASSISTANCE_NONE || CONFIG_GNSS_SAMPLE_MODE_TTFF_TEST */

#if !defined(CONFIG_GNSS_SAMPLE_ASSISTANCE_NONE)
	k_work_init(&agnss_data_get_work, agnss_data_get_work_fn);

	err = assistance_init(&gnss_work_q);
#endif /* !CONFIG_GNSS_SAMPLE_ASSISTANCE_NONE */

#if defined(CONFIG_GNSS_SAMPLE_MODE_TTFF_TEST)
	k_work_init_delayable(&ttff_test_got_fix_work, ttff_test_got_fix_work_fn);
	k_work_init_delayable(&ttff_test_prepare_work, ttff_test_prepare_work_fn);
	k_work_init(&ttff_test_start_work, ttff_test_start_work_fn);
#endif /* CONFIG_GNSS_SAMPLE_MODE_TTFF_TEST */

	return err;
}

static int gnss_init_and_start(void)
{
#if defined(CONFIG_GNSS_SAMPLE_ASSISTANCE_NONE) || defined(CONFIG_GNSS_SAMPLE_LTE_ON_DEMAND)
	/* Enable GNSS. */
	if (lte_lc_func_mode_set(LTE_LC_FUNC_MODE_ACTIVATE_GNSS) != 0) {
		LOG_ERR("Failed to activate GNSS functional mode");
		return -1;
	}
#endif /* CONFIG_GNSS_SAMPLE_ASSISTANCE_NONE || CONFIG_GNSS_SAMPLE_LTE_ON_DEMAND */

	/* Configure GNSS. */
	if (nrf_modem_gnss_event_handler_set(gnss_event_handler) != 0) {
		LOG_ERR("Failed to set GNSS event handler");
		return -1;
	}

	/* Enable all supported NMEA messages. */
	uint16_t nmea_mask = NRF_MODEM_GNSS_NMEA_RMC_MASK |
			     NRF_MODEM_GNSS_NMEA_GGA_MASK |
			     NRF_MODEM_GNSS_NMEA_GLL_MASK |
			     NRF_MODEM_GNSS_NMEA_GSA_MASK |
			     NRF_MODEM_GNSS_NMEA_GSV_MASK;

	if (nrf_modem_gnss_nmea_mask_set(nmea_mask) != 0) {
		LOG_ERR("Failed to set GNSS NMEA mask");
		return -1;
	}

	/* Make QZSS satellites visible in the NMEA output. */
	if (nrf_modem_gnss_qzss_nmea_mode_set(NRF_MODEM_GNSS_QZSS_NMEA_MODE_CUSTOM) != 0) {
		LOG_WRN("Failed to enable custom QZSS NMEA mode");
	}

	/* This use case flag should always be set. */
	uint8_t use_case = NRF_MODEM_GNSS_USE_CASE_MULTIPLE_HOT_START;

	if (IS_ENABLED(CONFIG_GNSS_SAMPLE_MODE_PERIODIC) &&
	    !IS_ENABLED(CONFIG_GNSS_SAMPLE_ASSISTANCE_NONE)) {
		/* Disable GNSS scheduled downloads when assistance is used. */
		use_case |= NRF_MODEM_GNSS_USE_CASE_SCHED_DOWNLOAD_DISABLE;
	}

	if (IS_ENABLED(CONFIG_GNSS_SAMPLE_LOW_ACCURACY)) {
		use_case |= NRF_MODEM_GNSS_USE_CASE_LOW_ACCURACY;
	}

	if (nrf_modem_gnss_use_case_set(use_case) != 0) {
		LOG_WRN("Failed to set GNSS use case");
	}

#if defined(CONFIG_NRF_CLOUD_AGNSS_ELEVATION_MASK)
	if (nrf_modem_gnss_elevation_threshold_set(CONFIG_NRF_CLOUD_AGNSS_ELEVATION_MASK) != 0) {
		LOG_ERR("Failed to set elevation threshold");
		return -1;
	}
	LOG_DBG("Set elevation threshold to %u", CONFIG_NRF_CLOUD_AGNSS_ELEVATION_MASK);
#endif

#if defined(CONFIG_GNSS_SAMPLE_MODE_CONTINUOUS)
	/* Default to no power saving. */
	uint8_t power_mode = NRF_MODEM_GNSS_PSM_DISABLED;

#if defined(CONFIG_GNSS_SAMPLE_POWER_SAVING_MODERATE)
	power_mode = NRF_MODEM_GNSS_PSM_DUTY_CYCLING_PERFORMANCE;
#elif defined(CONFIG_GNSS_SAMPLE_POWER_SAVING_HIGH)
	power_mode = NRF_MODEM_GNSS_PSM_DUTY_CYCLING_POWER;
#endif

	if (nrf_modem_gnss_power_mode_set(power_mode) != 0) {
		LOG_ERR("Failed to set GNSS power saving mode");
		return -1;
	}
#endif /* CONFIG_GNSS_SAMPLE_MODE_CONTINUOUS */

	/* Default to continuous tracking. */
	uint16_t fix_retry = 0;
	uint16_t fix_interval = 1;

#if defined(CONFIG_GNSS_SAMPLE_MODE_PERIODIC)
	fix_retry = CONFIG_GNSS_SAMPLE_PERIODIC_TIMEOUT;
	fix_interval = CONFIG_GNSS_SAMPLE_PERIODIC_INTERVAL;
#elif defined(CONFIG_GNSS_SAMPLE_MODE_TTFF_TEST)
	/* Single fix for TTFF test mode. */
	fix_retry = 0;
	fix_interval = 0;
#endif

	if (nrf_modem_gnss_fix_retry_set(fix_retry) != 0) {
		LOG_ERR("Failed to set GNSS fix retry");
		return -1;
	}

	if (nrf_modem_gnss_fix_interval_set(fix_interval) != 0) {
		LOG_ERR("Failed to set GNSS fix interval");
		return -1;
	}

#if defined(CONFIG_GNSS_SAMPLE_MODE_TTFF_TEST)
	k_work_schedule_for_queue(&gnss_work_q, &ttff_test_prepare_work, K_NO_WAIT);
#else /* !CONFIG_GNSS_SAMPLE_MODE_TTFF_TEST */
	if (nrf_modem_gnss_start() != 0) {
		LOG_ERR("Failed to start GNSS");
		return -1;
	}
#endif

	return 0;
}

static bool output_paused(void)
{
#if defined(CONFIG_GNSS_SAMPLE_ASSISTANCE_NONE) || defined(CONFIG_GNSS_SAMPLE_LOG_LEVEL_OFF)
	return false;
#else
	return (requesting_assistance || assistance_is_active()) ? true : false;
#endif
}

static void print_satellite_stats(struct nrf_modem_gnss_pvt_data_frame *pvt_data)
{
	uint8_t tracked   = 0;
	uint8_t in_fix    = 0;
	uint8_t unhealthy = 0;

	for (int i = 0; i < NRF_MODEM_GNSS_MAX_SATELLITES; ++i) {
		if (pvt_data->sv[i].sv > 0) {
			tracked++;

			if (pvt_data->sv[i].flags & NRF_MODEM_GNSS_SV_FLAG_USED_IN_FIX) {
				in_fix++;
			}

			if (pvt_data->sv[i].flags & NRF_MODEM_GNSS_SV_FLAG_UNHEALTHY) {
				unhealthy++;
			}
		}
	}

	printf("Tracking: %2d Using: %2d Unhealthy: %d\n", tracked, in_fix, unhealthy);
}

static void print_flags(struct nrf_modem_gnss_pvt_data_frame *pvt_data)
{
	if (pvt_data->flags & NRF_MODEM_GNSS_PVT_FLAG_DEADLINE_MISSED) {
		printf("GNSS operation blocked by LTE\n");
	}
	if (pvt_data->flags & NRF_MODEM_GNSS_PVT_FLAG_NOT_ENOUGH_WINDOW_TIME) {
		printf("Insufficient GNSS time windows\n");
	}
	if (pvt_data->flags & NRF_MODEM_GNSS_PVT_FLAG_SLEEP_BETWEEN_PVT) {
		printf("Sleep period(s) between PVT notifications\n");
	}
	if (pvt_data->flags & NRF_MODEM_GNSS_PVT_FLAG_SCHED_DOWNLOAD) {
		printf("Scheduled navigation data download\n");
	}
}

static void print_fix_data(struct nrf_modem_gnss_pvt_data_frame *pvt_data)
{
	printf("Latitude:          %.06f\n", pvt_data->latitude);
	printf("Longitude:         %.06f\n", pvt_data->longitude);
	printf("Accuracy:          %.01f m\n", (double)pvt_data->accuracy);
	printf("Altitude:          %.01f m\n", (double)pvt_data->altitude);
	printf("Altitude accuracy: %.01f m\n", (double)pvt_data->altitude_accuracy);
	printf("Speed:             %.01f m/s\n", (double)pvt_data->speed);
	printf("Speed accuracy:    %.01f m/s\n", (double)pvt_data->speed_accuracy);
	printf("V. speed:          %.01f m/s\n", (double)pvt_data->vertical_speed);
	printf("V. speed accuracy: %.01f m/s\n", (double)pvt_data->vertical_speed_accuracy);
	printf("Heading:           %.01f deg\n", (double)pvt_data->heading);
	printf("Heading accuracy:  %.01f deg\n", (double)pvt_data->heading_accuracy);
	printf("Date:              %04u-%02u-%02u\n",
	       pvt_data->datetime.year,
	       pvt_data->datetime.month,
	       pvt_data->datetime.day);
	printf("Time (UTC):        %02u:%02u:%02u.%03u\n",
	       pvt_data->datetime.hour,
	       pvt_data->datetime.minute,
	       pvt_data->datetime.seconds,
	       pvt_data->datetime.ms);
	printf("PDOP:              %.01f\n", (double)pvt_data->pdop);
	printf("HDOP:              %.01f\n", (double)pvt_data->hdop);
	printf("VDOP:              %.01f\n", (double)pvt_data->vdop);
	printf("TDOP:              %.01f\n", (double)pvt_data->tdop);
}

int main(void)
{
	int err;
	uint8_t cnt = 0;
	struct nrf_modem_gnss_nmea_data_frame *nmea_data;

	LOG_INF("Starting GNSS sample");

	err = nrf_modem_lib_init();
	if (err) {
		LOG_ERR("Modem library initialization failed, error: %d", err);
		return err;
	}

	/* Initialize reference coordinates (if used). */
	if (sizeof(CONFIG_GNSS_SAMPLE_REFERENCE_LATITUDE) > 1 &&
	    sizeof(CONFIG_GNSS_SAMPLE_REFERENCE_LONGITUDE) > 1) {
		ref_used = true;
		ref_latitude = atof(CONFIG_GNSS_SAMPLE_REFERENCE_LATITUDE);
		ref_longitude = atof(CONFIG_GNSS_SAMPLE_REFERENCE_LONGITUDE);
	}

	if (modem_init() != 0) {
		LOG_ERR("Failed to initialize modem");
		return -1;
	}

	if (sample_init() != 0) {
		LOG_ERR("Failed to initialize sample");
		return -1;
	}

	if (gnss_init_and_start() != 0) {
		LOG_ERR("Failed to initialize and start GNSS");
		return -1;
	}

	fix_timestamp = k_uptime_get();

	for (;;) {
		(void)k_poll(events, 2, K_FOREVER);

		if (events[0].state == K_POLL_STATE_SEM_AVAILABLE &&
		    k_sem_take(events[0].sem, K_NO_WAIT) == 0) {
			/* New PVT data available */

			if (IS_ENABLED(CONFIG_GNSS_SAMPLE_MODE_TTFF_TEST)) {
				/* TTFF test mode. */

				/* Calculate the time GNSS has been blocked by LTE. */
				if (last_pvt.flags & NRF_MODEM_GNSS_PVT_FLAG_DEADLINE_MISSED) {
					time_blocked++;
				}
			} else if (IS_ENABLED(CONFIG_GNSS_SAMPLE_NMEA_ONLY)) {
				/* NMEA-only output mode. */

				if (output_paused()) {
					goto handle_nmea;
				}

				if (last_pvt.flags & NRF_MODEM_GNSS_PVT_FLAG_FIX_VALID) {
					print_distance_from_reference(&last_pvt);
				}
			} else {
				/* PVT and NMEA output mode. */

				if (output_paused()) {
					goto handle_nmea;
				}

				printf("\033[1;1H");
				printf("\033[2J");
				print_satellite_stats(&last_pvt);
				print_flags(&last_pvt);
				printf("-----------------------------------\n");

				if (last_pvt.flags & NRF_MODEM_GNSS_PVT_FLAG_FIX_VALID) {
					fix_timestamp = k_uptime_get();
					print_fix_data(&last_pvt);
					print_distance_from_reference(&last_pvt);
				} else {
					printf("Seconds since last fix: %d\n",
					       (uint32_t)((k_uptime_get() - fix_timestamp) / 1000));
					cnt++;
					printf("Searching [%c]\n", update_indicator[cnt%4]);
				}

				printf("\nNMEA strings:\n\n");
			}
		}

handle_nmea:
		if (events[1].state == K_POLL_STATE_MSGQ_DATA_AVAILABLE &&
		    k_msgq_get(events[1].msgq, &nmea_data, K_NO_WAIT) == 0) {
			/* New NMEA data available */

			if (!output_paused()) {
				printf("%s", nmea_data->nmea_str);
			}
			k_free(nmea_data);
		}

		events[0].state = K_POLL_STATE_NOT_READY;
		events[1].state = K_POLL_STATE_NOT_READY;
	}

	return 0;
}
```

## src/assistance.c
```c
/*
 * Copyright (c) 2021 Nordic Semiconductor ASA
 *
 * SPDX-License-Identifier: LicenseRef-Nordic-5-Clause
 */

#include <stdlib.h>
#include <zephyr/kernel.h>
#include <zephyr/logging/log.h>
#include <modem/modem_info.h>
#include <modem/modem_jwt.h>
#include <net/nrf_cloud_rest.h>
#if defined(CONFIG_NRF_CLOUD_AGNSS)
#include <net/nrf_cloud_agnss.h>
#endif /* CONFIG_NRF_CLOUD_AGNSS */
#if defined(CONFIG_NRF_CLOUD_PGPS)
#include <net/nrf_cloud_pgps.h>
#endif /* CONFIG_NRF_CLOUD_PGPS */

#include "assistance.h"

LOG_MODULE_DECLARE(gnss_sample, CONFIG_GNSS_SAMPLE_LOG_LEVEL);

static char jwt_buf[600];
static char rx_buf[2048];

#if defined(CONFIG_NRF_CLOUD_AGNSS)
static char agnss_data_buf[3500];
#endif /* CONFIG_NRF_CLOUD_AGNSS */

#if defined(CONFIG_NRF_CLOUD_PGPS)
static struct nrf_modem_gnss_agnss_data_frame agnss_need;
static struct gps_pgps_request pgps_request;
static struct nrf_cloud_pgps_prediction *prediction;
static struct k_work get_pgps_data_work;
static struct k_work inject_pgps_data_work;
#endif /* CONFIG_NRF_CLOUD_PGPS */

static struct k_work_q *work_q;
static volatile bool assistance_active;

#if defined(CONFIG_NRF_CLOUD_AGNSS)
static int serving_cell_info_get(struct lte_lc_cell *serving_cell)
{
	int err;

	err = modem_info_init();
	if (err) {
		return err;
	}

	char resp_buf[MODEM_INFO_MAX_RESPONSE_SIZE];

	err = modem_info_string_get(MODEM_INFO_CELLID,
				    resp_buf,
				    MODEM_INFO_MAX_RESPONSE_SIZE);
	if (err < 0) {
		return err;
	}

	serving_cell->id = strtol(resp_buf, NULL, 16);

	err = modem_info_string_get(MODEM_INFO_AREA_CODE,
				    resp_buf,
				    MODEM_INFO_MAX_RESPONSE_SIZE);
	if (err < 0) {
		return err;
	}

	serving_cell->tac = strtol(resp_buf, NULL, 16);

	/* Request for MODEM_INFO_MNC returns both MNC and MCC in the same string. */
	err = modem_info_string_get(MODEM_INFO_OPERATOR,
				    resp_buf,
				    MODEM_INFO_MAX_RESPONSE_SIZE);
	if (err < 0) {
		return err;
	}

	serving_cell->mnc = strtol(&resp_buf[3], NULL, 10);
	/* Null-terminate MCC, read and store it. */
	resp_buf[3] = '\0';
	serving_cell->mcc = strtol(resp_buf, NULL, 10);

	return 0;
}
#endif /* CONFIG_NRF_CLOUD_AGNSS */

#if defined(CONFIG_NRF_CLOUD_PGPS)
static void get_pgps_data_work_fn(struct k_work *work)
{
	ARG_UNUSED(work);

	int err;

	assistance_active = true;

	LOG_INF("Sending request for P-GPS predictions to nRF Cloud...");

	err = nrf_cloud_jwt_generate(0, jwt_buf, sizeof(jwt_buf));
	if (err) {
		LOG_ERR("Failed to generate JWT, error: %d", err);

		goto exit;
	}

	struct nrf_cloud_rest_context rest_ctx = {
		.connect_socket = -1,
		.keep_alive = false,
		.timeout_ms = NRF_CLOUD_REST_TIMEOUT_NONE,
		.auth = jwt_buf,
		.rx_buf = rx_buf,
		.rx_buf_len = sizeof(rx_buf),
		.fragment_size = 0, /* Defaults to CONFIG_NRF_CLOUD_REST_FRAGMENT_SIZE when 0 */
		.status = 0,
		.response = NULL,
		.response_len = 0,
		.total_response_len = 0
	};

	struct nrf_cloud_rest_pgps_request request = {
		.pgps_req = &pgps_request
	};

	err = nrf_cloud_rest_pgps_data_get(&rest_ctx, &request);
	if (err) {
		LOG_ERR("Failed to send P-GPS request, error: %d", err);

		nrf_cloud_pgps_request_reset();

		goto exit;
	}

	LOG_INF("Processing P-GPS response");

	err = nrf_cloud_pgps_process(rest_ctx.response, rest_ctx.response_len);
	if (err) {
		LOG_ERR("Failed to process P-GPS response, error: %d", err);

		nrf_cloud_pgps_request_reset();

		goto exit;
	}

	LOG_INF("P-GPS response processed");

exit:
	assistance_active = false;
}

static void inject_pgps_data_work_fn(struct k_work *work)
{
	ARG_UNUSED(work);

	int err;

	assistance_active = true;

	LOG_INF("Injecting P-GPS ephemerides");

	err = nrf_cloud_pgps_inject(prediction, &agnss_need);
	if (err) {
		LOG_ERR("Failed to inject P-GPS ephemerides");
	}

	err = nrf_cloud_pgps_preemptive_updates();
	if (err) {
		LOG_ERR("Failed to request P-GPS updates");
	}

	assistance_active = false;
}

static void pgps_event_handler(struct nrf_cloud_pgps_event *event)
{
	switch (event->type) {
	case PGPS_EVT_AVAILABLE:
		prediction = event->prediction;

		k_work_submit_to_queue(work_q, &inject_pgps_data_work);
		break;

	case PGPS_EVT_REQUEST:
		memcpy(&pgps_request, event->request, sizeof(pgps_request));

		k_work_submit_to_queue(work_q, &get_pgps_data_work);
		break;

	case PGPS_EVT_LOADING:
		LOG_INF("Loading P-GPS predictions");
		assistance_active = true;
		break;

	case PGPS_EVT_READY:
		LOG_INF("P-GPS predictions ready");
		assistance_active = false;
		break;

	default:
		/* No action needed */
		break;
	}
}
#endif /* CONFIG_NRF_CLOUD_PGPS */

#if defined(CONFIG_NRF_CLOUD_AGNSS)
static const char *get_system_string(uint8_t system_id)
{
	switch (system_id) {
	case NRF_MODEM_GNSS_SYSTEM_INVALID:
		return "invalid";

	case NRF_MODEM_GNSS_SYSTEM_GPS:
		return "GPS";

	case NRF_MODEM_GNSS_SYSTEM_QZSS:
		return "QZSS";

	default:
		return "unknown";
	}
}
#endif /* CONFIG_NRF_CLOUD_AGNSS */

int assistance_init(struct k_work_q *assistance_work_q)
{
	work_q = assistance_work_q;

#if defined(CONFIG_NRF_CLOUD_PGPS)
	k_work_init(&get_pgps_data_work, get_pgps_data_work_fn);
	k_work_init(&inject_pgps_data_work, inject_pgps_data_work_fn);

	struct nrf_cloud_pgps_init_param pgps_param = {
		.event_handler = pgps_event_handler,
		/* storage is defined by CONFIG_NRF_CLOUD_PGPS_STORAGE */
		.storage_base = 0u,
		.storage_size = 0u
	};

	if (nrf_cloud_pgps_init(&pgps_param) != 0) {
		LOG_ERR("Failed to initialize P-GPS");
		return -1;
	}
#endif /* CONFIG_NRF_CLOUD_PGPS */

	return 0;
}

int assistance_request(struct nrf_modem_gnss_agnss_data_frame *agnss_request)
{
	int err = 0;

#if defined(CONFIG_NRF_CLOUD_PGPS)
	/* Store the A-GNSS data request for P-GPS use. */
	memcpy(&agnss_need, agnss_request, sizeof(agnss_need));

#if defined(CONFIG_NRF_CLOUD_AGNSS)
	if (!agnss_request->data_flags) {
		/* No assistance needed from A-GNSS, skip directly to P-GPS. */
		nrf_cloud_pgps_notify_prediction();
		return 0;
	}

	/* P-GPS will handle GPS ephemerides, so skip those. */
	agnss_request->system[0].sv_mask_ephe = 0;
	/* GPS almanacs are not needed with P-GPS, so skip those. */
	agnss_request->system[0].sv_mask_alm = 0;
#endif /* CONFIG_NRF_CLOUD_AGNSS */
#endif /* CONFIG_NRF_CLOUD_PGPS */
#if defined(CONFIG_NRF_CLOUD_AGNSS)
	assistance_active = true;

	err = nrf_cloud_jwt_generate(0, jwt_buf, sizeof(jwt_buf));
	if (err) {
		LOG_ERR("Failed to generate JWT, error: %d", err);
		goto agnss_exit;
	}

	struct nrf_cloud_rest_context rest_ctx = {
		.connect_socket = -1,
		.keep_alive = false,
		.timeout_ms = NRF_CLOUD_REST_TIMEOUT_NONE,
		.auth = jwt_buf,
		.rx_buf = rx_buf,
		.rx_buf_len = sizeof(rx_buf),
		.fragment_size = 0, /* Defaults to CONFIG_NRF_CLOUD_REST_FRAGMENT_SIZE when 0 */
		.status = 0,
		.response = NULL,
		.response_len = 0,
		.total_response_len = 0
	};

	struct nrf_cloud_rest_agnss_request request = {
		.type = NRF_CLOUD_REST_AGNSS_REQ_CUSTOM,
		.agnss_req = agnss_request,
		.net_info = NULL,
#if defined(CONFIG_NRF_CLOUD_AGNSS_FILTERED_RUNTIME)
		.filtered = true,
		/* Note: if you change the mask angle here, you may want to
		 * also change it to match in gnss_init_and_start() in main.c.
		 */
		.mask_angle = CONFIG_NRF_CLOUD_AGNSS_ELEVATION_MASK
		/* Note: if CONFIG_NRF_CLOUD_AGNSS_FILTERED is enabled but
		 * CONFIG_NRF_CLOUD_AGNSS_FILTERED_RUNTIME is not,
		 * the nrf_cloud_rest library will set the above fields to
		 * true and CONFIG_NRF_CLOUD_AGNSS_ELEVATION_MASK respectively.
		 * When CONFIG_NRF_CLOUD_AGNSS_FILTERED is disabled, it will
		 * set them to false and 0.
		 */
#endif
	};

	struct nrf_cloud_rest_agnss_result result = {
		.buf = agnss_data_buf,
		.buf_sz = sizeof(agnss_data_buf),
		.agnss_sz = 0
	};

	struct lte_lc_cells_info net_info = { 0 };

	err = serving_cell_info_get(&net_info.current_cell);
	if (err) {
		LOG_ERR("Could not get cell info, error: %d", err);
	} else {
		/* Network info for the location request. */
		request.net_info = &net_info;
	}

	LOG_INF("Requesting A-GNSS data: data_flags: 0x%02x", agnss_request->data_flags);
	for (int i = 0; i < agnss_request->system_count; i++) {
		LOG_INF("Requesting A-GNSS data: %s ephe: 0x%llx, alm: 0x%llx",
			get_system_string(agnss_request->system[i].system_id),
			agnss_request->system[i].sv_mask_ephe,
			agnss_request->system[i].sv_mask_alm);
	}

	err = nrf_cloud_rest_agnss_data_get(&rest_ctx, &request, &result);
	if (err) {
		LOG_ERR("Failed to get A-GNSS data, error: %d", err);
		goto agnss_exit;
	}

	LOG_INF("Processing A-GNSS data");

	err = nrf_cloud_agnss_process(result.buf, result.agnss_sz);
	if (err) {
		LOG_ERR("Failed to process A-GNSS data, error: %d", err);
		goto agnss_exit;
	}

	LOG_INF("A-GNSS data processed");

agnss_exit:
	assistance_active = false;
#endif /* CONFIG_NRF_CLOUD_AGNSS */

#if defined(CONFIG_NRF_CLOUD_PGPS)
	nrf_cloud_pgps_notify_prediction();
#endif /* CONFIG_NRF_CLOUD_PGPS */

	return err;
}

bool assistance_is_active(void)
{
	return assistance_active;
}
```

## src/assistance_minimal.c
```c
/*
 * Copyright (c) 2021-2023 Nordic Semiconductor ASA
 *
 * SPDX-License-Identifier: LicenseRef-Nordic-5-Clause
 */

#include <stdio.h>
#include <stdlib.h>
#include <zephyr/kernel.h>
#include <zephyr/sys_clock.h>
#include <zephyr/sys/timeutil.h>
#include <zephyr/settings/settings.h>
#include <zephyr/logging/log.h>
#include <nrf_modem_at.h>
#include <nrf_modem_gnss.h>

#include "assistance.h"
#include "factory_almanac_v2.h"
#include "factory_almanac_v3.h"
#include "mcc_location_table.h"

LOG_MODULE_DECLARE(gnss_sample, CONFIG_GNSS_SAMPLE_LOG_LEVEL);

/* (6.1.1980 UTC - 1.1.1970 UTC) */
#define GPS_TO_UNIX_UTC_OFFSET_SECONDS	(315964800UL)
/* UTC/GPS time offset as of 1st of January 2017. */
#define GPS_TO_UTC_LEAP_SECONDS		(18UL)
#define SEC_PER_HOUR			(MIN_PER_HOUR * SEC_PER_MIN)
#define SEC_PER_DAY			(HOUR_PER_DAY * SEC_PER_HOUR)
#define DAYS_PER_WEEK			(7UL)
#define PLMN_STR_MAX_LEN		8 /* MCC + MNC + quotes */

enum almanac_version {
	FACTORY_ALMANAC_V2 = 2,
	FACTORY_ALMANAC_V3 = 3
};

static char current_alm_checksum[64];

static int set(const char *key, size_t len_rd, settings_read_cb read_cb, void *cb_arg)
{
	int len;
	int key_len;
	const char *next;

	if (!key) {
		return -ENOENT;
	}

	key_len = settings_name_next(key, &next);

	if (!strncmp(key, "almanac_checksum", key_len)) {
		len = read_cb(cb_arg, &current_alm_checksum, sizeof(current_alm_checksum));
		if (len < sizeof(current_alm_checksum)) {
			LOG_ERR("Failed to read almanac checksum from settings");
		}

		return 0;
	}

	return -ENOENT;
}

static struct settings_handler assistance_settings = {
	.name = "assistance",
	.h_set = set,
};

static enum almanac_version factory_almanac_version_get(void)
{
	char resp[32];

	if (nrf_modem_at_cmd(resp, sizeof(resp), "AT+CGMM") == 0) {
		/* nRF9160 uses factory almanac file format version 2, while nRF91x1 uses
		 * version 3.
		 */
		if (strstr(resp, "nRF9160") != NULL) {
			return FACTORY_ALMANAC_V2;
		}
	}

	return FACTORY_ALMANAC_V3;
}

static void factory_almanac_write(void)
{
	int err;
	enum almanac_version alm_version;
	const char *alm_data;
	const char *alm_checksum;

	/* Get the supported factory almanac version. */
	alm_version = factory_almanac_version_get();
	LOG_DBG("Supported factory almanac version: %d", alm_version);

	if (alm_version == 3) {
		alm_data = FACTORY_ALMANAC_DATA_V3;
		alm_checksum = FACTORY_ALMANAC_CHECKSUM_V3;
	} else {
		alm_data = FACTORY_ALMANAC_DATA_V2;
		alm_checksum = FACTORY_ALMANAC_CHECKSUM_V2;
	}

	/* Check if the same almanac has already been written to prevent unnecessary writes
	 * to flash memory.
	 */
	if (!strncmp(current_alm_checksum, alm_checksum, sizeof(current_alm_checksum))) {
		LOG_INF("Factory almanac has already been written, skipping writing");
		return;
	}

	err = nrf_modem_at_printf("AT%%XFILEWRITE=1,\"%s\",\"%s\"",
				  alm_data, alm_checksum);
	if (err != 0) {
		LOG_ERR("Failed to write factory almanac");
		return;
	}

	LOG_INF("Wrote factory almanac");

	err = settings_save_one("assistance/almanac_checksum",
				alm_checksum,
				sizeof(current_alm_checksum));
	if (err) {
		LOG_ERR("Failed to write almanac checksum to settings, error %d", err);
	}
}

static int64_t utc_to_gps_sec(const int64_t utc_sec)
{
	return (utc_sec - GPS_TO_UNIX_UTC_OFFSET_SECONDS) + GPS_TO_UTC_LEAP_SECONDS;
}

static void gps_sec_to_day_time(int64_t gps_sec,
				uint16_t *gps_day,
				uint32_t *gps_time_of_day)
{
	*gps_day = (uint16_t)(gps_sec / SEC_PER_DAY);
	*gps_time_of_day = (uint32_t)(gps_sec % SEC_PER_DAY);
}

static void time_inject(void)
{
	int ret;
	struct tm date_time;
	int64_t utc_sec;
	int64_t gps_sec;
	struct nrf_modem_gnss_agnss_gps_data_system_time_and_sv_tow gps_time = { 0 };

	/* Read current UTC time from the modem. */
	ret = nrf_modem_at_scanf("AT+CCLK?",
		"+CCLK: \"%u/%u/%u,%u:%u:%u",
		&date_time.tm_year,
		&date_time.tm_mon,
		&date_time.tm_mday,
		&date_time.tm_hour,
		&date_time.tm_min,
		&date_time.tm_sec
	);
	if (ret != 6) {
		LOG_WRN("Couldn't read current time from modem, time assistance unavailable");
		return;
	}

	/* Convert to struct tm format. */
	date_time.tm_year = date_time.tm_year + 2000 - 1900; /* years since 1900 */
	date_time.tm_mon--; /* months since January */

	/* Convert time to seconds since Unix time epoch (1.1.1970). */
	utc_sec = timeutil_timegm64(&date_time);
	/* Convert time to seconds since GPS time epoch (6.1.1980). */
	gps_sec = utc_to_gps_sec(utc_sec);

	gps_sec_to_day_time(gps_sec, &gps_time.date_day, &gps_time.time_full_s);

	ret = nrf_modem_gnss_agnss_write(&gps_time, sizeof(gps_time),
					 NRF_MODEM_GNSS_AGNSS_GPS_SYSTEM_CLOCK_AND_TOWS);
	if (ret != 0) {
		LOG_ERR("Failed to inject time, error %d", ret);
		return;
	}

	LOG_INF("Injected time (GPS day %u, GPS time of day %u)",
		gps_time.date_day, gps_time.time_full_s);
}

static void location_inject(void)
{
	int err;
	char plmn_str[PLMN_STR_MAX_LEN + 1];
	uint16_t mcc;
	const struct mcc_table *mcc_info;
	struct nrf_modem_gnss_agnss_data_location location = { 0 };

	/* Read PLMN string from modem to get the MCC. */
	err = nrf_modem_at_scanf(
		"AT%XMONITOR",
		"%%XMONITOR: "
		"%*d"                                  /* <reg_status>: ignored */
		",%*[^,]"                              /* <full_name>: ignored */
		",%*[^,]"                              /* <short_name>: ignored */
		",%"STRINGIFY(PLMN_STR_MAX_LEN)"[^,]", /* <plmn> */
		plmn_str);
	if (err != 1) {
		LOG_WRN("Couldn't read PLMN from modem, location assistance unavailable");
		return;
	}

	/* NULL terminate MCC and read it. */
	plmn_str[4] = '\0';
	mcc = strtol(plmn_str + 1, NULL, 10);

	mcc_info = mcc_lookup(mcc);
	if (mcc_info == NULL) {
		LOG_WRN("No location found for MCC %u", mcc);
		return;
	}

	location.latitude = lat_convert(mcc_info->lat);
	location.longitude = lon_convert(mcc_info->lon);
	location.unc_semimajor = mcc_info->unc_semimajor;
	location.unc_semiminor = mcc_info->unc_semiminor;
	location.orientation_major = mcc_info->orientation;
	location.confidence = mcc_info->confidence;

#if defined(CONFIG_GNSS_SAMPLE_LOW_ACCURACY)
	if (CONFIG_GNSS_SAMPLE_ASSISTANCE_REFERENCE_ALT != -32767) {
		/* Use reference altitude to enable 3-sat first fix. */
		LOG_INF("Using reference altitude %d meters",
			CONFIG_GNSS_SAMPLE_ASSISTANCE_REFERENCE_ALT);
		location.altitude = CONFIG_GNSS_SAMPLE_ASSISTANCE_REFERENCE_ALT;
		/* The altitude uncertainty has to be less than 100 meters (coded number K has to
		 * be less than 48) for the altitude to be used for a 3-sat fix. GNSS increases
		 * the uncertainty depending on the age of the altitude and whether the device is
		 * stationary or moving. The uncertainty is set to 0 (meaning 0 meters), so that
		 * it remains usable for a 3-sat fix for as long as possible.
		 */
		location.unc_altitude = 0;
	} else
#endif
	{
		location.unc_altitude = 255; /* altitude not used */
	}

	err = nrf_modem_gnss_agnss_write(
		&location, sizeof(location), NRF_MODEM_GNSS_AGNSS_LOCATION);
	if (err) {
		LOG_ERR("Failed to inject location for MCC %u, error %d", mcc, err);
		return;
	}

	LOG_INF("Injected location for MCC %u", mcc);
}

int assistance_init(struct k_work_q *assistance_work_q)
{
	ARG_UNUSED(assistance_work_q);

	int err;

	err = settings_subsys_init();
	if (err) {
		LOG_ERR("Settings subsystem initialization failed, error %d", err);
		return err;
	}

	err = settings_register(&assistance_settings);
	if (err) {
		LOG_ERR("Registering settings handler failed, error %d", err);
		return err;
	}

	err = settings_load();
	if (err) {
		LOG_ERR("Loading settings failed, error %d", err);
		return err;
	}

	factory_almanac_write();

	return 0;
}

int assistance_request(struct nrf_modem_gnss_agnss_data_frame *agnss_request)
{
	if (agnss_request->data_flags & NRF_MODEM_GNSS_AGNSS_GPS_SYS_TIME_AND_SV_TOW_REQUEST) {
		time_inject();
	}

	if (agnss_request->data_flags & NRF_MODEM_GNSS_AGNSS_POSITION_REQUEST) {
		location_inject();
	}

	return 0;
}

bool assistance_is_active(void)
{
	/* Always return false because assistance_request() doesn't take much time. */
	return false;
}
```

## src/factory_almanac_v2.h
```c
/*
 * Copyright (c) 2021 Nordic Semiconductor ASA
 *
 * SPDX-License-Identifier: LicenseRef-Nordic-5-Clause
 */

#ifndef FACTORY_ALMANAC_V2_H_
#define FACTORY_ALMANAC_V2_H_

/* Factory almanac generated on 2024-12-06 18:30:12.
 *
 * Note, that the almanac gets more inaccurate with time and it should be updated periodically.
 */

#define FACTORY_ALMANAC_DATA_V2 \
	"f0ea020031280900000000000000000000000000000000000000000000000000" \
	"00000000000000000000310e870f28099c0f50fd00170da1009209c0fff3d9d3" \
	"ff173dc6ffc9fe020031582e0f2809601d55fd008e0ca1005c6deeff18fd2e00" \
	"82d338008a02020031381a0f2809980f47fd000d0da1003a461a00594386ff8c" \
	"0ab4ff05020200313e2e0f2809cd144afd00520da1008d3becff78573600d40c" \
	"ceff33ff000031871b0f28096f1e63fd00a50da1001139c4ff0632e1ffc4c472" \
	"00e2fff8ff31d19a0f2809e0044ffd00430ca1005d80430097d2aafff0875000" \
	"efff000031d4520f28092b0535fd004f0da1008a4797ff2ebe0f00f8eec0ffc7" \
	"01030031e8190f28098f0b3ffd00f90ba100e4c9170058b35200a440d7fff601" \
	"0400314c520f2809221d55fd001c0da100fc52eeff4b50a0ff14a5100013fffc" \
	"ff31850e0f28093a0f4ffd004e0ca100bc64c5ff125c9fff710e9cffebfc0000" \
	"3105490f28095c0c48fd00d40da10090fa7000f0833b00cbb63200b8fdffff31" \
	"fe470f2809a1134ffd00160da1009daa1e00cfb02700db9db4ffd30200003191" \
	"290f2809780139fd00240da100390b6f00f4578bff5f712c0047020200313184" \
	"0f2809bcfc29fd00610da1002b601200d7573800cc9897fff90001003189750f" \
	"2809f50b46fd00da0ca10054b27100ae022300057fe9ff8eff0300315c6e0f28" \
	"096d0f43fd004b0ca10026439bffb3b3ccff6905bfff2902fcff3162270f2809" \
	"951456fd006d0da100a846c4fffc4d88ff2ed36d004bfd000031b5510f2809e5" \
	"0e41fd00580ca10056109dff40a66d00ff180b0058020100318e1f0f28093609" \
	"3cfd00d00ca100c1d8e6ffd5709dfff5967e0082010000319fd20f2809db0b50" \
	"fd00ac0ca10064b2bfffe15decff4074b9ff6400000031be6f0f28098a0b46fd" \
	"00000da100b7d47100e9ecd3ff4043d4ffa7ffffff3195280f2809f11951fd00" \
	"a30ca100de1aedff48648aff555c40008e0102003118860f280949fa40fd0017" \
	"0da1000f683f007a472a0042d373000efe010031d8630f28098d043ffd00220d" \
	"a100135d6d0084e92c00e7cc2a000b02000031574f0f2809fbf72efd00710da1" \
	"00a9ab6a006a1a1800f3680b00fefffcff313d6a0f28090f0b3dfd000c0da100" \
	"266d98ff09ac200083e3c3ffdcff000031de030f2809140c59fd00cc0da10095" \
	"3e4200741a3a00260d1e00f1fdfdff3182170f28090d1145fd00790da10000e5" \
	"9bff826e6c00bb58bdffb7fd010031e23a0f280934fb42fd00b20da100516843" \
	"008ac39bffbc424900eafe020031d3570f28096e0754fd00640ca1006d694400" \
	"8ee01f005bac240019ff000031a5420f2809b50d44fd00a90da100676a180073" \
	"6ca9ffdfabdcffb2fd0200000000000000000000000000000000000000000000" \
	"0000000000"
#define FACTORY_ALMANAC_CHECKSUM_V2 \
	"2264cef19c4c46673702013eaa4a98f012e8f9e83a60c1c468baeae74f45e82e"

#endif /* FACTORY_ALMANAC_V2_H_ */
```
