## Kconfig
```
#
# Copyright (c) 2022 Nordic Semiconductor ASA
#
# SPDX-License-Identifier: LicenseRef-Nordic-5-Clause
#

menu "Multi Service Sample Settings"

config APP_VERSION
	string "Multi Service Sample version"
	default "1.0.0"

config CLOUD_CONNECTION_RETRY_TIMEOUT_SECONDS
	int "Cloud connection retry timeout (seconds)"
	default 30
	help
	  If connecting to nRF Cloud takes longer than this timeout, it will be
	  reattempted.

config CLOUD_READY_TIMEOUT_SECONDS
	int "Cloud readiness timeout (seconds)"
	default 600
	help
	  If the connection to nRF Cloud does not become ready within this
	  timeout, the sample will reset its connection and try again.

config DATE_TIME_ESTABLISHMENT_TIMEOUT_SECONDS
	int "Modem date and time establishment timeout (seconds)"
	default 300
	help
	  The sample will wait this many seconds for the modem to determine the
	  current date and time before giving up and moving on.

config APPLICATION_THREAD_STACK_SIZE
	int "Application Thread Stack Size (bytes)"
	default 2048
	help
	  Sets the stack size (in bytes) for the application thread of the
	  sample.

config CONNECTION_THREAD_STACK_SIZE
	int "Connection Thread Stack Size (bytes)"
	default 2048
	help
	  Sets the stack size (in bytes) for the connection thread of the
	  sample.

config MESSAGE_THREAD_STACK_SIZE
	int "Message Queue Thread Stack Size (bytes)"
	default 2048
	help
	  Sets the stack size (in bytes) for the message queue processing
	  thread of the sample.

config LED_THREAD_STACK_SIZE
	int "LED Thread Stack Size (bytes)"
	default 1024
	help
	  Sets the stack size (in bytes) for the LED thread.

config MAX_OUTGOING_MESSAGES
	int "Outgoing message maximum"
	default 25
	help
	  Sets the maximum number of device messages which may be enqueued
	  before further messages are dropped.
	  Increasing this value may require an increase to CONFIG_HEAP_MEM_POOL_SIZE.

config MAX_CONSECUTIVE_SEND_FAILURES
	int "Max outgoing consecutive send failures"
	default 5
	help
	  Sets the maximum number of device messages which may fail to send
	  before a connection reset and cooldown is triggered.

config CONSECUTIVE_SEND_FAILURE_COOLDOWN_SECONDS
	int "Cooldown after max consecutive send failures exceeded"
	default 10
	help
	  If a connection reset is triggered by too many failed device
	  messages, the sample will wait this long (in seconds) before trying
	  again.

config SENSOR_SAMPLE_INTERVAL_SECONDS
	int "Sensor sampling interval (seconds)"
	default 60
	help
	  Sets the time to wait between each sensor sample.

menuconfig LOCATION_TRACKING
	bool "Location tracking service"
	default y
	help
	  Uses GNSS, LTE, and/or Wi-Fi information to determine and report device
	  location.

if LOCATION_TRACKING

config LOCATION_TRACKING_SAMPLE_INTERVAL_SECONDS
	int "Location sampling interval (seconds)"
	default 60
	help
	  Sets the location sampling interval in seconds.

config LOCATION_TRACKING_GNSS
	bool "Use GNSS method for location tracking"
	default y
	depends on LOCATION_METHOD_GNSS
	help
	  Disable all location tracking methods to completely disable location tracking.

config LOCATION_TRACKING_CELLULAR
	bool "Use cellular method for location tracking"
	default y
	depends on LOCATION_METHOD_CELLULAR
	help
	  Disable all location tracking methods to completely disable location tracking.

config LOCATION_TRACKING_WIFI
	bool "Use Wi-Fi method for location tracking"
	default n
	depends on LOCATION_METHOD_WIFI
	help
	  Requires the use of an nRF7002 companion chip.
	  Disable all location tracking methods to completely disable location tracking.

endif

config TEMP_DATA_USE_SENSOR
	bool "Use genuine temperature data"
	depends on BOARD_THINGY91_NRF9160_NS || BOARD_THINGY91X_NRF9151_NS
	default y if BOARD_THINGY91_NRF9160_NS || BOARD_THINGY91X_NRF9151_NS
	select SENSOR
	select BME680
	help
	  Sets whether to take genuine temperature measurements from a
	  connected BME680 sensor, or just simulate sensor data.

config TEMP_TRACKING
	bool "Track temperature"
	default y
	select NRF_CLOUD_ENABLE_SVC_INF_UI_TEMP
	help
	  Sets whether to take temperature measurements.

config TEMP_ALERT_LIMIT
	int "Temperature limit to send alert"
	default 30
	help
	  Sets the temperature in degrees C over which a temperature alert will
	  be sent to the cloud.

choice
	prompt "LED indication"
	default LED_INDICATION_PWM if BOARD_THINGY91_NRF9160_NS || BOARD_THINGY91X_NRF9151_NS
	default LED_INDICATION_GPIO if BOARD_NRF9160DK_NRF9160_NS || BOARD_NRF9161DK_NRF9161_NS || $(dt_compat_enabled,gpio-leds)
	default LED_INDICATION_DISABLED

	config LED_INDICATION_PWM
		select LED
		select LED_PWM
		select PWM
		bool "Enable LED indication using the pwm-leds driver"

	config LED_INDICATION_GPIO
		select LED
		select LED_GPIO
		bool "Enable LED indication using the gpio-leds driver"

	config LED_INDICATION_DISABLED
		bool "Disable LED indication"
endchoice

choice
	prompt "LED indication LED type"
	depends on !LED_INDICATION_DISABLED
	default LED_INDICATOR_RGB if (BOARD_THINGY91_NRF9160_NS || BOARD_THINGY91X_NRF9151_NS) && LED_INDICATION_PWM
	default LED_INDICATOR_4LED if !LED_INDICATION_DISABLED
	default LED_INDICATOR_NONE

	config LED_INDICATOR_RGB
		depends on LED_INDICATION_PWM
		bool "A single RGB LED"

	config LED_INDICATOR_4LED
		depends on !LED_INDICATION_DISABLED
		bool "Four binary LEDs"

	config LED_INDICATOR_NONE
		depends on LED_INDICATION_DISABLED
		bool "No indicator LEDs"

endchoice

config LED_VERBOSE_INDICATION
	depends on !LED_INDICATION_DISABLED
	bool "Enables extra LED status indications"
	default y

config LED_CONTINUOUS_INDICATION
	depends on !LED_INDICATION_DISABLED
	bool "Show an idle pattern instead of turning LEDs off"
	default y

config GNSS_FIX_TIMEOUT_SECONDS
	int "GNSS Fix timeout"
	default 40
	help
	  On each location sample, try for this long to achieve a GNSS fix
	  before falling back to cellular positioning.
	  Set this to 20 or so seconds below the sensor sample interval so
	  that there is time left over to perform cellular positioning.
	  Otherwise, location samples may occur at a longer interval than
	  requested.

config TEST_COUNTER
	bool "Sets whether the test counter is enabled"
	help
	  When enabled, the test counter configuration setting in the shadow is ignored.

config TEST_COUNTER_MULTIPLIER
	int "The number of test counter messages sent on each update"
	default 1
	range 1 1000
	help
	  This is a way to increase the number of device messages sent by the sample.
	  It is useful for load testing.

config AT_CMD_REQUESTS
	depends on !NRF_CLOUD_COAP
	bool "Enables remote execution of AT commands using device messages"
	default y

config AT_CMD_REQUEST_RESPONSE_BUFFER_LENGTH
	int "Max length (in bytes) for Modem responses during AT command requests"
	help
	  Responses to modem AT commands are stored in a buffer of this length before being sent to
	  nRF Cloud. If a response from the modem exceeds this length, it will be dropped, and an
	  error code sent in its place (-NRF_E2BIG). Cannot be less than 40 bytes.
	default 200

config SEND_ONLINE_ALERT
	bool "Sends a routine ALERT_TYPE_DEVICE_NOW_ONLINE on startup"
	help
	  Enable this to demonstrate the alert feature of nRF Cloud. Reception of this alert
	  indicates the device has rebooted.

config POST_PROVISIONING_INTERVAL_M
	int "Delay in minutes between provisioning checks once connected"
	default 30
	help
	  Use a slower rate to check for provisioning after we have successfully connected.
	  Until then use CONFIG_NRF_PROVISIONING_INTERVAL_S.

if NRF_CLOUD_COAP

menuconfig COAP_FOTA
	bool "FOTA service when using CoAP to connect to nRF Cloud"
	select FOTA_DOWNLOAD
	select FOTA_DOWNLOAD_PROGRESS_EVT
	select IMG_ERASE_PROGRESSIVELY
	select DFU_TARGET
	select DOWNLOAD_CLIENT
	select REBOOT
	select CJSON_LIB
	select SETTINGS
	default y

if COAP_FOTA

config COAP_FOTA_JOB_CHECK_RATE_MINUTES
	int "FOTA job check interval (minutes)"
	default 60
	help
	  Sets the time to wait between each request to get any pending FOTA job.

config COAP_FOTA_THREAD_STACK_SIZE
	int "CoAP FOTA Thread Stack Size (bytes)"
	default 2048
	help
	  Sets the stack size (in bytes) for the CoAP FOTA thread of the
	  sample.

endif

menuconfig COAP_SHADOW
	bool "Updating shadow service"
	default y
	help
	  Updates the shadow with device information. Checks for a shadow
	  delta periodically and processes it if received.

if COAP_SHADOW

config COAP_SHADOW_CHECK_RATE_SECONDS
	int "Shadow job check interval (seconds)"
	default 300
	help
	  Sets the time to wait between each request to get any change to the
	  device shadow.

config COAP_SHADOW_THREAD_STACK_SIZE
	int "CoAP Shadow Thread Stack Size (bytes)"
	default 3072
	help
	  Sets the stack size (in bytes) for the CoAP shadow thread of the
	  sample.

endif

config COAP_SEND_CONFIRMABLE
	bool "Send device messages as confirmable"
	help
	  Ensures all CoAP transfers, even for often less important messages such
	  as sensor data, are sent as confirmable messages.

endif

endmenu

if NRF_CLOUD_MQTT
module-str = MQTT Multi Service
endif
if NRF_CLOUD_COAP
module-str = CoAP Multi Service
endif
module = MULTI_SERVICE
source "${ZEPHYR_BASE}/subsys/logging/Kconfig.template.log_config"

menu "Zephyr Kernel"
source "Kconfig.zephyr"
endmenu
```

## Kconfig.sysbuild
```
#
# Copyright (c) 2024 Nordic Semiconductor
#
# SPDX-License-Identifier: LicenseRef-Nordic-5-Clause
#

config WIFI_NRF70
	default y if BOARD_THINGY91X_NRF9151_NS

choice WIFI_NRF70_OPER_MODES
	default WIFI_NRF70_SCAN_ONLY if BOARD_THINGY91X_NRF9151_NS
endchoice

source "${ZEPHYR_BASE}/share/sysbuild/Kconfig"
```

## sample.yaml
```
sample:
  name: nRF Cloud Multi Service Sample
tests:
  sample.cellular.nrf_cloud_multi_service.mqtt:
    sysbuild: true
    build_only: true
    platform_allow:
      - nrf9151dk/nrf9151/ns
      - nrf9160dk/nrf9160/ns
      - nrf9161dk/nrf9161/ns
      - thingy91/nrf9160/ns
      - thingy91x/nrf9151/ns
    integration_platforms:
      - nrf9151dk/nrf9151/ns
      - nrf9160dk/nrf9160/ns
      - nrf9161dk/nrf9161/ns
      - thingy91/nrf9160/ns
      - thingy91x/nrf9151/ns
    tags: ci_build sysbuild ci_samples_cellular
  sample.cellular.nrf_cloud_multi_service.mqtt.full:
    sysbuild: true
    build_only: true
    platform_allow: nrf9160dk/nrf9160/ns
    integration_platforms:
      - nrf9160dk/nrf9160/ns
    extra_args: "EXTRA_CONF_FILE=\"overlay_full_modem_fota.conf;\
      overlay_pgps_ext_flash.conf;overlay_mcuboot_ext_flash.conf\""
    tags: ci_build sysbuild ci_samples_cellular
  sample.cellular.nrf_cloud_multi_service.mqtt.min:
    sysbuild: true
    build_only: true
    platform_allow: nrf9160dk/nrf9160/ns
    integration_platforms:
      - nrf9160dk/nrf9160/ns
    extra_args: EXTRA_CONF_FILE="overlay_min_mqtt.conf"
    tags: ci_build sysbuild ci_samples_cellular
  sample.cellular.nrf_cloud_multi_service.coap:
    sysbuild: true
    build_only: true
    platform_allow:
      - nrf9151dk/nrf9151/ns
      - nrf9160dk/nrf9160/ns
      - nrf9161dk/nrf9161/ns
      - thingy91/nrf9160/ns
      - thingy91x/nrf9151/ns
    integration_platforms:
      - nrf9151dk/nrf9151/ns
      - nrf9160dk/nrf9160/ns
      - nrf9161dk/nrf9161/ns
      - thingy91/nrf9160/ns
      - thingy91x/nrf9151/ns
    extra_args: EXTRA_CONF_FILE="overlay_coap.conf"
    tags: ci_build sysbuild ci_samples_cellular
  sample.cellular.nrf_cloud_multi_service.coap.min:
    sysbuild: true
    build_only: true
    platform_allow: nrf9160dk/nrf9160/ns
    integration_platforms:
      - nrf9160dk/nrf9160/ns
    extra_args: EXTRA_CONF_FILE="overlay_coap.conf;overlay_min_coap.conf"
    tags: ci_build sysbuild ci_samples_cellular
  sample.cellular.nrf_cloud_multi_service.coap.trace:
    sysbuild: true
    build_only: true
    platform_allow:
      - nrf9151dk/nrf9151/ns
      - nrf9160dk/nrf9160/ns
      - nrf9161dk/nrf9161/ns
    integration_platforms:
      - nrf9151dk/nrf9151/ns
      - nrf9160dk/nrf9160/ns
      - nrf9161dk/nrf9161/ns
    extra_args: EXTRA_CONF_FILE="overlay-coap_nrf_provisioning.conf;overlay_coap.conf"
      nrf_cloud_multi_service_SNIPPET=nrf91-modem-trace-uart
    tags: ci_build sysbuild ci_samples_cellular
  sample.cellular.nrf7002ek_wifi.scan:
    sysbuild: true
    build_only: true
    integration_platforms:
      - nrf9151dk/nrf9151/ns
      - nrf9160dk/nrf9160/ns
      - nrf9161dk/nrf9161/ns
    platform_allow:
      - nrf9151dk/nrf9151/ns
      - nrf9160dk/nrf9160/ns
      - nrf9161dk/nrf9161/ns
    extra_args: nrf_cloud_multi_service_SHIELD=nrf7002ek_nrf7000
      EXTRA_CONF_FILE="overlay-nrf7002ek-wifi-scan-only.conf"
      SB_CONF_FILE="sysbuild_nrf700x-wifi-scan.conf"
    tags: ci_build sysbuild ci_samples_cellular
  sample.cellular.nrf7002ek_wifi.conn:
    sysbuild: true
    build_only: true
    integration_platforms:
      - nrf5340dk/nrf5340/cpuapp/ns
    platform_allow: nrf5340dk/nrf5340/cpuapp/ns
    extra_args: nrf_cloud_multi_service_SHIELD=nrf7002ek
      EXTRA_CONF_FILE="overlay_nrf700x_wifi_mqtt_no_lte.conf"
      SB_CONF_FILE="sysbuild_nrf700x-wifi-conn.conf"
    tags: ci_build sysbuild ci_samples_cellular
  sample.cellular.nrf7002dk_wifi.conn:
    sysbuild: true
    build_only: true
    integration_platforms:
      - nrf7002dk/nrf5340/cpuapp/ns
    platform_allow: nrf7002dk/nrf5340/cpuapp/ns
    extra_args: EXTRA_CONF_FILE="overlay_nrf700x_wifi_mqtt_no_lte.conf"
      SB_CONF_FILE="sysbuild_nrf700x-wifi-conn.conf"
    tags: ci_build sysbuild ci_samples_cellular
```

## prj.conf
```kconfig
#
# Copyright (c) 2022 Nordic Semiconductor ASA
#
# SPDX-License-Identifier: LicenseRef-Nordic-5-Clause
#

# Log level
# For more verbose and detailed log output, set the log level to
# CONFIG_MULTI_SERVICE_LOG_LEVEL_DBG=y instead.
CONFIG_MULTI_SERVICE_LOG_LEVEL_INF=y

# General config
CONFIG_EVENTS=y
CONFIG_PICOLIBC_IO_FLOAT=y
CONFIG_RESET_ON_FATAL_ERROR=y
CONFIG_NCS_SAMPLES_DEFAULTS=y
CONFIG_DK_LIBRARY=y

# LED indication
# Uncomment these to minimize LED state indication when power savings are necessary
# CONFIG_LED_VERBOSE_INDICATION=n
# CONFIG_LED_CONTINUOUS_INDICATION=n

# Or, uncomment this to completely disable LED state indication
# CONFIG_LED_INDICATION_DISABLED=y

# Improved Logging
# CONFIG_LOG_MODE_DEFERRED allows logging from multiple threads simultaneously without creating
# splintered log entries, at the cost of needing a buffer for storing logs.
CONFIG_LOG_MODE_DEFERRED=y

# CONFIG_LOG_BUFFER_SIZE is the aforementioned buffer. A size of 4096 bytes is useful for debugging
# and prototyping, but is probably more than necessary for production-ready firmware.
CONFIG_LOG_BUFFER_SIZE=4096

# Heap and stacks
# Extended AT host/monitor stack/heap sizes since some nrf_cloud credentials are longer than 1024 bytes.
CONFIG_AT_MONITOR_HEAP_SIZE=2048
CONFIG_AT_HOST_STACK_SIZE=2048
# Extended memory heap size needed both for PGPS and for encoding JSON-based nRF Cloud Device Messages.
CONFIG_HEAP_MEM_POOL_SIZE=19000
CONFIG_SYSTEM_WORKQUEUE_STACK_SIZE=4096
# The default modem shared memory buffer for TX is significantly larger than required.
# RX buffer has to be larger because the sample reads certificates so using default value.
CONFIG_NRF_MODEM_LIB_SHMEM_TX_SIZE=4096

# Enable Networking and Connection Manager.
CONFIG_NETWORKING=y
CONFIG_NET_SOCKETS=y
CONFIG_NET_SOCKETS_OFFLOAD=y
CONFIG_NET_MGMT_EVENT_STACK_SIZE=2048
CONFIG_NET_CONNECTION_MANAGER_MONITOR_STACK_SIZE=1024
CONFIG_MAIN_STACK_SIZE=2048

# Enable LTE Connectivity using Connection Manager
CONFIG_NET_IPV4=y
CONFIG_NET_IPV6=y
CONFIG_NET_IPV6_NBR_CACHE=n
CONFIG_NET_IPV6_MLD=n
CONFIG_NET_CONNECTION_MANAGER=y
CONFIG_NRF_MODEM_LIB_NET_IF=y
CONFIG_NRF_MODEM_LIB_NET_IF_AUTO_DOWN=y
CONFIG_NRF_MODEM_LIB_NET_IF_DOWN_DEFAULT_LTE_DISCONNECT=y

# Enable power savings mode
CONFIG_LTE_PSM_REQ=y
# Set the PSM Requested Active Time to 20 seconds
CONFIG_LTE_PSM_REQ_RAT="00001010"

# Modem library
CONFIG_NRF_MODEM_LIB=y

# AT commands interface
CONFIG_UART_INTERRUPT_DRIVEN=y
CONFIG_AT_HOST_LIBRARY=y

# Wait for credential installation to be complete before connecting to nRF Cloud
CONFIG_NRF_CLOUD_CHECK_CREDENTIALS=y

# nRF Cloud
CONFIG_NRF_CLOUD_MQTT=y # This also enables FOTA by implicitly setting CONFIG_NRF_CLOUD_FOTA=y

# MQTT
CONFIG_MQTT_KEEPALIVE=120

# MCUBOOT - Needed by FOTA
CONFIG_BOOTLOADER_MCUBOOT=y
CONFIG_IMG_MANAGER=y
CONFIG_MCUBOOT_IMG_MANAGER=y
CONFIG_STREAM_FLASH_ERASE=y

# Location Services configuration
CONFIG_LOCATION=y
CONFIG_LOCATION_METHOD_GNSS=y
CONFIG_LOCATION_METHOD_CELLULAR=y
CONFIG_NRF_CLOUD_AGNSS=y
CONFIG_NRF_CLOUD_LOCATION=y
CONFIG_MODEM_INFO=y
CONFIG_MODEM_INFO_ADD_NETWORK=y
CONFIG_NRF_CLOUD_PGPS=y
CONFIG_NRF_CLOUD_PGPS_REPLACEMENT_THRESHOLD=4
CONFIG_NRF_CLOUD_PGPS_REQUEST_UPON_INIT=y

# Date Time lib - Used by PGPS and main application
CONFIG_DATE_TIME=y

# LTE link control - used by PGPS and main application
CONFIG_LTE_LINK_CONTROL=y
CONFIG_LTE_LC_EDRX_MODULE=y
CONFIG_LTE_LC_PSM_MODULE=y

# Settings - used by nRF Cloud library and PGPS
CONFIG_SETTINGS=y
CONFIG_SETTINGS_FCB=y
CONFIG_FCB=y

# Download Client - used by FOTA and PGPS
CONFIG_DOWNLOAD_CLIENT=y
CONFIG_DOWNLOAD_CLIENT_HTTP_FRAG_SIZE_1024=y
CONFIG_DOWNLOAD_CLIENT_STACK_SIZE=4096
CONFIG_DOWNLOAD_CLIENT_BUF_SIZE=2300
CONFIG_DOWNLOAD_CLIENT_MAX_HOSTNAME_SIZE=128

# Flash - Used by FOTA and PGPS
CONFIG_FLASH=y
CONFIG_FLASH_PAGE_LAYOUT=y
CONFIG_FLASH_MAP=y
CONFIG_STREAM_FLASH=y
CONFIG_MPU_ALLOW_FLASH_WRITE=y
CONFIG_PM_EXTERNAL_FLASH_MCUBOOT_SECONDARY=n
CONFIG_NRF_CLOUD_ALERT=y
CONFIG_NRF_CLOUD_LOG_DIRECT=y
CONFIG_NRF_CLOUD_LOG_OUTPUT_LEVEL=3

# On initial connection to the cloud, add info sections to the shadow
CONFIG_NRF_CLOUD_SEND_DEVICE_STATUS=y
CONFIG_NRF_CLOUD_SEND_DEVICE_STATUS_NETWORK=y
CONFIG_NRF_CLOUD_SEND_DEVICE_STATUS_SIM=y
CONFIG_NRF_CLOUD_SEND_SERVICE_INFO_FOTA=y
CONFIG_NRF_CLOUD_SEND_SERVICE_INFO_UI=y
```

## overlay-coap_nrf_provisioning.conf
```kconfig
#
# Copyright (c) 2024 Nordic Semiconductor ASA
#
# SPDX-License-Identifier: LicenseRef-Nordic-5-Clause
#

# Enable provisioning library/provisioning shell dependencies
CONFIG_MODEM_JWT=y
CONFIG_MODEM_ATTEST_TOKEN=y

# Enable the provisioning library
CONFIG_NRF_PROVISIONING=y
CONFIG_NRF_PROVISIONING_AUTO_INIT=n
CONFIG_NRF_PROVISIONING_COAP=y

# Enable provisioning shell
CONFIG_SHELL=y
CONFIG_NRF_PROVISIONING_SHELL=y

# Adjust shell buffer sizes to handle nRF Cloud certs
CONFIG_SHELL_BACKEND_SERIAL_RX_RING_BUFFER_SIZE=4096
CONFIG_SHELL_CMD_BUFF_SIZE=4096
CONFIG_SHELL_BACKEND_SERIAL_API_INTERRUPT_DRIVEN=y

# Disable AT host and switch to using shell
CONFIG_AT_HOST_LIBRARY=n
CONFIG_AT_SHELL=y
CONFIG_SHELL_WILDCARD=n

# Configure provisioning message formatting
CONFIG_NRF_PROVISIONING_CODEC=y
CONFIG_NRF_PROVISIONING_CBOR=y
CONFIG_ZCBOR=y

# Include provisioning service certificate as part of the binary.
# Used only if none has been provisioned
CONFIG_NRF_PROVISIONING_WITH_CERT=y
CONFIG_NRF_PROVISIONING_ROOT_CA_SEC_TAG=42
CONFIG_NRF_CLOUD_CLIENT_ID_SRC_INTERNAL_UUID=y

# Max provisioning commands per response
CONFIG_NRF_PROVISIONING_CBOR_RECORDS=20

# Set the provisioning interval to 60 seconds.
# This is a very frequent interval. To save power, set this to something approaching 24 hours.
# But note that provisioning may take up to twice as long as this interval, since it
# happens in two steps.
CONFIG_NRF_PROVISIONING_INTERVAL_S=60

# Request spread factor
CONFIG_NRF_PROVISIONING_SPREAD_S=5

# Adjust provisioning and buffer sizes to handle nRF Cloud certs
CONFIG_NRF_PROVISIONING_RX_BUF_SZ=4096
CONFIG_NRF_PROVISIONING_TX_BUF_SZ=4096
CONFIG_NRF_PROVISIONING_CODEC_AT_CMD_LEN=2048
CONFIG_NRF_PROVISIONING_CODEC_RX_SZ_START=2048

# CoAP Client
CONFIG_COAP_EXTENDED_OPTIONS_LEN=y
CONFIG_COAP_EXTENDED_OPTIONS_LEN_VALUE=64
CONFIG_COAP_CLIENT_THREAD_PRIORITY=0
CONFIG_COAP_CLIENT_BLOCK_SIZE=1024
CONFIG_COAP_CLIENT_MESSAGE_SIZE=1024
CONFIG_COAP_CLIENT_STACK_SIZE=6144
```

## overlay-http_nrf_provisioning.conf
```kconfig
#
# Copyright (c) 2023 Nordic Semiconductor ASA
#
# SPDX-License-Identifier: LicenseRef-Nordic-5-Clause
#

# Enable provisioning library/provisioning shell dependencies
CONFIG_MODEM_JWT=y
CONFIG_MODEM_ATTEST_TOKEN=y

# Enable the provisioning library
CONFIG_NRF_PROVISIONING=y
CONFIG_NRF_PROVISIONING_AUTO_INIT=n
CONFIG_NRF_PROVISIONING_HTTP=y

# Enable provisioning shell
CONFIG_SHELL=y
CONFIG_NRF_PROVISIONING_SHELL=y

# Adjust shell buffer sizes to handle nRF Cloud certs
CONFIG_SHELL_BACKEND_SERIAL_RX_RING_BUFFER_SIZE=4096
CONFIG_SHELL_CMD_BUFF_SIZE=4096

# Disable AT host and switch to using shell
CONFIG_AT_HOST_LIBRARY=n
CONFIG_AT_SHELL=y
CONFIG_SHELL_WILDCARD=n

# Configure provisioning message formatting
CONFIG_NRF_PROVISIONING_CODEC=y
CONFIG_NRF_PROVISIONING_CBOR=y
CONFIG_ZCBOR=y
CONFIG_ZCBOR_CANONICAL=y

# Include provisioning service certificate as part of the binary.
# Used only if none has been provisioned
CONFIG_NRF_PROVISIONING_WITH_CERT=y
CONFIG_NRF_PROVISIONING_ROOT_CA_SEC_TAG=50
CONFIG_NRF_CLOUD_CLIENT_ID_SRC_INTERNAL_UUID=y

# Max provisioning commands per response
CONFIG_NRF_PROVISIONING_CBOR_RECORDS=20

# Set the provisioning interval to 60 seconds.
# This is a very frequent interval. To save power, set this to something approaching 24 hours.
# But note that provisioning may take up to twice as long as this interval, since it
# happens in two steps.
CONFIG_NRF_PROVISIONING_INTERVAL_S=60

# Request spread factor
CONFIG_NRF_PROVISIONING_SPREAD_S=5

# Adjust provisioning and buffer sizes to handle nRF Cloud certs
CONFIG_NRF_PROVISIONING_RX_BUF_SZ=4096
CONFIG_NRF_PROVISIONING_TX_BUF_SZ=4096
CONFIG_NRF_PROVISIONING_CODEC_AT_CMD_LEN=2048
CONFIG_NRF_PROVISIONING_CODEC_RX_SZ_START=2048
```

## overlay-nrf7002ek-wifi-scan-only.conf
```kconfig
#
# Copyright (c) 2022 Nordic Semiconductor ASA
#
# SPDX-License-Identifier: LicenseRef-Nordic-5-Clause
#

# Overlay to use nRF7002 EK on top of nrf9160 DK for Wi-Fi scanning

# Enable the Wi-Fi location method:
CONFIG_LOCATION_TRACKING_WIFI=y
CONFIG_LOCATION_METHOD_WIFI=y
# Align this with CONFIG_NRF_WIFI_SCAN_MAX_BSS_CNT.
# Also see comments for CONFIG_HEAP_MEM_POOL_SIZE.
CONFIG_LOCATION_METHOD_WIFI_SCANNING_RESULTS_MAX_CNT=10

# Enable Wi-Fi drivers
CONFIG_WIFI=y
CONFIG_WIFI_NRF70=y
CONFIG_WIFI_NRF70_SKIP_LOCAL_ADMIN_MAC=y
# Align this with CONFIG_LOCATION_METHOD_WIFI_SCANNING_RESULTS_MAX_CNT.
# Also see comments for CONFIG_HEAP_MEM_POOL_SIZE.
CONFIG_NRF_WIFI_SCAN_MAX_BSS_CNT=10
CONFIG_NET_L2_ETHERNET=y
# We need 2 to ensure nrf9x_socket gets an IP address regardless of order of net_if array
CONFIG_NET_IF_MAX_IPV4_COUNT=2
CONFIG_NET_IF_MAX_IPV6_COUNT=2

# But disable the supplicant, since we don't need connectivity
CONFIG_WIFI_NM_WPA_SUPPLICANT=n
CONFIG_MBEDTLS=n

# Stack/heap tweaks needed to support Wi-Fi.
# Heap allocation should be changed when CONFIG_LOCATION_METHOD_WIFI_SCANNING_RESULTS_MAX_CNT
# and CONFIG_NRF_WIFI_SCAN_MAX_BSS_CNT (which should be the same value) are changed.
CONFIG_HEAP_MEM_POOL_SIZE=20000
CONFIG_HEAP_MEM_POOL_IGNORE_MIN=y
CONFIG_MAIN_STACK_SIZE=2048
CONFIG_NET_MGMT_EVENT_STACK_SIZE=1024

# NET tweaks needed to support Wi-FI
CONFIG_NET_BUF_RX_COUNT=1
CONFIG_NET_BUF_TX_COUNT=1
CONFIG_NET_PKT_RX_COUNT=1
CONFIG_NET_PKT_TX_COUNT=1
CONFIG_NET_TX_STACK_SIZE=512
CONFIG_NET_RX_STACK_SIZE=512
CONFIG_NET_TC_TX_COUNT=1
CONFIG_NET_MAX_CONTEXTS=5

# Disable LED patterns, enabling WiFi scanning takes control of two LEDs
CONFIG_LED_INDICATION_DISABLED=y
```

## overlay_coap.conf
```kconfig
#
# Copyright (c) 2022 Nordic Semiconductor ASA
#
# SPDX-License-Identifier: LicenseRef-Nordic-5-Clause
#

# General config
CONFIG_FPU=y
CONFIG_NEWLIB_LIBC_NANO=n

# Rate of cloud interactions
# These are faster than one normally would use in a low power device.
# This is strictly for demo purposes.
CONFIG_SENSOR_SAMPLE_INTERVAL_SECONDS=120
CONFIG_LOCATION_TRACKING_SAMPLE_INTERVAL_SECONDS=360
CONFIG_COAP_FOTA_JOB_CHECK_RATE_MINUTES=2
CONFIG_COAP_SHADOW_CHECK_RATE_SECONDS=120

# Logs
CONFIG_LOG=y
CONFIG_NET_LOG=y
CONFIG_LOG_PRINTK=y
CONFIG_COAP_LOG_LEVEL_INF=y
CONFIG_LOCATION_LOG_LEVEL_INF=y
CONFIG_NRF_CLOUD_COAP_LOG_LEVEL_INF=y
CONFIG_MULTI_SERVICE_LOG_LEVEL_INF=y

# LTE link control - used by PGPS and main application
CONFIG_LTE_LINK_CONTROL=y

# Modem
CONFIG_MODEM_KEY_MGMT=y
CONFIG_MODEM_JWT=y
CONFIG_MODEM_INFO_ADD_DEVICE=y
CONFIG_MODEM_INFO_ADD_DATE_TIME=n
CONFIG_MODEM_INFO_ADD_SIM=n
CONFIG_MODEM_INFO_ADD_SIM_ICCID=n
CONFIG_MODEM_INFO_ADD_SIM_IMSI=n

# Network
CONFIG_POSIX_API=y
CONFIG_NET_SOCKETS_TLS_SET_MAX_FRAGMENT_LENGTH=y
CONFIG_NET_SOCKETS_OFFLOAD_PRIORITY=40

# CoAP Client
CONFIG_COAP_CLIENT_BLOCK_SIZE=1024
CONFIG_COAP_CLIENT_STACK_SIZE=2048
CONFIG_COAP_CLIENT_THREAD_PRIORITY=0
CONFIG_COAP_CLIENT_MAX_INSTANCES=3
# The extended options length must be increased to perform FOTA and P-GPS downloads over CoAP.
CONFIG_COAP_EXTENDED_OPTIONS_LEN_VALUE=192

# Not compatible with ground-fix
CONFIG_ZCBOR_CANONICAL=n

# nRF Cloud
CONFIG_NRF_CLOUD_MQTT=n
CONFIG_NRF_CLOUD_COAP=y
CONFIG_NRF_CLOUD_ALERT=y
CONFIG_NRF_CLOUD_LOG_DIRECT=y
CONFIG_NRF_CLOUD_LOG_OUTPUT_LEVEL=3
CONFIG_NRF_CLOUD_LOG_LOG_LEVEL_INF=y
CONFIG_NRF_CLOUD_FOTA_POLL=y

# Disable MQTT-specific services; equivalent CoAP versions are used instead.
CONFIG_NRF_CLOUD_FOTA=n
CONFIG_NRF_CLOUD_LOCATION=n

# Location Services configuration
CONFIG_LOCATION_DATA_DETAILS=y

# Sample configuration
CONFIG_APPLICATION_THREAD_STACK_SIZE=4096
CONFIG_TEMP_ALERT_LIMIT=24
```

## overlay_full_modem_fota.conf
```kconfig
# Copyright (c) 2021 Nordic Semiconductor ASA
#
# SPDX-License-Identifier: LicenseRef-Nordic-5-Clause
#

# Full Modem FOTA
CONFIG_NRF_CLOUD_FOTA_FULL_MODEM_UPDATE=y
CONFIG_SPI=y
CONFIG_SPI_NOR=y
CONFIG_SPI_NOR_FLASH_LAYOUT_PAGE_SIZE=4096
# FMFU_FDEV requires additional stack space
CONFIG_CONNECTION_THREAD_STACK_SIZE=4096
CONFIG_PM_OVERRIDE_EXTERNAL_DRIVER_CHECK=y
CONFIG_PM_EXTERNAL_FLASH_MCUBOOT_SECONDARY=n
CONFIG_PM_SINGLE_IMAGE=y
# FMFU requires additional heap space.
# If the heap is too small, a boot loop can occur when the full modem image is installed.
CONFIG_HEAP_MEM_POOL_SIZE=47250
```

## overlay_min_coap.conf
```kconfig
#
# Copyright (c) 2023 Nordic Semiconductor ASA
#
# SPDX-License-Identifier: LicenseRef-Nordic-5-Clause
#

# Save power by slowing down sample rate, and not using LEDs
CONFIG_SENSOR_SAMPLE_INTERVAL_SECONDS=60
CONFIG_LED_INDICATION_DISABLED=y
# Enable optional power savings mode for carrier roaming; this is compatible
# with nRF Cloud CoAP because communications are always initiated by the device.
# It is not compatible with MQTT.
CONFIG_LTE_PROPRIETARY_PSM_REQ=y

# PSM mode parameters
CONFIG_LTE_PSM_REQ_RPTAU="00100001"
CONFIG_LTE_PSM_REQ_RAT="00000000"

# eDRX
CONFIG_LTE_EDRX_REQ=n
CONFIG_LTE_EDRX_REQ_VALUE_LTE_M="1001"

# Disable serial logging to ensure minimum power draw
CONFIG_LOG=n
CONFIG_SERIAL=n
CONFIG_UART_INTERRUPT_DRIVEN=n
CONFIG_UART_CONSOLE=n
CONFIG_AT_HOST_LIBRARY=n
CONFIG_TFM_LOG_LEVEL_SILENCE=y
CONFIG_PM_DEVICE=y

# nRF Cloud
CONFIG_NRF_CLOUD_MQTT=n
CONFIG_NRF_CLOUD_COAP=y

# Disable most services
CONFIG_LOCATION_TRACKING=n
CONFIG_NRF_CLOUD_AGNSS=n
CONFIG_MODEM_INFO=n
CONFIG_MODEM_INFO_ADD_NETWORK=n
CONFIG_NRF_CLOUD_PGPS=n
CONFIG_NRF_CLOUD_PGPS_REQUEST_UPON_INIT=n
CONFIG_NRF_CLOUD_ALERT=n
CONFIG_NRF_CLOUD_LOG_DIRECT=n
CONFIG_NRF_CLOUD_SEND_DEVICE_STATUS=n
CONFIG_NRF_CLOUD_SEND_DEVICE_STATUS_NETWORK=n
CONFIG_NRF_CLOUD_SEND_DEVICE_STATUS_SIM=n
CONFIG_NRF_CLOUD_FOTA=n
CONFIG_NRF_CLOUD_LOCATION=n
CONFIG_COAP_FOTA=n
CONFIG_COAP_SHADOW=n

# Enable only temperature
CONFIG_TEMP_TRACKING=y

# General config
CONFIG_FPU=y
CONFIG_NEWLIB_LIBC_NANO=n

# LTE link control - used by PGPS and main application
CONFIG_LTE_LINK_CONTROL=y

# Modem
CONFIG_MODEM_KEY_MGMT=y
CONFIG_MODEM_JWT=y

# Network
CONFIG_POSIX_API=y
CONFIG_NET_SOCKETS_TLS_SET_MAX_FRAGMENT_LENGTH=y
CONFIG_NET_SOCKETS_OFFLOAD_PRIORITY=40

# CoAP Client
CONFIG_COAP_CLIENT_BLOCK_SIZE=1024
CONFIG_COAP_CLIENT_STACK_SIZE=6144
CONFIG_COAP_CLIENT_THREAD_PRIORITY=0
CONFIG_COAP_EXTENDED_OPTIONS_LEN_VALUE=40

CONFIG_APPLICATION_THREAD_STACK_SIZE=4096
```

## src/application.c
```c
/* Copyright (c) 2023 Nordic Semiconductor ASA
 *
 * SPDX-License-Identifier: LicenseRef-Nordic-5-Clause
 */

#include <zephyr/kernel.h>
#include <zephyr/logging/log.h>
#include <zephyr/logging/log_ctrl.h>
#include <helpers/nrfx_reset_reason.h>
#include <date_time.h>
#include <stdio.h>
#include <net/nrf_cloud.h>
#include <net/nrf_cloud_codec.h>
#include <net/nrf_cloud_log.h>
#include <net/nrf_cloud_alert.h>
#if defined(CONFIG_NRF_CLOUD_COAP)
#include <net/nrf_cloud_coap.h>
#endif
#if defined(CONFIG_LOCATION_TRACKING)
#include <modem/location.h>
#include "location_tracking.h"
#endif
#include <dk_buttons_and_leds.h>
#include "application.h"
#include "temperature.h"
#include "cloud_connection.h"
#include "message_queue.h"
#include "led_control.h"
#include "at_commands.h"
#include "shadow_config.h"

LOG_MODULE_REGISTER(application, CONFIG_MULTI_SERVICE_LOG_LEVEL);

/* Timer used to time the sensor sampling rate. */
static K_TIMER_DEFINE(sensor_sample_timer, NULL, NULL);

/* AT command request error handling */
#define AT_CMD_REQUEST_ERR_FORMAT "Error while processing AT command request: %d"
#define AT_CMD_REQUEST_ERR_MAX_LEN (sizeof(AT_CMD_REQUEST_ERR_FORMAT) + 20)
BUILD_ASSERT(CONFIG_AT_CMD_REQUEST_RESPONSE_BUFFER_LENGTH >= AT_CMD_REQUEST_ERR_MAX_LEN,
	     "Not enough AT command response buffer for printing error events.");

/* Temperature alert limits. */
#define TEMP_ALERT_LIMIT ((double)CONFIG_TEMP_ALERT_LIMIT)
#define TEMP_ALERT_HYSTERESIS 1.5
#define TEMP_ALERT_LOWER_LIMIT (TEMP_ALERT_LIMIT - TEMP_ALERT_HYSTERESIS)

/* State of the test counter. This can be changed using the configuration in the shadow */
static bool test_counter_enabled;

/**
 * @brief Construct a device message object with automatically generated timestamp
 *
 * The resultant JSON object will be conformal to the General Message Schema described in the
 * application-protocols repo:
 *
 * https://github.com/nRFCloud/application-protocols
 *
 * @param msg - The object to contain the message
 * @param appid - The appId for the device message
 * @param msg_type - The messageType for the device message
 * @return int - 0 on success, negative error code otherwise.
 */
static int create_timestamped_device_message(struct nrf_cloud_obj *const msg,
					     const char *const appid,
					     const char *const msg_type)
{
	int err;
	int64_t timestamp;

	/* Acquire timestamp */
	err = date_time_now(&timestamp);
	if (err) {
		LOG_ERR("Failed to obtain current time, error %d", err);
		return -ETIME;
	}

	/* Create message object */
	err = nrf_cloud_obj_msg_init(msg, appid,
				     IS_ENABLED(CONFIG_NRF_CLOUD_COAP) ? NULL : msg_type);
	if (err) {
		LOG_ERR("Failed to initialize message with appid %s and msg type %s",
			appid, msg_type);
		return err;
	}

	/* Add timestamp to message object */
	err = nrf_cloud_obj_ts_add(msg, timestamp);
	if (err) {
		LOG_ERR("Failed to add timestamp to data message with appid %s and msg type %s",
			appid, msg_type);
		nrf_cloud_obj_free(msg);
		return err;
	}

	return 0;
}

/**
 * @brief Transmit a collected sensor sample to nRF Cloud.
 *
 * @param sensor - The name of the sensor which was sampled.
 * @param value - The sampled sensor value.
 * @return int - 0 on success, negative error code otherwise.
 */
static int send_sensor_sample(const char *const sensor, double value)
{
	int ret;

	MSG_OBJ_DEFINE(msg_obj);

	/* Create a timestamped message container object for the sensor sample. */
	ret = create_timestamped_device_message(&msg_obj, sensor,
						NRF_CLOUD_JSON_MSG_TYPE_VAL_DATA);
	if (ret) {
		return -EINVAL;
	}

	/* Populate the container object with the sensor value. */
	ret = nrf_cloud_obj_num_add(&msg_obj, NRF_CLOUD_JSON_DATA_KEY, value, false);
	if (ret) {
		LOG_ERR("Failed to append value to %s sample container object ",
			sensor);
		nrf_cloud_obj_free(&msg_obj);
		return -ENOMEM;
	}

	/* Send the sensor sample container object as a device message. */
	return send_device_message(&msg_obj);
}

#if defined(CONFIG_LOCATION_TRACKING)
/**
 * @brief Transmit a collected GNSS sample to nRF Cloud.
 *
 * @param loc_gnss - GNSS location data.
 * @return int - 0 on success, negative error code otherwise.
 */
static int send_gnss(const struct location_event_data * const loc_gnss)
{
	int ret;

	if (!loc_gnss || (loc_gnss->method != LOCATION_METHOD_GNSS)) {
		return -EINVAL;
	}

	struct nrf_cloud_gnss_data gnss_pvt = {
		.type = NRF_CLOUD_GNSS_TYPE_PVT,
		.ts_ms = NRF_CLOUD_NO_TIMESTAMP,
		.pvt = {
			.lon		= loc_gnss->location.longitude,
			.lat		= loc_gnss->location.latitude,
			.accuracy	= loc_gnss->location.accuracy,
			.has_alt	= 0,
			.has_speed	= 0,
			.has_heading	= 0
		}
	};
	MSG_OBJ_DEFINE(msg_obj);

	/* Add the timestamp */
	(void)date_time_now(&gnss_pvt.ts_ms);

	/* Encode the location data into a device message */
	ret = nrf_cloud_obj_gnss_msg_create(&msg_obj, &gnss_pvt);

	if (ret == 0) {
		/* Send the location message */
		ret = send_device_message(&msg_obj);
	}

	return ret;
}

/**
 * @brief Callback to receive periodic location updates from location_tracking.c and forward them
 * to nRF Cloud.
 *
 * Note that cellular positioning (MCELL/Multi-Cell and SCELL/Single-Cell) is sent to nRF
 * Cloud automatically (since the Location library and nRF Cloud must work together to
 * determine them in the first place). GNSS positions, on the other hand, must be
 * sent manually, since they are determined entirely on-device.
 *
 * @param location_data - The received location update.
 *
 */
static void on_location_update(const struct location_event_data * const location_data)
{
	LOG_INF("Location Updated: %.06f N %.06f W, accuracy: %.01f m, Method: %s",
		location_data->location.latitude,
		location_data->location.longitude,
		(double)location_data->location.accuracy,
		location_method_str(location_data->method));

	/* If the position update was derived using GNSS, send it onward to nRF Cloud. */
	if (location_data->method == LOCATION_METHOD_GNSS) {
		LOG_INF("GNSS Position Update! Sending to nRF Cloud...");
		send_gnss(location_data);
	}
}
#endif /* CONFIG_LOCATION_TRACKING */

/**
 * @brief Receives general device messages from nRF Cloud, checks if they are AT command requests,
 * and performs them if so, transmitting the modem response back to nRF Cloud.
 *
 * Try sending {"appId":"MODEM", "messageType":"CMD", "data":"AT+CGMR"}
 * in the nRF Cloud Portal Terminal card.
 *
 * @param msg - The device message to check.
 */
static void handle_at_cmd_requests(const struct nrf_cloud_data *const dev_msg)
{
	char *cmd;
	struct nrf_cloud_obj msg_obj;
	int err = nrf_cloud_obj_input_decode(&msg_obj, dev_msg);

	if (err) {
		/* The message isn't JSON or otherwise couldn't be parsed. */
		LOG_DBG("A general topic device message of length %d could not be parsed.",
			dev_msg->len);
		return;
	}

	/* Confirm app ID and message type */
	err = nrf_cloud_obj_msg_check(&msg_obj, NRF_CLOUD_JSON_APPID_VAL_MODEM,
				      NRF_CLOUD_JSON_MSG_TYPE_VAL_CMD);
	if (err) {
		goto cleanup;
	}

	/* Get the command string */
	err = nrf_cloud_obj_str_get(&msg_obj, NRF_CLOUD_JSON_DATA_KEY, &cmd);
	if (err) {
		/* Missing or invalid command value will be treated as a blank command */
		cmd = "";
	}

	/* Execute the command and receive the result */
	char *response = execute_at_cmd_request(cmd);

	/* To re-use msg_obj for the response message we must first free its memory and
	 * reset its state.
	 * The cmd string will no longer be valid after msg_obj is freed.
	 */
	cmd = NULL;
	/* Free the object's allocated memory */
	err = nrf_cloud_obj_free(&msg_obj);
	if (err) {
		LOG_ERR("Failed to free AT CMD request");
		return;
	}

	/* Reset the object's state */
	err = nrf_cloud_obj_reset(&msg_obj);
	if (err) {
		LOG_ERR("Failed to reset AT CMD request message object for reuse");
		return;
	}

	err = create_timestamped_device_message(&msg_obj, NRF_CLOUD_JSON_APPID_VAL_MODEM,
						NRF_CLOUD_JSON_MSG_TYPE_VAL_DATA);
	if (err) {
		return;
	}

	/* Populate response with command result */
	err = nrf_cloud_obj_str_add(&msg_obj, NRF_CLOUD_JSON_DATA_KEY, response, false);
	if (err) {
		LOG_ERR("Failed to populate AT CMD response with modem response data");
		goto cleanup;
	}

	/* Send the response */
	err = send_device_message(&msg_obj);
	if (err) {
		LOG_ERR("Failed to send AT CMD request response, error: %d", err);
	}

	return;

cleanup:
	(void)nrf_cloud_obj_free(&msg_obj);
}

/** @brief Check whether temperature is acceptable.
 * If the device exceeds a temperature limit, send the temperature alert one time.
 * Once the temperature falls below a lower limit, re-enable the temperature alert
 * so it will be sent if limit is exceeded again.
 *
 * The difference between the two limits should be sufficient to prevent sending
 * new alerts if the temperature value oscillates between two nearby values.
 *
 * @param temp - The current device temperature.
 */
static void monitor_temperature(double temp)
{
	static bool temperature_alert_active;

	if ((temp > TEMP_ALERT_LIMIT) && !temperature_alert_active) {
		temperature_alert_active = true;
		(void)nrf_cloud_alert_send(ALERT_TYPE_TEMPERATURE, (float)temp,
					   "Temperature over limit!");
		LOG_INF("Temperature limit %f C exceeded: now %f C.",
			TEMP_ALERT_LIMIT, temp);
	} else if ((temp < TEMP_ALERT_LOWER_LIMIT) && temperature_alert_active) {
		temperature_alert_active = false;
		LOG_INF("Temperature now below limit: %f C.", temp);
	}
}

/** @brief Send an incrementing test counter message to nRF Cloud.
 * If CONFIG_TEST_COUNTER_MULTIPLIER is greater than 1, the counter will be incremented
 * that many times in a row, and a separate test counter message will be sent for each increment.
 */
static void test_counter_send(void)
{
	static int counter;

	for (int i = 0; i < CONFIG_TEST_COUNTER_MULTIPLIER; i++) {
		LOG_INF("Sent test counter = %d", counter);
		(void)send_sensor_sample("COUNT", counter++);
	}
}

static void button_handler(uint32_t button_state, uint32_t has_changed)
{
	if (has_changed & DK_BTN1_MSK) {
		if ((button_state & DK_BTN1_MSK) == DK_BTN1_MSK) {
			LOG_INF("Button pressed");
			(void)nrf_cloud_alert_send(ALERT_TYPE_MSG, 0, "Button pressed");
		}
	}
}

static void print_reset_reason(void)
{
	uint32_t reset_reason;

	reset_reason = nrfx_reset_reason_get();
	LOG_INF("Reset reason: 0x%x", reset_reason);
}

static void report_startup(void)
{
	if (IS_ENABLED(CONFIG_SEND_ONLINE_ALERT)) {
		uint32_t reset_reason;

		reset_reason = nrfx_reset_reason_get();
		nrfx_reset_reason_clear(reset_reason);
		(void)nrf_cloud_alert_send(ALERT_TYPE_DEVICE_NOW_ONLINE, reset_reason, NULL);
	}
}

void main_application_thread_fn(void)
{
	print_reset_reason();

	if (IS_ENABLED(CONFIG_AT_CMD_REQUESTS)) {
		/* Register with connection.c to receive general device messages and check them for
		 * AT command requests.
		 */
		register_general_dev_msg_handler(handle_at_cmd_requests);
	}

	dk_buttons_init(button_handler);

	/* Wait for first connection before starting the application. */
	(void)await_cloud_ready(K_FOREVER);

	report_startup();

	/* Wait for the date and time to become known.
	 * This is needed both for location services and for sensor sample timestamping.
	 */
	LOG_INF("Waiting for modem to determine current date and time");
	if (!await_date_time_known(K_SECONDS(CONFIG_DATE_TIME_ESTABLISHMENT_TIMEOUT_SECONDS))) {
		LOG_WRN("Failed to determine valid date time. Proceeding anyways");
	} else {
		LOG_INF("Current date and time determined");
	}

	const char *protocol = "";

	if (IS_ENABLED(CONFIG_NRF_CLOUD_MQTT)) {
		protocol = "MQTT";
	} else if (IS_ENABLED(CONFIG_NRF_CLOUD_COAP)) {
		protocol = "CoAP";
	}
	nrf_cloud_log_init();
	nrf_cloud_log_control_set(CONFIG_NRF_CLOUD_LOG_OUTPUT_LEVEL);
	/* Send a direct log to the nRF Cloud web portal indicating the sample has started up. */
	(void)nrf_cloud_log_send(LOG_LEVEL_INF,
				 "nRF Cloud multi-service sample has started, "
				 "version: %s, protocol: %s",
				 CONFIG_APP_VERSION, protocol);

#if defined(CONFIG_LOCATION_TRACKING)
	/* Begin tracking location at the configured interval. */
	(void)start_location_tracking(on_location_update,
					CONFIG_LOCATION_TRACKING_SAMPLE_INTERVAL_SECONDS);
#endif

	/* Begin sampling sensors. */
	while (true) {
		/* Start the sensor sample interval timer.
		 * We use a timer here instead of merely sleeping the thread, because the
		 * application thread can be preempted by other threads performing long tasks
		 * (such as periodic location acquisition), and we want to account for these
		 * delays when metering the sample send rate.
		 */
		k_timer_start(&sensor_sample_timer,
			K_SECONDS(CONFIG_SENSOR_SAMPLE_INTERVAL_SECONDS), K_FOREVER);

		if (IS_ENABLED(CONFIG_TEMP_TRACKING)) {
			double temp = -1;

			if (get_temperature(&temp) == 0) {
				LOG_INF("Temperature is %d degrees C", (int)temp);
				(void)send_sensor_sample(NRF_CLOUD_JSON_APPID_VAL_TEMP, temp);

				monitor_temperature(temp);
			}
		}

		if (test_counter_enable_get()) {
			test_counter_send();
		}

		/* Wait out any remaining time on the sample interval timer. */
		k_timer_status_sync(&sensor_sample_timer);

		/* If cloud stops being ready due to network trouble or device being deleted
		 * from the cloud, turn off sensors and wait, then restart sensors.
		 */
		if (!await_cloud_ready(K_NO_WAIT) && is_device_deleted()) {
#if defined(CONFIG_LOCATION_TRACKING)
			(void)location_request_cancel();
#endif
			LOG_INF("Cloud not ready. Pausing sensors.");
			(void)await_cloud_ready(K_FOREVER);
			LOG_INF("Cloud is ready. Enabling sensors.");
#if defined(CONFIG_LOCATION_TRACKING)
			/* Begin tracking location at the configured interval. */
			(void)start_location_tracking(on_location_update,
						  CONFIG_LOCATION_TRACKING_SAMPLE_INTERVAL_SECONDS);
#endif
		}
	}
}

void test_counter_enable_set(const bool enable)
{
	if (IS_ENABLED(CONFIG_TEST_COUNTER)) {
		LOG_DBG("CONFIG_TEST_COUNTER is enabled, ignoring state change request");
	} else {
		LOG_DBG("Test counter %s", enable ? "enabled" : "disabled");
		test_counter_enabled = enable;
	}
}

bool test_counter_enable_get(void)
{
	/* When CONFIG_TEST_COUNTER is enabled the test counter is always enabled */
	return (test_counter_enabled || IS_ENABLED(CONFIG_TEST_COUNTER));
}
```

## src/message_queue.c
```c
/* Copyright (c) 2023 Nordic Semiconductor ASA
 *
 * SPDX-License-Identifier: LicenseRef-Nordic-5-Clause
 */

#include <zephyr/kernel.h>
#include <net/nrf_cloud.h>
#if defined(CONFIG_NRF_CLOUD_COAP)
#include <net/nrf_cloud_coap.h>
#endif
#include <date_time.h>
#include <zephyr/logging/log.h>
#include <net/nrf_cloud_codec.h>

#include "message_queue.h"
#include "cloud_connection.h"

#include "led_control.h"

LOG_MODULE_REGISTER(message_queue, CONFIG_MULTI_SERVICE_LOG_LEVEL);

/* Message Queue for enqueing outgoing messages during offline periods. */
K_MSGQ_DEFINE(device_message_queue,
	      sizeof(struct nrf_cloud_obj *),
	      CONFIG_MAX_OUTGOING_MESSAGES,
	      sizeof(struct nrf_cloud_obj *));

/* Tracks the number of consecutive message-send failures. A total count greater than
 * CONFIG_MAX_CONSECUTIVE_SEND_FAILURES will trigger a connection reset and cooldown.
 * Resets on every successful device message send.
 */
static int send_failure_count;

static struct nrf_cloud_obj *allocate_dev_msg_for_queue(struct nrf_cloud_obj *msg_to_copy)
{
	struct nrf_cloud_obj *new_msg = k_malloc(sizeof(struct nrf_cloud_obj));

	if (new_msg && msg_to_copy) {
		*new_msg = *msg_to_copy;
	}

	return new_msg;
}

static int enqueue_device_message(struct nrf_cloud_obj *const msg_obj, const bool create_copy)
{
	if (!msg_obj) {
		return -EINVAL;
	}

	struct nrf_cloud_obj *q_msg = msg_obj;
	uint32_t msgs_in_q = k_msgq_num_used_get(&device_message_queue);

	LOG_DBG("Messages queue status: %u/%u", msgs_in_q, CONFIG_MAX_OUTGOING_MESSAGES);

	if (msgs_in_q == CONFIG_MAX_OUTGOING_MESSAGES) {
		LOG_WRN("Message queue is full");
		return -ENOSPC;
	}

	if (create_copy) {
		/* Allocate a new nrf_cloud_obj structure for the message queue.
		 * Copy the contents of msg_obj, which contains a pointer to the
		 * original message data, into the new structure.
		 */
		q_msg = allocate_dev_msg_for_queue(msg_obj);
		if (!q_msg) {
			return -ENOMEM;
		}
	}

	/* Attempt to append data onto message queue. */
	LOG_DBG("Adding device message to queue");
	if (k_msgq_put(&device_message_queue, &q_msg, K_NO_WAIT)) {
		LOG_ERR("Device message rejected, outgoing message queue is full");
		if (create_copy) {
			k_free(q_msg);
		}
		return -ENOMEM;
	}

	return 0;
}

static void free_queued_dev_msg_message(struct nrf_cloud_obj *msg_obj)
{
	/* Free the memory pointed to by the msg_obj struct */
	nrf_cloud_obj_free(msg_obj);
	/* Free the msg_obj struct itself */
	k_free(msg_obj);
}

/**
 * @brief Consume (attempt to send) a single device message from the device message queue.
 *	  Waits for nRF Cloud readiness before sending each message.
 *	  If the message fails to send, it will be reenqueued.
 *
 * @return int - 0 on success, otherwise negative error code.
 */
static int consume_device_message(void)
{
	struct nrf_cloud_obj *queued_msg;
	int ret;

	LOG_DBG("Consuming an enqueued device message");

	/* Wait until a message is available to send. */
	ret = k_msgq_get(&device_message_queue, &queued_msg, K_FOREVER);
	if (ret) {
		LOG_ERR("Failed to retrieve item from outgoing message queue, error: %d", ret);
		return -ret;
	}

	/* Wait until we are able to send it. */
	LOG_DBG("Waiting for valid connection before transmitting device message");
	(void)await_cloud_ready(K_FOREVER);

	/* Attempt to send it.
	 *
	 * Note, it is possible (and better) to batch-send device messages when more than one is
	 * queued up. We limit this sample to sending individual messages mainly to keep the sample
	 * simple and accessible. See the Asset Tracker V2 application for an example of batch
	 * message sending.
	 */
	LOG_DBG("Attempting to transmit enqueued device message");
	LOG_DBG("Messages remaining in queue: %u", k_msgq_num_used_get(&device_message_queue));

#if defined(CONFIG_NRF_CLOUD_MQTT)
	struct nrf_cloud_tx_data mqtt_msg = {
		.qos = MQTT_QOS_1_AT_LEAST_ONCE,
		.topic_type = NRF_CLOUD_TOPIC_MESSAGE,
		.obj = queued_msg
	};

	/* Send message */
	ret = nrf_cloud_send(&mqtt_msg);

#elif defined(CONFIG_NRF_CLOUD_COAP)
	ret = nrf_cloud_coap_obj_send(queued_msg, IS_ENABLED(CONFIG_COAP_SEND_CONFIRMABLE));

#endif /* CONFIG_NRF_CLOUD_COAP */

	if (ret < 0) {
		LOG_ERR("Transmission of enqueued device message failed, nrf_cloud_send "
			"gave error: %d. The message will be re-enqueued and tried again "
			"later.", ret);

		/* Re-enqueue the message for later retry.
		 * No need to create a copy since we already copied the
		 * message object struct when it was first enqueued.
		 */
		ret = enqueue_device_message(queued_msg, false);
		if (ret) {
			LOG_ERR("Could not re-enqueue message, discarding.");
			free_queued_dev_msg_message(queued_msg);
		}

		/* Increment the failure counter. */
		send_failure_count += 1;

		/* If we have failed too many times in a row, there is likely a bigger problem,
		 * and we should reset our connection to nRF Cloud, and wait for a few seconds.
		 */
		if (send_failure_count > CONFIG_MAX_CONSECUTIVE_SEND_FAILURES) {
			/* Disconnect. */
			disconnect_cloud();

			/* Wait for a few seconds before trying again. */
			k_sleep(K_SECONDS(CONFIG_CONSECUTIVE_SEND_FAILURE_COOLDOWN_SECONDS));
		}
	} else {
		/* Clean up the message receive from the queue */
		free_queued_dev_msg_message(queued_msg);

		LOG_DBG("Enqueued device message consumed successfully");

		/* Either overwrite the existing pattern with a short success pattern, or just
		 * disable the previously requested pattern, depending on if we are in verbose mode.
		 */
		if (IS_ENABLED(CONFIG_LED_VERBOSE_INDICATION)) {
			short_led_pattern(LED_SUCCESS);
		} else {
			stop_led_pattern();
		}

		/* Reset the failure counter, since we succeeded. */
		send_failure_count = 0;
	}

	return ret;
}

int send_device_message(struct nrf_cloud_obj *const msg_obj)
{
	/* Enqueue the message, creating a copy to be managed by the queue. */
	int ret = enqueue_device_message(msg_obj, true);

	if (ret) {
		LOG_ERR("Cannot add message to queue");
		nrf_cloud_obj_free(msg_obj);
	} else {
		/* The message data now belongs to the queue.
		 * Reset the provided object so it cannot be modified.
		 */
		nrf_cloud_obj_reset(msg_obj);
	}

	return ret;
}

void message_queue_thread_fn(void)
{
	/* Continually attempt to consume device messages */
	while (true) {
		(void) consume_device_message();
	}
}
```

## src/provisioning_support.h
```c
/* Copyright (c) 2023 Nordic Semiconductor ASA
 *
 * SPDX-License-Identifier: LicenseRef-Nordic-5-Clause
 */

#ifndef _SAMPLE_REBOOT_H_
#define _SAMPLE_REBOOT_H_

#include <zephyr/kernel.h>

/**
 * @brief Sleep until the provisioning library is idle.
 *
 * @param timeout - The time to wait before timing out.
 * @return true if the provisioning library became idle in time.
 * @return false if timed out.
 */
#if defined(CONFIG_NRF_PROVISIONING)

bool await_provisioning_idle(k_timeout_t timeout);

#else /*CONFIG_NRF_PROVISIONING*/

static inline bool await_provisioning_idle(k_timeout_t timeout)
{
	return true;
}

#endif /*CONFIG_NRF_PROVISIONING*/

#endif /* _SAMPLE_REBOOT_H_ */
```
