## CMakeLists.txt
```
#
# Copyright (c) 2024 Nordic Semiconductor ASA
#
# SPDX-License-Identifier: LicenseRef-Nordic-5-Clause
#

cmake_minimum_required(VERSION 3.20.0)

set(EXTRA_DTC_OVERLAY_FILE "dts.overlay")

find_package(Zephyr REQUIRED HINTS $ENV{ZEPHYR_BASE})
project(nrf_wifi_thread_coex)

target_sources(app PRIVATE
	src/ot_utils.c
	src/zperf_utils.c
	src/ot_coex_functions.c
	src/main.c
)

# For net_private.h
target_include_directories(app PUBLIC
	${ZEPHYR_BASE}/subsys/net/ip
)
```

## sample.yaml
```
sample:
  description: Wi-Fi Thread coex sample
    application
  name: Wi-Fi Thread coex
tests:
  sample.nrf7002.thread_coex_sep_ant:
    sysbuild: true
    build_only: true
    integration_platforms:
      - nrf7002dk/nrf5340/cpuapp
    extra_args: CONFIG_MPSL_CX=y ipc_radio_CONFIG_MPSL_CX=y
                CONFIG_COEX_SEP_ANTENNAS=y
                EXTRA_CONF_FILE="overlay-wifi-udp-client-thread-udp-client.conf"
    platform_allow: nrf7002dk/nrf5340/cpuapp
    tags: ci_build sysbuild ci_samples_wifi
  sample.nrf7001.thread_coex:
    sysbuild: true
    build_only: true
    integration_platforms:
      - nrf7002dk/nrf5340/cpuapp/nrf7001
    extra_args: CONFIG_MPSL_CX=y ipc_radio_CONFIG_MPSL_CX=y
                CONFIG_COEX_SEP_ANTENNAS=y
                EXTRA_CONF_FILE="overlay-wifi-udp-client-thread-udp-client.conf"
    platform_allow: nrf7002dk/nrf5340/cpuapp/nrf7001
    tags: ci_build sysbuild ci_samples_wifi
  sample.nrf7002ek.thread_coex:
    sysbuild: true
    build_only: true
    integration_platforms:
      - nrf5340dk/nrf5340/cpuapp
    extra_args: SHIELD=nrf7002ek
                CONFIG_MPSL_CX=y ipc_radio_CONFIG_MPSL_CX=y
                CONFIG_COEX_SEP_ANTENNAS=y
                EXTRA_CONF_FILE="overlay-wifi-udp-client-thread-udp-client.conf"
    platform_allow: nrf5340dk/nrf5340/cpuapp
    tags: ci_build sysbuild ci_samples_wifi
  sample.nrf7001ek.thread_coex:
    sysbuild: true
    build_only: true
    integration_platforms:
      - nrf5340dk/nrf5340/cpuapp
    extra_args: SHIELD=nrf7002ek_nrf7001
                CONFIG_MPSL_CX=y ipc_radio_CONFIG_MPSL_CX=y
                CONFIG_COEX_SEP_ANTENNAS=y
                EXTRA_CONF_FILE="overlay-wifi-udp-client-thread-udp-client.conf"
    platform_allow: nrf5340dk/nrf5340/cpuapp
    tags: ci_build sysbuild ci_samples_wifi
  sample.nrf7002_eb.thingy53.thread_coex:
    sysbuild: true
    build_only: true
    extra_args: thread_coex_SHIELD=nrf7002eb ipc_radio_SHIELD=nrf7002eb_coex
                CONFIG_MPSL_CX=y ipc_radio_CONFIG_MPSL_CX=y
                CONFIG_COEX_SEP_ANTENNAS=y
                EXTRA_CONF_FILE="overlay-wifi-udp-client-thread-udp-client.conf"
    integration_platforms:
      - thingy53/nrf5340/cpuapp
    platform_allow: thingy53/nrf5340/cpuapp
    tags: ci_build sysbuild ci_samples_wifi
```

## prj.conf
```kconfig
#
# Copyright (c) 2024 Nordic Semiconductor ASA
#
# SPDX-License-Identifier: LicenseRef-Nordic-5-Clause
#
CONFIG_WIFI=y
CONFIG_WIFI_NRF70=y
CONFIG_NRF70_SR_COEX=y
CONFIG_NRF70_SR_COEX_RF_SWITCH=y

# WPA supplicant
CONFIG_WIFI_NM_WPA_SUPPLICANT=y

# Networking
CONFIG_NETWORKING=y
CONFIG_NET_SOCKETS=y
CONFIG_NET_LOG=y
CONFIG_NET_IPV4=y
CONFIG_NET_UDP=y
CONFIG_NET_TCP=y
CONFIG_NET_DHCPV4=y

CONFIG_NET_IF_UNICAST_IPV4_ADDR_COUNT=2
CONFIG_NET_MAX_CONTEXTS=8
CONFIG_NET_CONTEXT_SYNC_RECV=y

CONFIG_INIT_STACKS=y

CONFIG_NET_L2_ETHERNET=y

CONFIG_NET_CONFIG_SETTINGS=y
CONFIG_NET_CONFIG_INIT_TIMEOUT=0

# Memories
CONFIG_MAIN_STACK_SIZE=5200
CONFIG_NET_TX_STACK_SIZE=4096
CONFIG_NET_RX_STACK_SIZE=4096

# Debugging
CONFIG_STACK_SENTINEL=y
CONFIG_DEBUG_COREDUMP=y
CONFIG_DEBUG_COREDUMP_BACKEND_LOGGING=y
CONFIG_DEBUG_COREDUMP_MEMORY_DUMP_MIN=y

# Kernel options
CONFIG_ENTROPY_GENERATOR=y

# Logging
CONFIG_LOG=y
CONFIG_PRINTK=y
CONFIG_POSIX_CLOCK=y

# Benchmarking
CONFIG_NET_ZPERF=y
CONFIG_ZVFS_OPEN_MAX=16

# Optimized networking settings for performance
CONFIG_NET_TC_TX_COUNT=1
CONFIG_HEAP_MEM_POOL_SIZE=230000

# Below Wi-Fi configs need to be modified based on security
CONFIG_WIFI_MGMT_EXT=y
CONFIG_WIFI_CREDENTIALS=y
CONFIG_WIFI_CREDENTIALS_STATIC=y
CONFIG_WIFI_CREDENTIALS_STATIC_SSID="Myssid"
CONFIG_WIFI_CREDENTIALS_STATIC_PASSWORD="Mypassword"

CONFIG_NET_CONFIG_MY_IPV4_ADDR="192.168.1.99"
CONFIG_NET_CONFIG_MY_IPV4_NETMASK="255.255.255.0"
CONFIG_NET_CONFIG_MY_IPV4_GW="192.168.1.1"

# DUT Wi-Fi zperf configuration
CONFIG_WIFI_ZPERF_PKT_SIZE=1024
CONFIG_WIFI_ZPERF_RATE=10000

CONFIG_NRF70_MAX_TX_PENDING_QLEN=12
CONFIG_NRF_WIFI_LOW_POWER=y
CONFIG_NRF70_QSPI_LOW_POWER=n

CONFIG_LOG_BUFFER_SIZE=2048
CONFIG_NET_MGMT_EVENT_QUEUE_TIMEOUT=5000

# Thread configurations
CONFIG_OT_CHANNEL=22
CONFIG_OT_PAN_ID=1
CONFIG_OT_PACKET_SIZE=256
CONFIG_OT_RATE_BPS=65000

CONFIG_NET_ZPERF=y
CONFIG_NET_LOG=y

# To handle multiple interfaces.
CONFIG_NET_CONFIG_SETTINGS=y
CONFIG_NET_CONFIG_INIT_TIMEOUT=0
CONFIG_NET_CONFIG_AUTO_INIT=n

# test duration in milliseconds
CONFIG_COEX_TEST_DURATION=30000

CONFIG_NET_SOCKETS_POLL_MAX=10
CONFIG_MBEDTLS_MD_C=y

CONFIG_NET_L2_OPENTHREAD=y
CONFIG_OPENTHREAD_NORDIC_LIBRARY_MASTER=y
CONFIG_NET_IF_MAX_IPV6_COUNT=2
CONFIG_NET_IF_MAX_IPV4_COUNT=2
CONFIG_NET_MGMT_EVENT_QUEUE_SIZE=8
# Required by WIFI
CONFIG_MBEDTLS_SHA1_C=y

# Optimized networking settings for performance
CONFIG_NET_PKT_RX_COUNT=2
CONFIG_NET_PKT_TX_COUNT=8
CONFIG_NET_BUF_RX_COUNT=2
CONFIG_NET_BUF_TX_COUNT=16

# Wi-Fi zperf configuration
CONFIG_WIFI_ZPERF_PROT_UDP=y
CONFIG_WIFI_ZPERF_SERVER=n

# Thread zperf configuration
CONFIG_OT_ZPERF_PROT_UDP=y
CONFIG_OT_ROLE_CLIENT=y

# control log level
CONFIG_OPENTHREAD_L2_LOG_LEVEL_OFF=y
CONFIG_IEEE802154_DRIVER_LOG_LEVEL_OFF=y
CONFIG_NET_PKT_LOG_LEVEL_OFF=y
```

## dts.overlay
```dts
&uart0 {
	/* Disabling hardware flow control to free up pins for other purposes. */
     /delete-property/ hw-flow-control;
};
```

## src/main.h
```c
/*
 * Copyright (c) 2024 Nordic Semiconductor ASA
 *
 * SPDX-License-Identifier: LicenseRef-Nordic-5-Clause
 */

#ifndef MAIN_H_
#define MAIN_H_

#include <stdio.h>
#include <stdlib.h>
#include <string.h>
#include <stdbool.h>

#include <zephyr/logging/log.h>
LOG_MODULE_REGISTER(main, CONFIG_LOG_DEFAULT_LEVEL);

#include <zephyr/kernel.h>
#include <zephyr/init.h>
#include <zephyr/device.h>
#include <zephyr/devicetree.h>
#include <zephyr/drivers/gpio.h>
#include <zephyr/shell/shell.h>
#include <zephyr/shell/shell_uart.h>
#include <zephyr/sys/byteorder.h>
#include <zephyr/net/zperf.h>
#include <zephyr/net/net_if.h>
#include <zephyr/net/wifi_mgmt.h>
#include <zephyr/net/net_event.h>
#include <zephyr/net/socket.h>

#include "coex.h"
#include "fmac_main.h"


/**
 * @brief Function to test Wi-Fi throughput client/server and Thread throughput client/server
 *
 * @return Zero on success or (negative) error code otherwise.
 */
int wifi_tput_ot_tput(bool test_wifi, bool is_ant_mode_sep, bool test_thread,
		bool is_ot_client, bool is_wifi_server, bool is_wifi_zperf_udp,
		bool is_ot_zperf_udp, bool is_sr_protocol_ble);

/**
 * @brief memset_context
 *
 * @return No return value.
 */
void memset_context(void);

/**
 * @brief Handle net management callbacks
 *
 * @return No return value.
 */
void wifi_mgmt_callback_functions(void);

/**
 * @brief Wi-Fi init.
 *
 * @return None
 */
void wifi_init(void);

/**
 * @brief Network configuration
 *
 * @return status
 */
int net_config_init_app(const struct device *dev, const char *app_info);

#endif /* MAIN_H_ */
```

## src/ot_coex_functions.h
```c
/*
 * Copyright (c) 2024 Nordic Semiconductor ASA
 *
 * SPDX-License-Identifier: LicenseRef-Nordic-5-Clause
 */

#ifndef OT_COEX_FUNCTIONS_
#define OT_COEX_FUNCTIONS_

#include <stdio.h>
#include <stdlib.h>
#include <string.h>

#include <zephyr/logging/log.h>
LOG_MODULE_REGISTER(ot_coex_functions, CONFIG_LOG_DEFAULT_LEVEL);

#include <zephyr/kernel.h>
#include <zephyr/init.h>
#include <zephyr/device.h>
#include <zephyr/devicetree.h>
#include <zephyr/drivers/gpio.h>
#include <zephyr/shell/shell.h>
#include <zephyr/shell/shell_uart.h>
#include <zephyr/sys/byteorder.h>
#include <zephyr/net/zperf.h>
#include <zephyr/net/net_if.h>
#include <zephyr/net/wifi_mgmt.h>
#include <zephyr/net/net_event.h>
#include <zephyr/net/socket.h>
#include <zephyr/net/wifi_utils.h>

#include <net/wifi_mgmt_ext.h>

/* For net_sprint_ll_addr_buf */
#include "net_private.h"

#include "coex.h"
#include "coex_struct.h"
#include "fmac_main.h"
#include "ot_utils.h"

#define DEMARCATE_TEST_START

#define KSLEEP_WHILE_CHECK_1SEC K_SECONDS(1)
#define KSLEEP_100MSEC K_MSEC(100)

static uint8_t wait4_peer_wifi_client_to_start_tput;

static struct sockaddr_in in4_addr_my = {
	.sin_family = AF_INET,
	.sin_port = htons(CONFIG_NET_CONFIG_PEER_IPV4_PORT),
};

static struct {
	uint8_t connected :1;
	uint8_t disconnect_requested: 1;
	uint8_t _unused : 6;
} wifi_context;

K_SEM_DEFINE(wait_for_next, 0, 1);
K_SEM_DEFINE(udp_tcp_callback, 0, 1);

/**
 * @brief configure PTA registers
 *
 * @return Zero on success or (negative) error code otherwise.
 */
int config_pta(bool is_ant_mode_sep, bool is_ot_client,
				bool is_wifi_server, bool is_sr_protocol_ble);

/**
 * @brief Start wi-fi traffic for zperf udp upload or download
 *
 * @return Zero on success or (negative) error code otherwise.
 */
int run_wifi_traffic_udp(bool is_wifi_server);

/**
 * @brief Start wi-fi traffic for zperf tcp upload or download
 *
 * @return Zero on success or (negative) error code otherwise.
 */
int run_wifi_traffic_tcp(bool is_wifi_server);

/**
 * @brief check if Wi-Fi traffic is complete
 *
 * @return None
 */
void check_wifi_traffic(void);

/**
 * @brief Disconnect Wi-Fi
 *
 * @return None
 */
void wifi_disconnection(void);

/**
 * @brief Exit Thread throughput test
 *
 * @return None
 */
void ot_throughput_test_exit(void);

/**
 * @brief Print Wi-Fi status
 *
 * @return Zero on success or (negative) error code otherwise.
 */
int cmd_wifi_status(void);

/**
 * @brief Request Wi-Fi connection
 *
 * @return Zero on success or (negative) error code otherwise.
 */
int wifi_connect(void);

/**
 * @brief Request Wi-Fi disconnection
 *
 * @return Zero on success or (negative) error code otherwise.
 */
int wifi_disconnect(void);

/**
 * @brief parse Wi-Fi IPv4 address
 *
 * @return Zero on success or (negative) error code otherwise.
 */
int parse_ipv4_addr(char *host, struct sockaddr_in *addr);

/**
 * @brief wait for next Wi-Fi event
 *
 * @return Zero on success or (negative) error code otherwise.
 */
int wifi_wait_for_next_event(const char *event_name, int timeout);

/**
 * @brief Callback for UDP download results
 *
 * @return None
 */
void udp_download_results_cb(enum zperf_status status,
	struct zperf_results *result,
	void *user_data);

/**
 * @brief Callback for UDP upload results
 *
 * @return None
 */
void udp_upload_results_cb(enum zperf_status status,
	struct zperf_results *result,
	void *user_data);

/**
 * @brief Callback for TCP download results
 *
 * @return None
 */
void tcp_download_results_cb(enum zperf_status status,
	struct zperf_results *result,
	void *user_data);

/**
 * @brief Callback for TCP upload results
 *
 * @return None
 */
void tcp_upload_results_cb(enum zperf_status status,
	struct zperf_results *result,
	void *user_data);
/**
 * @brief Print common test parameters info
 *
 * @return None
 */
void print_common_test_params(bool is_ant_mode_sep, bool test_thread, bool test_wifi,
	bool is_ot_client);

/**
 * @brief Print throughput test parameters info
 *
 * @return None
 */
int print_wifi_tput_ot_tput_test_details(bool is_ot_client, bool is_wifi_server,
	bool is_wifi_zperf_udp,	bool is_ot_zperf_udp);

/* wifi_utils.h */
#define MAX_SSID_LEN 32
#define WIFI_CONNECTION_TIMEOUT_SEC 30 /* in seconds */
#define WIFI_DHCP_TIMEOUT_SEC 10 /* in seconds */

#define DEMARCATE_TEST_START

#define TXPOWER_INIT_VALUE 127
#define RSSI_INIT_VALUE 127

#define HIGHEST_CHANNUM_24G 14

uint32_t wifi_disconn_success_cnt;
uint32_t wifi_disconn_fail_cnt;
uint32_t wifi_disconn_no_conn_cnt;

int8_t wifi_rssi = RSSI_INIT_VALUE;
static int print_wifi_conn_status_once = 1;

struct wifi_iface_status wifi_if_status = { 0 };

static struct net_mgmt_event_callback wifi_sta_mgmt_cb;
static struct net_mgmt_event_callback net_addr_mgmt_cb;

#define WIFI_MGMT_EVENTS (NET_EVENT_WIFI_CONNECT_RESULT | NET_EVENT_WIFI_DISCONNECT_RESULT)

/**
 * @brief Handle Wi-Fi management events
 *
 * @return No return value.
 */
void wifi_mgmt_event_handler(struct net_mgmt_event_callback *cb, uint32_t mgmt_event,
	struct net_if *iface);

/**
 * @brief Handle net management events
 *
 * @return No return value.
 */
void net_mgmt_event_handler(struct net_mgmt_event_callback *cb, uint32_t mgmt_event,
	struct net_if *iface);

/**
 * @brief Callback for Wi-Fi connection result
 *
 * @return No return value.
 */
void handle_wifi_connect_result(struct net_mgmt_event_callback *cb);

/**
 * @brief Callback for Wi-Fi disconnection result
 *
 * @return No return value.
 */
void handle_wifi_disconnect_result(struct net_mgmt_event_callback *cb);

/**
 * @brief Callback for Wi-Fi scan result
 *
 * @return No return value.
 */
void handle_wifi_scan_result(struct net_mgmt_event_callback *cb);

/**
 * @brief Callback for Wi-Fi scan done
 *
 * @return No return value.
 */
void handle_wifi_scan_done(struct net_mgmt_event_callback *cb);

/**
 * @brief Callback for Wi-Fi DHCP IP address
 *
 * @return None
 */
void print_dhcp_ip(struct net_mgmt_event_callback *cb);

#endif /* OT_COEX_FUNCTIONS_ */
```

## src/ot_utils.c
```c
/*
 * Copyright (c) 2024 Nordic Semiconductor ASA
 *
 * SPDX-License-Identifier: LicenseRef-Nordic-5-Clause
 */

#include <stdio.h>

#include "ot_utils.h"
#include "zperf_utils.h"

#include "openthread/ping_sender.h"
#include <zephyr/logging/log.h>
#include <openthread/thread.h>
#include <zephyr/shell/shell.h>
#include <zephyr/shell/shell_uart.h>

LOG_MODULE_REGISTER(ot_utils, CONFIG_LOG_DEFAULT_LEVEL);

#include <zephyr/kernel.h>
#include <zephyr/console/console.h>
#include <zephyr/types.h>

/* #define WAIT_TIME_FOR_OT_CON K_SECONDS(4) */
/* Note: current value of WAIT_TIME_FOR_OT_CON = 4sec.
 * Sometimes, starting openthread happening before
 * the thread join failed.So, increase it to 10sec.
 */
#define WAIT_TIME_FOR_OT_CON K_SECONDS(10)
#define GET_PEER_ADDR_WAIT_TIME 5000
#define CHECK_OT_ROLE_WAIT_TIME 50

typedef struct peer_address_info {
	char address_string[OT_IP6_ADDRESS_STRING_SIZE];
	bool address_found;
} peer_address_info_t;

peer_address_info_t peer_address_info  = {.address_found = false};

extern uint8_t ot_wait4_ping_reply_from_peer;
extern bool is_ot_device_role_client;

static K_SEM_DEFINE(connected_sem, 0, 1);

static void ot_device_dettached(void *ptr)
{
	(void) ptr;

	LOG_INF("\nOT device dettached gracefully\n");
}

static void ot_commissioner_state_changed(otCommissionerState aState, void *aContext)
{
	LOG_INF("OT commissioner state changed");
	if (aState == OT_COMMISSIONER_STATE_ACTIVE) {
		LOG_INF("ot commissioner joiner add * FEDCBA9876543210 2000");
		otCommissionerAddJoiner(openthread_get_default_instance(), NULL,
		"FEDCBA9876543210", 2000);
		LOG_INF("\n\nRun thread application on client\n\n");
	}
}

static void ot_thread_state_changed(otChangedFlags flags, struct openthread_context *ot_context,
				    void *user_data)
{
	LOG_INF("OT device state changed");
	if (flags & OT_CHANGED_THREAD_ROLE) {
		otDeviceRole ot_role = otThreadGetDeviceRole(ot_context->instance);

		if (ot_role != OT_DEVICE_ROLE_DETACHED && ot_role != OT_DEVICE_ROLE_DISABLED) {
			/* ot commissioner start */
			LOG_INF("ot commissioner start");
			otCommissionerStart(ot_context->instance, &ot_commissioner_state_changed,
			NULL, NULL);
		}
	}
}

static struct openthread_state_changed_cb ot_state_chaged_cb = {
	.state_changed_cb = ot_thread_state_changed
};

/* call back Thread device joiner */
static void ot_joiner_start_handler(otError error, void *context)
{
	switch (error) {

	case OT_ERROR_NONE:
		LOG_INF("Thread Join success");
		k_sem_give(&connected_sem);
	break;

	default:
		LOG_ERR("Thread join failed [%s]", otThreadErrorToString(error));
	break;
	}
}

int ot_throughput_client_init(void)
{
	otError err = 0;
	uint32_t ot_role_non_child = 0;

	ot_start_joiner("FEDCBA9876543210");
	err = k_sem_take(&connected_sem, WAIT_TIME_FOR_OT_CON);
	struct openthread_context *context = openthread_get_default_context();

	LOG_INF("Starting openthread.");
	openthread_api_mutex_lock(context);
	/*  ot thread start */
	err = otThreadSetEnabled(openthread_get_default_instance(), true);
	if (err != OT_ERROR_NONE) {
		LOG_ERR("Starting openthread: %d (%s)", err, otThreadErrorToString(err));
	}

	otDeviceRole current_role =
		otThreadGetDeviceRole(openthread_get_default_instance());
	openthread_api_mutex_unlock(context);

	LOG_INF("Current role: %s. Waiting to get child role",
		otThreadDeviceRoleToString(current_role));

	while (current_role != OT_DEVICE_ROLE_CHILD) {
		k_sleep(K_MSEC(CHECK_OT_ROLE_WAIT_TIME));
		openthread_api_mutex_lock(context);
		current_role = otThreadGetDeviceRole(openthread_get_default_instance());
		openthread_api_mutex_unlock(context);
		/* Avoid infinite waiting if the device role is not child */
		if (current_role == OT_DEVICE_ROLE_ROUTER) {
			ot_role_non_child = 1;
			break;
		}
	}

	if (ot_role_non_child) {
		LOG_ERR("\nCurrent role of Thread device: %s",
			otThreadDeviceRoleToString(current_role));
		LOG_ERR("Current role is not child, exiting the test. Re-run the test\n");
		return -1;
	}
	ot_get_peer_address(GET_PEER_ADDR_WAIT_TIME);
	if (!peer_address_info.address_found) {
		LOG_WRN("Peer address not found. Not continuing with zperf test.");
		return -1;
	}
	return 0;
}

int ot_throughput_test_run(bool is_ot_zperf_udp)
{
	if (is_ot_device_role_client) {
		ot_zperf_test(is_ot_zperf_udp);
		/* Only for client case. Server case is handled as part of init */
	}
	return 0;
}

void ot_start_joiner(const char *pskd)
{
	LOG_INF("Starting joiner");

	otInstance *instance = openthread_get_default_instance();
	struct openthread_context *context = openthread_get_default_context();

	openthread_api_mutex_lock(context);

	/** Step1: Set null network key i.e,
	 * ot networkkey 00000000000000000000000000000000
	 */
	/* ot_setNullNetworkKey(instance); */

	/** Step2: Bring up the interface and start joining to the network
	 * on DK2 with pre-shared key.
	 * i.e. ot ifconfig up
	 * ot joiner start FEDCBA9876543210
	 */
	otIp6SetEnabled(instance, true); /* ot ifconfig up */
	otJoinerStart(instance, pskd, NULL,
				"Zephyr", "Zephyr",
				KERNEL_VERSION_STRING, NULL,
				&ot_joiner_start_handler, NULL);
	openthread_api_mutex_unlock(context);
	/* LOG_INF("Thread start joiner Done."); */
}

int ot_throughput_test_init(bool is_ot_client, bool is_ot_zperf_udp)
{
	int ret = 0;

	if (is_ot_client) {
		ret = ot_throughput_client_init();
		if (ret != 0) {
			LOG_ERR("Thread throughput client init failed: %d", ret);
			return ret;
		}
	}
	if (!is_ot_client) { /* for server */
		ot_initialization();
		openthread_state_changed_cb_register(openthread_get_default_context(),
		&ot_state_chaged_cb);

		LOG_INF("Starting zperf server");
		ot_start_zperf_test_recv(is_ot_zperf_udp);
	}
	return 0;
}

int ot_tput_test_exit(void)
{
	otInstance *instance = openthread_get_default_instance();
	struct openthread_context *context = openthread_get_default_context();

	otThreadDetachGracefully(instance, ot_device_dettached, context);
	k_sleep(K_MSEC(1000));

	return 0;
}

void ot_setNullNetworkKey(otInstance *aInstance)
{
	otOperationalDataset aDataset;
	uint8_t key[OT_NETWORK_KEY_SIZE] = {0x00, 0x00, 0x00, 0x00, 0x00, 0x00, 0x00, 0x00,
		0x00, 0x00, 0x00, 0x00, 0x00, 0x00, 0x00, 0x00};

	/* memset(&aDataset, 0, sizeof(otOperationalDataset)); */ /* client */
	otDatasetCreateNewNetwork(aInstance, &aDataset); /* server */


	/* Set network key to null */
	memcpy(aDataset.mNetworkKey.m8, key, sizeof(aDataset.mNetworkKey));
	aDataset.mComponents.mIsNetworkKeyPresent = true;
	otDatasetSetActive(aInstance, &aDataset);
}

void ot_setNetworkConfiguration(otInstance *aInstance)
{
	static const char aNetworkName[] = "TestNetwork";
	otOperationalDataset aDataset;
	size_t length;
	uint8_t extPanId[OT_EXT_PAN_ID_SIZE] = {0x11, 0x11, 0x11, 0x11,	0x11, 0x11, 0x11, 0x11};
	uint8_t key[OT_NETWORK_KEY_SIZE] = {0x11, 0x11, 0x11, 0x11, 0x11, 0x11, 0x11, 0x11,
		0x11, 0x11, 0x11, 0x11, 0x11, 0x11, 0x11, 0x11};

	/* memset(&aDataset, 0, sizeof(otOperationalDataset)); */
	otDatasetCreateNewNetwork(aInstance, &aDataset);

	/**
	 * Fields that can be configured in otOperationDataset to override defaults:
	 *     Network Name, Mesh Local Prefix, Extended PAN ID, PAN ID, Delay Timer,
	 *     Channel, Channel Mask Page 0, Network Key, PSKc, Security Policy
	 */

	aDataset.mActiveTimestamp.mSeconds = 1;
	aDataset.mActiveTimestamp.mTicks = 0;
	aDataset.mActiveTimestamp.mAuthoritative = false;
	aDataset.mComponents.mIsActiveTimestampPresent = true;

	/* Set Channel */
	aDataset.mChannel = CONFIG_OT_CHANNEL;
	aDataset.mComponents.mIsChannelPresent = true;

	/* Set Pan ID */
	aDataset.mPanId = (otPanId)CONFIG_OT_PAN_ID;
	aDataset.mComponents.mIsPanIdPresent = true;

	/* Set Extended Pan ID */
	memcpy(aDataset.mExtendedPanId.m8, extPanId, sizeof(aDataset.mExtendedPanId));
	aDataset.mComponents.mIsExtendedPanIdPresent = true;

	/* Set network key */
	memcpy(aDataset.mNetworkKey.m8, key, sizeof(aDataset.mNetworkKey));
	aDataset.mComponents.mIsNetworkKeyPresent = true;

	/* Set Network Name */
	length = strlen(aNetworkName);
	assert(length <= OT_NETWORK_NAME_MAX_SIZE);
	memcpy(aDataset.mNetworkName.m8, aNetworkName, length);
	aDataset.mComponents.mIsNetworkNamePresent = true;
	otDatasetSetActive(aInstance, &aDataset);
}

int ot_initialization(void)
{
	struct openthread_context *context = openthread_get_default_context();

	otInstance *instance = openthread_get_default_instance();

	/* LOG_INF("Updating thread parameters"); */
	ot_setNetworkConfiguration(instance);
	/* LOG_INF("Enabling thread"); */
	otError err = openthread_start(context); /* 'ifconfig up && thread start' */

	if (err != OT_ERROR_NONE) {
		LOG_ERR("Starting openthread: %d (%s)", err, otThreadErrorToString(err));
	}
	otDeviceRole current_role = otThreadGetDeviceRole(instance);

	LOG_INF("Current role of Thread device: %s", otThreadDeviceRoleToString(current_role));
	return 0;
}

void ot_handle_ping_reply(const otPingSenderReply *reply, void *context)
{
	otIp6Address add = reply->mSenderAddress;
	char string[OT_IP6_ADDRESS_STRING_SIZE];

	otIp6AddressToString(&add, string, OT_IP6_ADDRESS_STRING_SIZE);
	LOG_INF("Reply received from: %s\n", string);

	ot_wait4_ping_reply_from_peer = 1;

	if (!peer_address_info.address_found) {
		strcpy(peer_address_info.address_string, string);
		peer_address_info.address_found = true;
	}
}

void ot_get_peer_address(uint64_t timeout_ms)
{
	const char *dest = "ff03::1"; /* Mesh-Local anycast for all FTDs and MEDs */
	uint64_t start_time;
	otPingSenderConfig config;

	/* LOG_INF("Finding other devices..."); */
	memset(&config, 0, sizeof(config));
	config.mReplyCallback = ot_handle_ping_reply;

	openthread_api_mutex_lock(openthread_get_default_context());
	otIp6AddressFromString(dest, &config.mDestination);
	otPingSenderPing(openthread_get_default_instance(), &config);
	openthread_api_mutex_unlock(openthread_get_default_context());

	start_time = k_uptime_get();
	while (!peer_address_info.address_found && k_uptime_get() < start_time + timeout_ms) {
		k_sleep(K_MSEC(100));
	}
}

void ot_start_zperf_test_send(const char *peer_addr, uint32_t duration_sec,
	uint32_t packet_size_bytes,	uint32_t rate_bps, bool is_ot_zperf_udp)
{
	zperf_upload(peer_addr, duration_sec, packet_size_bytes, rate_bps, is_ot_zperf_udp);
}


void ot_start_zperf_test_recv(bool is_ot_zperf_udp)
{
	zperf_download(is_ot_zperf_udp);
}

void ot_zperf_test(bool is_ot_zperf_udp)
{
	if (is_ot_device_role_client) {
		uint32_t ot_zperf_duration_sec = CONFIG_COEX_TEST_DURATION/1000;

		ot_start_zperf_test_send(peer_address_info.address_string, ot_zperf_duration_sec,
		CONFIG_OT_PACKET_SIZE, CONFIG_OT_RATE_BPS, is_ot_zperf_udp);
	}
	/* Note: ot_start_zperf_test_recv() done as part of init */
}
```
