## dts/bindings/factory/darfon,custom-device.yaml
```yaml
include: base.yaml

compatible: "darfon,custom-device"
description: Custom devicetree device
properties:
  custom-gpios:
    type: phandle-array
    description: custom gpio pins
    required: true
```

## dts/bindings/led_driver/matrix_scan_leds.yaml
```yaml
description: |
    This is a representation of the led_matrix_scan led driver

compatible: "matrix-scan-leds"

include: base.yaml

properties:
  en-gpios:
    type: phandle-array
    description: enable gpio pin
    required: true
  col-gpios:
    type: phandle-array
    description: column gpio pins
    required: true
  row-gpios:
    type: phandle-array
    description: row gpio pins
    required: true
  scan-interval:
    type: int
    description: col-gpios scan interval
    required: true
```

## dts/bindings/sensor/pixart,paw3222.yaml
```yaml
#
# Copyright (c) 2019 Nordic Semiconductor
#
# SPDX-License-Identifier: LicenseRef-Nordic-5-Clause
#


description: |
    This is a representation of the PAW3222 optical motion sensor

compatible: "pixart,paw3222"

include: spi-device.yaml

properties:
    irq-gpios:
      type: phandle-array
      required: true
```

## dts/bindings/sensor/pixart,paw3232.yaml
```yaml
#
# Copyright (c) 2019 Nordic Semiconductor
#
# SPDX-License-Identifier: LicenseRef-Nordic-5-Clause
#


description: |
    This is a representation of the PAW3232 optical motion sensor

compatible: "pixart,paw3232"

include: spi-device.yaml

properties:
    irq-gpios:
      type: phandle-array
      required: true
```
