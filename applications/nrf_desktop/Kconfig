## applications/nrf_desktop/Kconfig
```kconfig
#
# Copyright (c) 2018 Nordic Semiconductor ASA
#
# SPDX-License-Identifier: LicenseRef-Nordic-5-Clause
#

menu "nRF52 Desktop"
rsource "Kconfig.hid"
rsource "Kconfig.ble"
rsource "Kconfig.debug"
rsource "src/events/Kconfig"
rsource "src/hw_interface/Kconfig"
rsource "src/modules/Kconfig"
rsource "src/util/Kconfig"
rsource "Kconfig.defaults"
rsource "src/multi_link/Kconfig"
endmenu

menu "CY25"
rsource "Kconfig.cy25"
endmenu

menu "Zephyr Kernel"
source "Kconfig.zephyr"
endmenu
```

## applications/nrf_desktop/Kconfig.cy25
```kconfig
#
# Copyright (c) 2022 Nordic Semiconductor ASA
#
# SPDX-License-Identifier: LicenseRef-Nordic-5-Clause
#

menu "cy25 configuration"

config CY25
	bool "cy25 poc"


if CY25

config CY25KB_RECHARGEABLE
    bool "cy25kb rechargeable"
	default n

config CY25KB_DRYCELL
    bool "cy25kb drycell"
	default n

config CY25MS_DRYCELL
    bool "cy25ms drycell"
	default n

config CY25_BLE_DFU_SPEED_UP
	 bool "cy25 BLE DFU speed up"
	 default n

config CY25_BAT_LOW_PERCEN
	int "SOC percentage"
	range 0 100
	default 3

config EARY_BATTERY_MEAS
	bool "Force reading BAT ADC before DPM ready"	
	default n

endif

endmenu
```

## applications/nrf_desktop/dts/bindings/m3tek,bt2306.yaml
```yaml
#
# Copyright (c) 2019 Nordic Semiconductor ASA
#
# SPDX-License-Identifier: Apache-2.0
#

description:
    Texas Instruments Battery Charger BT2306

compatible: "m3tek,bt2306"

include: [battery.yaml]

properties:
    int-gpios:
      type: phandle-array
      required: false

   
```

## applications/nrf_desktop/src/hw_interface/Kconfig.battery_charger_manager
```kconfig
#
# Copyright (c) 2019 Nordic Semiconductor
#
# SPDX-License-Identifier: LicenseRef-Nordic-5-Clause
#

menu "Battery charger manager configuration"



config CHARGER
	bool "battery charger manager"
	help
	  If selected, battery charging is enabled.


if CHARGER

config CHARGER_CONSTANT_CHARGE_CURRENT_UA
	int "Fast charge(uA) current"
	default 0
config CHARGER_PRECHARGE_CURRENT_UA
	int "Precharge current(uA) setting"
	default 0
config CHARGER_CHARGE_TERM_CURRENT_UA
	int "Termination current(uA) setting"
	default 0
config CHARGER_CONSTANT_CHARGE_VOLTAGE_UV
	int "Battery voltage(uV) setting"
	default 0
config CHARGER_INPUT_REGULATION_CURRENT_UA
	int "Input current(uA) limit setting"
	default 0
config CHARGER_INPUT_REGULATION_VOLTAGE_UV
	int "Input voltage(mV) threshold setting"
	default 0

	module = CHARGER_MANAGER
	module-str = battery charger manager module
	source "subsys/logging/Kconfig.template.log_config"
endif

endmenu
```

## applications/nrf_desktop/src/hw_interface/Kconfig.tilt
```kconfig
#
# Copyright (c) 2019 Nordic Semiconductor
#
# SPDX-License-Identifier: LicenseRef-Nordic-5-Clause
#

menu "Tilt configuration"

choice
	prompt "Select tilt interface"
	default DESKTOP_TILT_NONE

config DESKTOP_TILT_NONE
	bool "Disable tilt"
	help
	  If selected, no tilt source if defined for the interface.

config DESKTOP_TILT_BUTTONS_ENABLE
	bool "tilt from buttons"
	depends on CAF_BUTTON_EVENTS
	help
	  If selected, movement data it obtained from buttons.

endchoice


config DESKTOP_TILT_BUTTONS_LEFT_KEY_ID
	int "Left key ID"
	depends on DESKTOP_TILT_BUTTONS_ENABLE
	default 0
	help
	  ID of key use for generating left tilt.

config DESKTOP_TILT_BUTTONS_RIGHT_KEY_ID
	int "Right key ID"
	depends on DESKTOP_TILT_BUTTONS_ENABLE
	default 0
	help
	  ID of key use for generating right tilt.

config DESKTOP_TILT_BUTTONS_TILT_PER_SEC
	int "tilt generated per second during a button press"
	depends on DESKTOP_TILT_BUTTONS_ENABLE
	range 1 100000
	default 1000

if !DESKTOP_TILT_NONE
module = DESKTOP_TILT
module-str = tilt module
source "subsys/logging/Kconfig.template.log_config"
endif

endmenu
```

## applications/nrf_desktop/src/modules/Kconfig.dell_pair
```kconfig
#
# Copyright (c) 2022 Nordic Semiconductor ASA
#
# SPDX-License-Identifier: LicenseRef-Nordic-5-Clause
#

config DELL_PAIR_ENABLE

	bool "DELL PAIR ENABLE"
	default n

if DELL_PAIR_ENABLE
    config BT_ADV_PROV_DELL_PAIR
	bool "Dell Fast Pair"
    default y
	help
	  Adds Microsoft Swfit Pair manufacturer data to advertising data if
	  device is in pairing mode and advertising has not entered grace
	  period. 

    module = DELL_PAIR
    module-str = dell_pair
    source "subsys/logging/Kconfig.template.log_config"

endif
```

## applications/nrf_desktop/src/modules/Kconfig.dpm
```kconfig
#
# Copyright (c) 2022 Nordic Semiconductor ASA
#
# SPDX-License-Identifier: LicenseRef-Nordic-5-Clause
#

config DPM_ENABLE

	bool "DPM ENABLE"
	default n

if DPM_ENABLE

config DPM_COLLABS_KEY_SUPPORT
	bool "DPM collabs key support"
	default n

config DPM_MULTI_LINK_SUPPORT
	bool "DPM multi link support"
	default n

module = DPM
module-str = dpm
source "subsys/logging/Kconfig.template.log_config"

endif
```

## applications/nrf_desktop/src/modules/Kconfig.mac_os_keys
```kconfig
#
# Copyright (c) 2019 Nordic Semiconductor
#
# SPDX-License-Identifier: LicenseRef-Nordic-5-Clause
#

menu "Mac os keys"

config DESKTOP_MAC_OS_KEYS_ENABLE
	bool "Enable Mac os keys support"
	help
	  Button remapper adds fn bit to all key ids while mac os key function is tigger.

if DESKTOP_MAC_OS_KEYS_ENABLE

config WIN_MODE_SELECTOR_BUTTON
    hex "Windows os mode opration button"
	range 0x0000 0xffff
	default 0xffff

config MAC_MODE_SELECTOR_BUTTON
    hex "Mac os mode opration button"
	range 0x0000 0xffff
	default 0xffff

config DESKTOP_MAC_KEYS_MAX_ACTIVE
	int "Max Fn key pressed"
	default 4
	help
	  Maximum number of mac keys pressed at the same time.

module = DESKTOP_MAC_OS_KEYS
module-str = Mac os keys
source "subsys/logging/Kconfig.template.log_config"

endif

endmenu
```

## applications/nrf_desktop/src/modules/Kconfig.radio_test
```kconfig
#
# Copyright (c) 2022 Nordic Semiconductor ASA
#
# SPDX-License-Identifier: LicenseRef-Nordic-5-Clause
#

config RADIO_TEST_ENABLE

	bool "RADIO_TEST ENABLE"
	default n

if RADIO_TEST_ENABLE

config RADIO_TEST_POWER_CONTROL_AUTOMATIC
	bool "Automatic power control"
	depends on FEM
	default y
	help
	  Set SoC output power and front-end module gain to achieve Tx output power requested
	  by user. If the exact value cannot be achieved, power is set to closest value which does
	  not exceed the limits. If this option is disabled, user has to set SoC output power and
	  fem gain with separate commands.

config RADIO_TEST_CHANNEL_LOW
	int "Default radio test low channel"
	range 0 80
	default 2

config RADIO_TEST_CHANNEL_MIDDLE
	int "Default radio test middle channel"
	range 0 80
	default 40

config RADIO_TEST_CHANNEL_HIGH
	int "Default radio test high channel"
	range 0 80
	default 80

module = RADIO_TEST
module-str = radio_test
source "subsys/logging/Kconfig.template.log_config"

endif
```

## applications/nrf_desktop/src/modules/Kconfig.uart_handler
```kconfig
#
# Copyright (c) 2022 Nordic Semiconductor ASA
#
# SPDX-License-Identifier: LicenseRef-Nordic-5-Clause
#

config UART_HANDLER_ENABLE

	bool "UART_HANDLER ENABLE"
	default n

if UART_HANDLER_ENABLE

module = UART_HANDLER
module-str = uart_handler
source "subsys/logging/Kconfig.template.log_config"

endif
```

## applications/nrf_desktop/src/multi_link/Kconfig
```kconfig
# Copyright (c) 2020 IndiLogic LLC
# SPDX-License-Identifier: Apache-2.0


menu "Multi LINK configuration"

config MULTILINK_ENABLE
	bool "Enable multi link module"
#	depends on DESKTOP_ROLE_HID_PERIPHERAL
#	select GAZELL
#	select GZLL
	help
	  Enables multi link module.
if MULTILINK_ENABLE

choice GAZELL_SWI
	default GAZELL_SWI1 if BT
	help
	  Update used software interrupt to avoid BLE interoperability issues.
endchoice

choice GAZELL_TIMER
	default GAZELL_TIMER2 if BT
	help
	  Update used timer to avoid BLE interoperability issues.
endchoice

config MULTILINK_BLE_SELECTOR_BUTTON
    hex "Multi-link and BLE mode opration button"
	range 0x0000 0xffff
	default 0xffff

config BT1_MODE_SELECTOR_BUTTON
    hex "BLE 1 mode opration button"
	range 0x0000 0xffff
	default 0xffff

config BT2_MODE_SELECTOR_BUTTON
    hex "BLE 2 mode opration button"
	range 0x0000 0xffff
	default 0xffff

config MULTILINK_MODE_SELECTOR_BUTTON
    hex "Multi-link mode opration button"
	range 0x0000 0xffff
	default 0xffff

config MULTI_LINK_PEER_CONTROL_BUTTON
    hex "Multi-link peer operation button"
	range 0x0000 0xffff
	default 0xffff

config DESKTOP_GZP_SUBSCRIBER_PRIORITY
	int "Gazell HID reports subscriber priority"
	default 1
	range 1 255
	help
	  The lower value means the lower priority in subscribtion to HID
	  reports. By default, Gazell uses the lowest possible priority.

config DESKTOP_BLE_GZP_SELECTOR_ID
	int "ID of HW selector used to control switching between Bluetooth LE and Gazell"
	range 0 255
	default 0

config DESKTOP_BLE_GZP_SELECTOR_POS_BLE
	int "Selector position for BLE"
	range 0 255
	default 0

config DESKTOP_BLE_GZP_SELECTOR_POS_GZP
	int "Selector position for Gazell"
	range 0 255
	default 0

config DESKTOP_GZP_MODULE_SUSPEND_EVENTS
	bool "Module suspend/resume request events support"
	depends on CAF_MODULE_SUSPEND_EVENTS
	default y

config DESKTOP_GZP_SUSPEND_ON_READY
	bool "Automatically suspend module right after initialization"
	depends on DESKTOP_GZP_MODULE_SUSPEND_EVENTS
	default y

#config DELL_DONGLE_MULTI_LINK_PROTO_COMMON_LOG_LEVEL
#	int "Multi link common log level"
#	default 0

#config DELL_DONGLE_MULTI_LINK_PROTO_DEVICE_LOG_LEVEL
#	int "Multi link device log level"
#	default CONFIG_DELL_DONGLE_MULTI_LINK_PROTO_COMMON_LOG_LEVEL

config MULTI_LINK_PEER_EVENTS
	bool "Enable multi link peer events"
	default n
	help
	  Enable support for multi link peer events.


config DELL_DEVICE_MULTI_LINK_PROTO_COMMON_LOG_LEVEL
	int "Multi link common log level"
	default 3

config DELL_DEVICE_MULTI_LINK_PROTO_DEVICE_LOG_LEVEL
	int "Multi link device log level"
	default 0

config CHICONY_DEBUG_ENABLE
	bool 
    default n
    prompt "Chicony  DEBUG"

config CHICONY_COMMON_DEBUG_MODE_ENABLE
	bool 
    default n
    prompt "Chicony  Common DEBUG"

config CHICONY_DEBUG_PSA_HELPER_ENABLE
	bool 
    default n
    prompt "Chicony  DEBUG"
	
config ENABLE_INJECTTION_DATA
	bool 
    default n
    prompt "G3p5 Injection Data  DEBUG"

config ODM_COMMON_DEBUG_MODE_ENABLE
	bool 
    default n
    prompt "Enable odm debug common.c"

config MULTI_LINK_COMMON_LIB_ENABLE
	bool 
    default n
    prompt "Enable odm debug common.c"

config DESKTOP_MULTI_LINK_G35_SUPPORT
    bool
    default y
    prompt "Enable MULTI Link G35"




module = MULTI_LINK
module-str = multi link
source "subsys/logging/Kconfig.template.log_config"


endif # MULTILINK_ENABLE
endmenu
 
```

## drivers/charger/Kconfig
```kconfig
#
# Copyright (c) 2019 Nordic Semiconductor
#
# SPDX-License-Identifier: LicenseRef-Nordic-5-Clause
#

menuconfig CHARGER
	bool "Battery charger drivers"
	help
	  Enable battery charger driver configuration.

if CHARGER

rsource "bq2561x/Kconfig"
rsource "bq24295/Kconfig"
rsource "bt2306/Kconfig"
endif # CHARGER
```

## drivers/charger/bq24295/Kconfig
```kconfig
#
#  Copyright (c) 2019 Nordic Semiconductor ASA
#
#  SPDX-License-Identifier: Apache-2.0
#

menuconfig BQ24295
	bool "BQ24295 Charger"
	depends on DT_HAS_TI_BQ24295_ENABLED
	select I2C
	help
	  Enable driver for BQ24295 Charger.

if BQ24295


module = BQ24295
module-str = BQ24295
source "${ZEPHYR_BASE}/subsys/logging/Kconfig.template.log_config"

endif #BQ24295
```

## drivers/charger/bq2561x/Kconfig
```kconfig
#
#  Copyright (c) 2019 Nordic Semiconductor ASA
#
#  SPDX-License-Identifier: Apache-2.0
#

menuconfig BQ2561X
	bool "BQ2561X Charger"
	depends on DT_HAS_TI_BQ2561X_ENABLED
	select I2C
	help
	  Enable driver for BQ2561X Charger.

if BQ2561X


module = BQ2561X
module-str = BQ2561X
source "${ZEPHYR_BASE}/subsys/logging/Kconfig.template.log_config"

endif #BQ2561X
```

## drivers/charger/bt2306/Kconfig
```kconfig
#
#  Copyright (c) 2019 Nordic Semiconductor ASA
#
#  SPDX-License-Identifier: Apache-2.0
#

menuconfig BT2306
	bool "BT2306 Charger"
	depends on DT_HAS_M3TEK_BT2306_ENABLED
	select I2C
	help
	  Enable driver for BT2306 Charger.

if BT2306


module = BT2306
module-str = BT2306
source "${ZEPHYR_BASE}/subsys/logging/Kconfig.template.log_config"

endif #BT2306
```

## drivers/led_driver/Kconfig
```kconfig
#
# Copyright (c) 2019 Nordic Semiconductor
#
# SPDX-License-Identifier: LicenseRef-Nordic-5-Clause
#

menuconfig LED_DRIVER
	bool "LED Drivers"
	help
		Include LED drivers in config

if LED_DRIVER

rsource "lp50xx/Kconfig"
rsource "led_matrix_scan/Kconfig"

endif 
```

## drivers/led_driver/led_matrix_scan/Kconfig
```kconfig
#
#  Copyright (c) 2019 Nordic Semiconductor ASA
#
#  SPDX-License-Identifier: LicenseRef-Nordic-5-Clause
#

menuconfig MATRIX_SCAN_LED
	bool "matrix_scan_led"
#	depends on I2C
	help
	  Enable driver for MATRIX_SCAN_LED.

if MATRIX_SCAN_LED

config LED_DRIVER_MAX_LEDS
	int "Maximum number LEDs"
	default 6
	range 1 6
	help
	  Maximum number of LED devices. The minimum (and
	  default) number is 1.

endif
```

## drivers/led_driver/lp50xx/Kconfig
```kconfig
menuconfig LP5012
	bool "LP5012 LED DRIVER"
	depends on I2C
	help
	  Enable driver for LP5012 sensors.

if LP5012

config LED_DRIVER_MAX_LEDS
	int "Maximum number LEDs"
	default 12
	range 1 12
	help
	  Maximum number of LED devices. The minimum (and
	  default) number is 1.

endif
```

## drivers/sensor/paw3222/Kconfig
```kconfig
# PAW3222 optical motion sensor
#
# Copyright (c) 2019 Nordic Semiconductor
#
# SPDX-License-Identifier: LicenseRef-Nordic-5-Clause
#

menuconfig PAW3222
	bool "PAW3222 mouse optical sensor"
	help
	  Enable PAW3222 mouse optical sensor.

if PAW3222

choice
	prompt "Select PAW3222 sensor orientation"
	default PAW3222_ORIENTATION_0

config PAW3222_ORIENTATION_0
	bool "PAW3222 not rotated"

config PAW3222_ORIENTATION_90
	bool "PAW3222 rotated 90 deg clockwise"

config PAW3222_ORIENTATION_180
	bool "PAW3222 rotated 180 deg clockwise"

config PAW3222_ORIENTATION_270
	bool "PAW3222 rotated 270 deg clockwise"

endchoice

choice
	prompt "Select PAW3222 sensor motion data length"
	default PAW3222_8_BIT_MODE

config PAW3222_8_BIT_MODE
	bool "PAW3222 8-bit motion data length"

config PAW3222_12_BIT_MODE
	bool "PAW3222 12-bit motion data length"

endchoice

module = PAW3222
module-str = PAW3222
source "${ZEPHYR_BASE}/subsys/logging/Kconfig.template.log_config"

endif #PAW3222
```

## drivers/sensor/paw3232/Kconfig
```kconfig
# PAW3232 optical motion sensor
#
# Copyright (c) 2019 Nordic Semiconductor
#
# SPDX-License-Identifier: LicenseRef-Nordic-5-Clause
#

menuconfig PAW3232
	bool "PAW3232 mouse optical sensor"
	help
	  Enable PAW3232 mouse optical sensor.

if PAW3232

choice
	prompt "Select PAW3232 sensor orientation"
	default PAW3232_ORIENTATION_0

config PAW3232_ORIENTATION_0
	bool "PAW3232 not rotated"

config PAW3232_ORIENTATION_90
	bool "PAW3232 rotated 90 deg clockwise"

config PAW3232_ORIENTATION_180
	bool "PAW3232 rotated 180 deg clockwise"

config PAW3232_ORIENTATION_270
	bool "PAW3232 rotated 270 deg clockwise"

endchoice

choice
	prompt "Select PAW3232 sensor motion data length"
	default PAW3232_8_BIT_MODE

config PAW3232_8_BIT_MODE
	bool "PAW3232 8-bit motion data length"

config PAW3232_16_BIT_MODE
	bool "PAW3232 16-bit motion data length"

endchoice

module = PAW3232
module-str = PAW3232
source "${ZEPHYR_BASE}/subsys/logging/Kconfig.template.log_config"

endif #PAW3232
```

## dts/bindings/charger/ti,bq2561x.yaml
```yaml
#
# Copyright (c) 2019 Nordic Semiconductor ASA
#
# SPDX-License-Identifier: Apache-2.0
#

description:
    Texas Instruments Battery Charger BQ2561X

compatible: "ti,bq2561x"

include: [battery.yaml, i2c-device.yaml]

properties:
    int-gpios:
      type: phandle-array
      required: false

    ce-gpios:
      type: phandle-array
      required: false
```
