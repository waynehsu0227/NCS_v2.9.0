## subsys/bluetooth/adv_prov/providers/Kconfig.dell_pair
```kconfig
#
# Copyright (c) 2022 Nordic Semiconductor ASA
#
# SPDX-License-Identifier: LicenseRef-Nordic-5-Clause
#
if BT_ADV_PROV_DELL_PAIR

config BT_ADV_PROV_DELL_PAIR_COOL_DOWN_DURATION
	int "Dell Pair cool down duration [s]"
	default 30
	range 30 600
	help
	  To ensure users would not try to connect to a device which is no
	  longer available, Swift Pair vendor section is removed and
	  advertising is continued without Swift Pair data for additional time
	  before the advertising is stopped.

	  The cool down phase is reported as requested grace period. The used
	  grace period is greater than or equal to the requested value.
endif  # BT_ADV_PROV_DELL_NAME
```
